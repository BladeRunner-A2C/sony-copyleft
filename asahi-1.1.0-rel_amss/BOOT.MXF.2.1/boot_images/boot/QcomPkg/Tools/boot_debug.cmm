;****************************************************************************
;**         boot_debug.cmm
;**
;**         This script performs setup for debugging on secboot 3.0 Architecture.
;**
;**  Copyright (c) 2018-2023 Qualcomm Technologies, Inc. All rights reserved.
;**  Confidential and Proprietary - Qualcomm Technologies, Inc.	
;**
;****************************************************************************
;**
;**                        EDIT HISTORY FOR MODULE
;**
;** $$
;**
;** when       who     what, where, why
;** --------   ---     ------------------------------------------------------
;** 11/06/23   amaji   Added support for Milos
;** 04/27/23   nnaram  Added support for palawan
;** 03/02/23   krd     Added support for Kuno
;** 12/19/22   rama    Clean up older targets
;** 04/26/22   ts      Added support for Halliday
;** 02/23/21   rhy     Added support for Pinnacles
;** 09/23/21   ck      Added support for Lassen
;** 02/19/21   rama    Ported changes for removing unused options
;** 10/06/20   rama    Added rumi emulation version as argument
;** 08/07/20   rama    Added support for Waipio
;** 03/13/20   ck      Added support for Olympic
;** 01/03/20   rrawat  Added support for Cedros
;** 06/20/18   ds      Add SM8250
;****************************************************************************

  ; This script is a wrapper for the target specific debug script

  ;============================================================================
  ; Declare variables used
  ;============================================================================
  local  &Choice
  local  &Option  ; Menu Option
  global &Platform
  global &Storage
  global &SkipSysUp
  local  &Variant
  
  ;============================================================================
  ; Get the arguments passed in.
  ;============================================================================
  ENTRY &Choice &Variant &Platform &Option &Storage &DumpType &DumpStorage &QSEEBuildPath &RumiEmulation
  &SkipSysUp="FALSE"

  ;============================================================================
  ; Set up the display window
  ;============================================================================

  winclear
  area.RESET 
  WINPOS 0% 50% 68% 50% 0. 0. W001
  Area.create MAIN
  Area.view MAIN
  Area.select MAIN
  
  ;============================================================================
  ; If user passed TARGET on command line, just go
  ;============================================================================ 

  if "&Choice"=="Lanai"
  (
    gosub CheckVariant
    do boot_debug_common.cmm Soc Lanai SM Loader False &Variant &Platform &Option &Storage &DumpType &DumpStorage &QSEEBuildPath &RumiEmulation
    enddo
  )

  if "&Choice"=="Pakala"
  (
    gosub CheckVariant
    do boot_debug_common.cmm Soc Pakala SM Loader False &Variant &Platform &Option &Storage &DumpType &DumpStorage &QSEEBuildPath &RumiEmulation
    enddo
  )
  
  if "&Choice"=="Palawan"
  (
    gosub CheckVariant
    do boot_debug_common.cmm Soc Palawan SM Loader False &Variant &Platform &Option &Storage &DumpType &DumpStorage &QSEEBuildPath &RumiEmulation
    enddo
  )

  if "&Choice"=="Hamoa"
  (
    gosub CheckVariant
    do boot_debug_common.cmm Soc Hamoa SM Loader False &Variant &Platform &Option &Storage &DumpType &DumpStorage &QSEEBuildPath &RumiEmulation
    enddo
  )
  
  if "&Choice"=="Milos"
  (
    gosub CheckVariant
    do boot_debug_common.cmm Soc Milos SM Loader False &Variant &Platform &Option &Storage &DumpType &DumpStorage &QSEEBuildPath &RumiEmulation
    enddo
  )

  ;============================================================================
  ; Provide user with a choice for the chipset
  ;============================================================================
    
  print "Please enter chipset name: "
  print "eg: Lanai, Pakala , Palawan, Hamoa"
  print
  print "Please make a choice: "
  enter &Choice
  print "Enter Variant Lanai LAA, Pakala LAA, Palawan LAA, Hamoa WP, Milos LAA: "
  enter &Variant
  gosub CheckVariant

  if "&Choice"=="Lanai"
  (
    do boot_debug_common.cmm Soc Lanai SM Loader False &Variant
    enddo
  )

  if "&Choice"=="Pakala"
  (
    do boot_debug_common.cmm Soc Pakala SM Loader False &Variant
    enddo
  )
  
  if "&Choice"=="Palawan"
  (
    do boot_debug_common.cmm Soc Palawan SM Loader False &Variant
    enddo
  )
  
  if "&Choice"=="Hamoa"
  (
    print "Enter storage type (UFS/SPINOR) : "
    &SkipSysUp="TRUE"
    enter &Storage
    do boot_debug_common.cmm Soc Hamoa SM Loader False &Variant default default &Storage
    enddo
  )
  
  if "&Choice"=="Kuno"
  (
    do boot_debug_common.cmm Soc Kuno SDX Loader False &Variant
    enddo
  )
  
  if "&Choice"=="Milos"
  (
    do boot_debug_common.cmm Soc Milos SM Loader False &Variant
    enddo
  )
  
  ;Default case 
  (
    print "Incorrect entry"
    enddo
  )
  
CheckVariant:
  if "&Variant"==""
  (
    print "Variant not passed.  Exiting."
    END
  )
  return
