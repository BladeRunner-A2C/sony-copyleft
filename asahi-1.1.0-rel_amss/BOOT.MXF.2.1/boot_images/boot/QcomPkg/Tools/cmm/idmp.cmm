;============================================================================
;  Name:
;    idmp.cmm
;
;  Description:
;     Interrupt related registers dump.
;
; Copyright (c) 2017-2018 Qualcomm Technologies, Inc.
; All Rights Reserved.
; Qualcomm Technologies Proprietary and Confidential.
;
;----------------------------------------------------------------------------
;============================================================================
;
;                        EDIT HISTORY FOR MODULE
;
;
;   when         who     what, where, why
; -----------   -----   ---------------------------------------------------------------
;  10-28-2022  kanandac  Added Traget check feature and code to read all SPI status
;  09-05-2018    yg      Add Routing info for Qtimer
;  12-14-2017    yg      Created new
;======================================================================================;

; ---------------------------------------------------------
; Script entry point
; ---------------------------------------------------------
global &Distr_base
global &MaxCpu
global &QtimerBase
global &RDistr_base
global &RDistr_Stride

local &cpunum
local &RD_Base
local &SGI_Base
local &istat
local &rdtype
local &adr
local &n

local &isenabler
local &ispendr
local &isactiver
local &iprio
local &itarget
local &icfg
local &iroute

local &iEnabled
local &iPending
local &iActive

local &low
local &high
local &Target
local &CwDir
local &ConfigTargetPath

;area.reset
area.clear
area.create IDMP_LOGS 1000. 8192.
area.select IDMP_LOGS
area.view IDMP_LOGS

;---------------------------------------------------
; Entry point
;---------------------------------------------------
ENTRY &Target 

  if ("&Target"=="")
  (
    print "ERROR!! Please include the target name..."
    print "       For Ex: do idump.cmm <target_name>"
    enddo
  )

  &isenabler=0x100
  &ispendr=0x200
  &isactiver=0x300
  &iprio=0x400
  &itarget=0x800
  &icfg=0xC00
  &iroute=0x6000

  ;Setup present and other directories
  &CwDir=os.ppd()
  &Target=convert.toupper("&Target")

  if (("&Target"=="LANAI")||("&Target"=="HAMOA")||("&Target"=="KUNO")||("&Target"=="PINNACLES")||("&Target"=="LASSEN"))
  (
    if ("&Target"=="KUNO")
    (
    print "idump for Kuno is disabled for now..."
    print "!!Please Update RDistr_base address and stride in configure_target.cmm for kuno target"
    enddo 
    )
    print "idump for &Target..."
    &ConfigTargetPath="&CwDir/../../SocPkg/&Target/Tools"
    do &ConfigTargetPath/configure_target.cmm
  )
  else
  (
    print "Error!! Target should be either Lanai, Pinnacles, Hamoa, Kuno or Lassen"
    enddo
  )

  &cpunum=0

  print ""
  print "Distributor Base     : ", FORMAT.HEX(8.,&Distr_base)
  print "Redistributor Base   : ", FORMAT.HEX(8.,&RDistr_base)
  print "Redistributor Stride : ", FORMAT.HEX(8.,&RDistr_Stride)

  print ""
  print "PPI's (31-16) & SGI's (15-0)"
  print "CPU  : RDist type    IEnabled      IPend       IActive "
  while (&cpunum<&MaxCpu)
  (
     &RD_Base=&RDistr_base+(&cpunum*&RDistr_Stride)
     &SGI_Base=&RD_Base+0x10000

     &adr=&RD_Base+0x8
     &rdtype=data.long(A:&adr)

     &adr=&SGI_Base+&isenabler
     &iEnabled=data.long(A:&adr)

     &adr=&SGI_Base+&ispendr
     &iPending=data.long(A:&adr)

     &adr=&SGI_Base+&isactiver
     &iActive=data.long(A:&adr)


     print "&cpunum  : ", FORMAT.HEX(8.,&rdtype), "      ", FORMAT.HEX(8.,&iEnabled), "     ", FORMAT.HEX(8.,&iPending), "     ", FORMAT.HEX(8.,&iActive)

     &cpunum=&cpunum+1
  )

  print ""
  print "SPI's: (32 - 1023)"

  &adr=&Distr_base+&isenabler
  &n=1
  print "IEnabled   :  ", FORMAT.HEX(8.,&adr), "++7C"
  print "Register   :   Addr    :   value    :  BIT_RANGE"
  while (&n<=31.)
  (
    &adr=&adr+4
    &low=32.*&n
    &high=&low+32.-1
    &iEnabled=data.long(A:&adr)
    print "IEnabled   : ", FORMAT.HEX(8.,&adr), "     ", FORMAT.HEX(8.,&iEnabled),"    ", FORMAT.Decimal(4.,&high)," -", FORMAT.Decimal(4.,&low)
    &n=&n+1
  )

  print ""
  &adr=&Distr_base+&ispendr
  &n=1
  print "IPending   :  ", FORMAT.HEX(8.,&adr), "++7C"
  print "Register   :   Addr    :   value"
  while (&n<=31.)
  (
    &adr=&adr+4
    &low=32.*&n
    &high=&low+32.-1
    &iPending=data.long(A:&adr)
    print "IPending   : ", FORMAT.HEX(8.,&adr), "     ", FORMAT.HEX(8.,&iPending),"    ", FORMAT.Decimal(4.,&high)," -", FORMAT.Decimal(4.,&low) 
    &n=&n+1
  )

  print ""
  &adr=&Distr_base+&isactiver
  &n=1
  print "iActive    :  ", FORMAT.HEX(8.,&adr), "++7C"
  print "Register   :   Addr    :   value"
  while (&n<=31.)
  (
    &adr=&adr+4
    &low=32.*&n
    &high=&low+32.-1
    &iActive=data.long(A:&adr)
    print "IActive   : ", FORMAT.HEX(8.,&adr), "     ", FORMAT.HEX(8.,&iActive),"    ", FORMAT.Decimal(4.,&high)," -", FORMAT.Decimal(4.,&low) 
    &n=&n+1
  )

  &adr=&Distr_base+0x20+&iprio
  print "IPriority :  ", FORMAT.HEX(8.,&adr), "++3FF   (1 Byte per intr)"

  &adr=&Distr_base+0x8+&icfg
  print "ICfg      :  ", FORMAT.HEX(8.,&adr), "++0xFF  (2 bits per intr)"

  &adr=&Distr_base+0x100+&iroute
  print "IRoute    :  ", FORMAT.HEX(8.,&adr), "++1EFF  (8 Bytes per intr)"


  print ""
  
  print "Timer at " , FORMAT.HEX(8.,&QtimerBase)
  &adr=&QtimerBase
  &low=data.long(A:&adr)
  &high=data.long(A:&adr+0x4)
  print "CntPct    :  ", FORMAT.HEX(8.,&high), "    ", FORMAT.HEX(8.,&low)

  &adr=&QtimerBase+0x20
  &low=data.long(A:&adr)
  &high=data.long(A:&adr+0x4)
  print "CntpCval  :  ", FORMAT.HEX(8.,&high), "    ", FORMAT.HEX(8.,&low)

  &adr=&QtimerBase+0x2C
  &low=data.long(A:&adr)
  print "CntpCtl   :  ", FORMAT.HEX(1.,&low)

  &QtimerIntrVect=0x28
  &adr=&Distr_base+&iroute+(&QtimerIntrVect*0x8)
  &low=data.quad(A:&adr)
  print "Routing   :  Vect ", FORMAT.Decimal(2.,&QtimerIntrVect), " => Cpu ", FORMAT.HEX(8.,&low)

  print "------------------------------------------------------------"

enddo

