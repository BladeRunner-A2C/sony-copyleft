;============================================================================
;
; *************** THIS SCRIPT WAS AUTOGENERATED ****************
;
; SCRIPT
;   enable_all_clocks.cmm
;
; GENERAL DESCRIPTION
;   This script enables all clocks in a specified subsystem.
;
; Copyright (c) 2023 by QUALCOMM Technologies Inc.  All Rights Reserved.
;============================================================================

entry &subsystem

if ("&subsystem"=="")
(
  &subsystem="all"
)


&access_mode="ezaxi"


if ("&subsystem"=="gcc"||"&subsystem"=="all")
(
  per.set.field &access_mode:0x110004 %long 0x1 0x0 ; Enable GCC_ANOC_PCIE_GDSCR
  per.set.field &access_mode:0x189004 %long 0x1 0x0 ; Enable GCC_IPA_GDSCR
  per.set.field &access_mode:0x199000 %long 0x1 0x0 ; Enable GCC_LPASS_QTB_GDSCR
  per.set.field &access_mode:0x11C004 %long 0x1 0x0 ; Enable GCC_MMNOC_GDSCR
  per.set.field &access_mode:0x183004 %long 0x1 0x0 ; Enable GCC_MMU_GDSCR
  per.set.field &access_mode:0x16B004 %long 0x1 0x0 ; Enable GCC_PCIE_0_GDSCR
  per.set.field &access_mode:0x16C000 %long 0x1 0x0 ; Enable GCC_PCIE_0_PHY_GDSCR
  per.set.field &access_mode:0x19D000 %long 0x1 0x0 ; Enable GCC_TURING_QTB_GDSCR
  per.set.field &access_mode:0x19E000 %long 0x1 0x0 ; Enable GCC_UFS_MEM_PHY_GDSCR
  per.set.field &access_mode:0x177004 %long 0x1 0x0 ; Enable GCC_UFS_PHY_GDSCR
  per.set.field &access_mode:0x139004 %long 0x1 0x0 ; Enable GCC_USB30_PRIM_GDSCR
  per.set.field &access_mode:0x150018 %long 0x1 0x0 ; Enable GCC_USB3_PHY_GDSCR

  data.set &access_mode:0x152000 %long 0xFFFFFFFF ; Enable all votable clocks in GCC_APCS_CLOCK_BRANCH_ENA_VOTE
  data.set &access_mode:0x152008 %long 0xFFFFFFFF ; Enable all votable clocks in GCC_APCS_CLOCK_BRANCH_ENA_VOTE_1
  data.set &access_mode:0x152010 %long 0xFFFFFFFF ; Enable all votable clocks in GCC_APCS_CLOCK_BRANCH_ENA_VOTE_2
  data.set &access_mode:0x152018 %long 0xFFFFFFFF ; Enable all votable clocks in GCC_APCS_CLOCK_BRANCH_ENA_VOTE_3
  data.set &access_mode:0x153030 %long 0xFFFFFFFF ; Enable all votable clocks in GCC_APCS_TZ_CLOCK_BRANCH_ENA_VOTE
  data.set &access_mode:0x153038 %long 0xFFFFFFFF ; Enable all votable clocks in GCC_APCS_TZ_CLOCK_BRANCH_ENA_VOTE_1
  data.set &access_mode:0x153040 %long 0xFFFFFFFF ; Enable all votable clocks in GCC_APCS_TZ_CLOCK_BRANCH_ENA_VOTE_2
  data.set &access_mode:0x153048 %long 0xFFFFFFFF ; Enable all votable clocks in GCC_APCS_TZ_CLOCK_BRANCH_ENA_VOTE_3
  data.set &access_mode:0x179000 %long 0xFFFFFFFF ; Enable all votable clocks in GCC_CESTA_CLOCK_BRANCH_ENA_VOTE
  data.set &access_mode:0x179008 %long 0xFFFFFFFF ; Enable all votable clocks in GCC_CESTA_CLOCK_BRANCH_ENA_VOTE_1
  data.set &access_mode:0x179010 %long 0xFFFFFFFF ; Enable all votable clocks in GCC_CESTA_CLOCK_BRANCH_ENA_VOTE_2
  data.set &access_mode:0x179018 %long 0xFFFFFFFF ; Enable all votable clocks in GCC_CESTA_CLOCK_BRANCH_ENA_VOTE_3
  data.set &access_mode:0x156000 %long 0xFFFFFFFF ; Enable all votable clocks in GCC_HYP_CLOCK_BRANCH_ENA_VOTE
  data.set &access_mode:0x156008 %long 0xFFFFFFFF ; Enable all votable clocks in GCC_HYP_CLOCK_BRANCH_ENA_VOTE_1
  data.set &access_mode:0x156010 %long 0xFFFFFFFF ; Enable all votable clocks in GCC_HYP_CLOCK_BRANCH_ENA_VOTE_2
  data.set &access_mode:0x156018 %long 0xFFFFFFFF ; Enable all votable clocks in GCC_HYP_CLOCK_BRANCH_ENA_VOTE_3
  data.set &access_mode:0x155000 %long 0xFFFFFFFF ; Enable all votable clocks in GCC_LPASS_DSP_CLOCK_BRANCH_ENA_VOTE
  data.set &access_mode:0x155008 %long 0xFFFFFFFF ; Enable all votable clocks in GCC_LPASS_DSP_CLOCK_BRANCH_ENA_VOTE_1
  data.set &access_mode:0x155010 %long 0xFFFFFFFF ; Enable all votable clocks in GCC_LPASS_DSP_CLOCK_BRANCH_ENA_VOTE_2
  data.set &access_mode:0x155018 %long 0xFFFFFFFF ; Enable all votable clocks in GCC_LPASS_DSP_CLOCK_BRANCH_ENA_VOTE_3
  data.set &access_mode:0x135030 %long 0xFFFFFFFF ; Enable all votable clocks in GCC_MSS_Q6_CLOCK_BRANCH_ENA_VOTE
  data.set &access_mode:0x135038 %long 0xFFFFFFFF ; Enable all votable clocks in GCC_MSS_Q6_CLOCK_BRANCH_ENA_VOTE_1
  data.set &access_mode:0x135040 %long 0xFFFFFFFF ; Enable all votable clocks in GCC_MSS_Q6_CLOCK_BRANCH_ENA_VOTE_2
  data.set &access_mode:0x135048 %long 0xFFFFFFFF ; Enable all votable clocks in GCC_MSS_Q6_CLOCK_BRANCH_ENA_VOTE_3
  data.set &access_mode:0x151000 %long 0xFFFFFFFF ; Enable all votable clocks in GCC_RPM_CLOCK_BRANCH_ENA_VOTE
  data.set &access_mode:0x151008 %long 0xFFFFFFFF ; Enable all votable clocks in GCC_RPM_CLOCK_BRANCH_ENA_VOTE_1
  data.set &access_mode:0x151010 %long 0xFFFFFFFF ; Enable all votable clocks in GCC_RPM_CLOCK_BRANCH_ENA_VOTE_2
  data.set &access_mode:0x151018 %long 0xFFFFFFFF ; Enable all votable clocks in GCC_RPM_CLOCK_BRANCH_ENA_VOTE_3
  data.set &access_mode:0x15A000 %long 0xFFFFFFFF ; Enable all votable clocks in GCC_SPARE1_CLOCK_BRANCH_ENA_VOTE
  data.set &access_mode:0x15A008 %long 0xFFFFFFFF ; Enable all votable clocks in GCC_SPARE1_CLOCK_BRANCH_ENA_VOTE_1
  data.set &access_mode:0x15A010 %long 0xFFFFFFFF ; Enable all votable clocks in GCC_SPARE1_CLOCK_BRANCH_ENA_VOTE_2
  data.set &access_mode:0x15A018 %long 0xFFFFFFFF ; Enable all votable clocks in GCC_SPARE1_CLOCK_BRANCH_ENA_VOTE_3
  data.set &access_mode:0x157000 %long 0xFFFFFFFF ; Enable all votable clocks in GCC_SPARE_CLOCK_BRANCH_ENA_VOTE
  data.set &access_mode:0x157008 %long 0xFFFFFFFF ; Enable all votable clocks in GCC_SPARE_CLOCK_BRANCH_ENA_VOTE_1
  data.set &access_mode:0x157010 %long 0xFFFFFFFF ; Enable all votable clocks in GCC_SPARE_CLOCK_BRANCH_ENA_VOTE_2
  data.set &access_mode:0x157018 %long 0xFFFFFFFF ; Enable all votable clocks in GCC_SPARE_CLOCK_BRANCH_ENA_VOTE_3
  data.set &access_mode:0x169030 %long 0xFFFFFFFF ; Enable all votable clocks in GCC_TME_CLOCK_BRANCH_ENA_VOTE
  data.set &access_mode:0x169038 %long 0xFFFFFFFF ; Enable all votable clocks in GCC_TME_CLOCK_BRANCH_ENA_VOTE_1
  data.set &access_mode:0x169040 %long 0xFFFFFFFF ; Enable all votable clocks in GCC_TME_CLOCK_BRANCH_ENA_VOTE_2
  data.set &access_mode:0x169048 %long 0xFFFFFFFF ; Enable all votable clocks in GCC_TME_CLOCK_BRANCH_ENA_VOTE_3
  data.set &access_mode:0x15B000 %long 0xFFFFFFFF ; Enable all votable clocks in GCC_TURING_DSP_CLOCK_BRANCH_ENA_VOTE
  data.set &access_mode:0x15B008 %long 0xFFFFFFFF ; Enable all votable clocks in GCC_TURING_DSP_CLOCK_BRANCH_ENA_VOTE_1
  data.set &access_mode:0x15B010 %long 0xFFFFFFFF ; Enable all votable clocks in GCC_TURING_DSP_CLOCK_BRANCH_ENA_VOTE_2
  data.set &access_mode:0x15B018 %long 0xFFFFFFFF ; Enable all votable clocks in GCC_TURING_DSP_CLOCK_BRANCH_ENA_VOTE_3
  data.set &access_mode:0x1B1030 %long 0xFFFFFFFF ; Enable all votable clocks in GCC_WPSS_Q6_CLOCK_BRANCH_ENA_VOTE
  data.set &access_mode:0x1B1038 %long 0xFFFFFFFF ; Enable all votable clocks in GCC_WPSS_Q6_CLOCK_BRANCH_ENA_VOTE_1
  data.set &access_mode:0x1B1040 %long 0xFFFFFFFF ; Enable all votable clocks in GCC_WPSS_Q6_CLOCK_BRANCH_ENA_VOTE_2
  data.set &access_mode:0x1B1048 %long 0xFFFFFFFF ; Enable all votable clocks in GCC_WPSS_Q6_CLOCK_BRANCH_ENA_VOTE_3

  per.set.field &access_mode:0x14305C %long 0x1 0x1 ; Enable GCC_AACS_XO_DIV_CBCR
  per.set.field &access_mode:0x182010 %long 0x1 0x1 ; Enable GCC_AGGRE_CNOC_PERIPH_NORTH_AHB_CBCR
  per.set.field &access_mode:0x182014 %long 0x1 0x1 ; Enable GCC_AGGRE_CNOC_PERIPH_SOUTH_AHB_CBCR
  per.set.field &access_mode:0x1822F0 %long 0x1 0x1 ; Enable GCC_AGGRE_CNOC_PERIPH_WEST_AHB_CBCR
  per.set.field &access_mode:0x182008 %long 0x1 0x1 ; Enable GCC_AGGRE_NOC_AHB_CBCR
  per.set.field &access_mode:0x18201C %long 0x1 0x1 ; Enable GCC_AGGRE_NOC_CENTER_AXI_CBCR
  per.set.field &access_mode:0x182034 %long 0x1 0x1 ; Enable GCC_AGGRE_NOC_CENTER_HS_AXI_CBCR
  per.set.field &access_mode:0x182048 %long 0x1 0x1 ; Enable GCC_AGGRE_NOC_EAST_AXI_CBCR
  per.set.field &access_mode:0x18204C %long 0x1 0x1 ; Enable GCC_AGGRE_NOC_EAST_TUNNEL_CBCR
  per.set.field &access_mode:0x189174 %long 0x1 0x1 ; Enable GCC_AGGRE_NOC_IPA_CBCR
  per.set.field &access_mode:0x182060 %long 0x1 0x1 ; Enable GCC_AGGRE_NOC_NORTH_AXI_CBCR
  per.set.field &access_mode:0x1822F4 %long 0x1 0x1 ; Enable GCC_AGGRE_NOC_NORTH_AXI_NORTH_TILE_CBCR
  per.set.field &access_mode:0x182054 %long 0x1 0x1 ; Enable GCC_AGGRE_NOC_NORTH_HS_AXI_CBCR
  per.set.field &access_mode:0x182064 %long 0x1 0x1 ; Enable GCC_AGGRE_NOC_NORTH_TUNNEL_CBCR
  per.set.field &access_mode:0x110064 %long 0x1 0x1 ; Enable GCC_AGGRE_NOC_PCIE_AXI_CBCR
  per.set.field &access_mode:0x182028 %long 0x1 0x1 ; Enable GCC_AGGRE_NOC_QDSS_BAM_CBCR
  per.set.field &access_mode:0x182018 %long 0x1 0x1 ; Enable GCC_AGGRE_NOC_QOSGEN_EXTREF_CBCR
  per.set.field &access_mode:0x182004 %long 0x1 0x1 ; Enable GCC_AGGRE_NOC_SOUTH_AHB_CFG_CBCR
  per.set.field &access_mode:0x182058 %long 0x1 0x1 ; Enable GCC_AGGRE_NOC_SOUTH_AXI_CBCR
  per.set.field &access_mode:0x182050 %long 0x1 0x1 ; Enable GCC_AGGRE_NOC_SOUTH_HS_AXI_CBCR
  per.set.field &access_mode:0x18205C %long 0x1 0x1 ; Enable GCC_AGGRE_NOC_SOUTH_TUNNEL_CBCR
  per.set.field &access_mode:0x182040 %long 0x1 0x1 ; Enable GCC_AGGRE_NOC_WEST_AXI_CBCR
  per.set.field &access_mode:0x182044 %long 0x1 0x1 ; Enable GCC_AGGRE_NOC_WEST_TUNNEL_CBCR
  per.set.field &access_mode:0x1822F8 %long 0x1 0x1 ; Enable GCC_AGGRE_NOC_WEST_TUNNEL_WEST_TILE_CBCR
  per.set.field &access_mode:0x1770E4 %long 0x1 0x1 ; Enable GCC_AGGRE_UFS_PHY_AXI_CBCR
  per.set.field &access_mode:0x13908C %long 0x1 0x1 ; Enable GCC_AGGRE_USB3_PRIM_AXI_CBCR
  per.set.field &access_mode:0x16A004 %long 0x1 0x1 ; Enable GCC_AHB2PHY_0_CBCR
  per.set.field &access_mode:0x11A004 %long 0x1 0x1 ; Enable GCC_AHB2PHY_1_CBCR
  per.set.field &access_mode:0x143008 %long 0x1 0x1 ; Enable GCC_AHB_CONFIG_CBCR
  per.set.field &access_mode:0x110054 %long 0x1 0x1 ; Enable GCC_ANOC_PCIE_PWRCTL_CBCR
  per.set.field &access_mode:0x110048 %long 0x1 0x1 ; Enable GCC_ANOC_PCIE_QOSGEN_EXTREF_CBCR
  per.set.field &access_mode:0x110040 %long 0x1 0x1 ; Enable GCC_ANOC_PCIE_SOUTH_AT_CBCR
  per.set.field &access_mode:0x110044 %long 0x1 0x1 ; Enable GCC_ANOC_PCIE_TSCTR_CBCR
  per.set.field &access_mode:0x13C00C %long 0x1 0x1 ; Enable GCC_AOSS_AT_CBCR
  per.set.field &access_mode:0x13C004 %long 0x1 0x1 ; Enable GCC_AOSS_CNOC_M_AHB_CBCR
  per.set.field &access_mode:0x13C008 %long 0x1 0x1 ; Enable GCC_AOSS_CNOC_S_AHB_CBCR
  per.set.field &access_mode:0x14300C %long 0x1 0x1 ; Enable GCC_AO_PGM_CBCR
  per.set.field &access_mode:0x17A054 %long 0x1 0x1 ; Enable GCC_APC_VS_CBCR
  per.set.field &access_mode:0x148294 %long 0x1 0x1 ; Enable GCC_APSS_QDSS_APB_CBCR
  per.set.field &access_mode:0x148290 %long 0x1 0x1 ; Enable GCC_APSS_QDSS_TSCTR_CBCR
  per.set.field &access_mode:0x143000 %long 0x1 0x1 ; Enable GCC_AT_CBCR
  per.set.field &access_mode:0x138004 %long 0x1 0x1 ; Enable GCC_BOOT_ROM_AHB_CBCR
  per.set.field &access_mode:0x126004 %long 0x1 0x1 ; Enable GCC_CAMERA_AHB_CBCR
  per.set.field &access_mode:0x126010 %long 0x1 0x1 ; Enable GCC_CAMERA_HF_AXI_CBCR
  per.set.field &access_mode:0x126028 %long 0x1 0x1 ; Enable GCC_CAMERA_HF_XO_CBCR
  per.set.field &access_mode:0x12601C %long 0x1 0x1 ; Enable GCC_CAMERA_SF_AXI_CBCR
  per.set.field &access_mode:0x12602C %long 0x1 0x1 ; Enable GCC_CAMERA_SF_XO_CBCR
  per.set.field &access_mode:0x141014 %long 0x1 0x1 ; Enable GCC_CE1_AHB_CBCR
  per.set.field &access_mode:0x141010 %long 0x1 0x1 ; Enable GCC_CE1_AXI_CBCR
  per.set.field &access_mode:0x141004 %long 0x1 0x1 ; Enable GCC_CE1_CBCR
  per.set.field &access_mode:0x11F040 %long 0x1 0x1 ; Enable GCC_CENTER_APB_CBCR
  per.set.field &access_mode:0x17404C %long 0x1 0x1 ; Enable GCC_CFG_NOC_AH2PHY_XO_CBCR
  per.set.field &access_mode:0x174018 %long 0x1 0x1 ; Enable GCC_CFG_NOC_AHB_CBCR
  per.set.field &access_mode:0x174024 %long 0x1 0x1 ; Enable GCC_CFG_NOC_EAST_AHB_CBCR
  per.set.field &access_mode:0x17402C %long 0x1 0x1 ; Enable GCC_CFG_NOC_HF_MMNOC_AHB_CBCR
  per.set.field &access_mode:0x147168 %long 0x1 0x1 ; Enable GCC_CFG_NOC_LPASS_CBCR
  per.set.field &access_mode:0x174020 %long 0x1 0x1 ; Enable GCC_CFG_NOC_NORTH_AHB_CBCR
  per.set.field &access_mode:0x110050 %long 0x1 0x1 ; Enable GCC_CFG_NOC_PCIE_ANOC_AHB_CBCR
  per.set.field &access_mode:0x174030 %long 0x1 0x1 ; Enable GCC_CFG_NOC_SF_MMNOC_AHB_CBCR
  per.set.field &access_mode:0x174028 %long 0x1 0x1 ; Enable GCC_CFG_NOC_SOUTH_AHB_CBCR
  per.set.field &access_mode:0x139088 %long 0x1 0x1 ; Enable GCC_CFG_NOC_USB3_PRIM_AXI_CBCR
  per.set.field &access_mode:0x17401C %long 0x1 0x1 ; Enable GCC_CFG_NOC_WEST_AHB_CBCR
  per.set.field &access_mode:0x122004 %long 0x1 0x1 ; Enable GCC_CM_PHY_REFGEN1_CBCR
  per.set.field &access_mode:0x124004 %long 0x1 0x1 ; Enable GCC_CM_PHY_REFGEN2_CBCR
  per.set.field &access_mode:0x14829C %long 0x1 0x1 ; Enable GCC_CNOC_APSS_QH_CBCR
  per.set.field &access_mode:0x174004 %long 0x1 0x1 ; Enable GCC_CNOC_CENTER_QX_CBCR
  per.set.field &access_mode:0x17400C %long 0x1 0x1 ; Enable GCC_CNOC_NORTH_QX_CBCR
  per.set.field &access_mode:0x110058 %long 0x1 0x1 ; Enable GCC_CNOC_PCIE_SF_AXI_CBCR
  per.set.field &access_mode:0x174054 %long 0x1 0x1 ; Enable GCC_CNOC_PERIPH_CBCR
  per.set.field &access_mode:0x174014 %long 0x1 0x1 ; Enable GCC_CNOC_PERIPH_NORTH_CBCR
  per.set.field &access_mode:0x174010 %long 0x1 0x1 ; Enable GCC_CNOC_PERIPH_SOUTH_CBCR
  per.set.field &access_mode:0x174A00 %long 0x1 0x1 ; Enable GCC_CNOC_PERIPH_WEST_CBCR
  per.set.field &access_mode:0x174034 %long 0x1 0x1 ; Enable GCC_CNOC_QDSS_STM_CBCR
  per.set.field &access_mode:0x174008 %long 0x1 0x1 ; Enable GCC_CNOC_SF_QX_CBCR
  per.set.field &access_mode:0x1748CC %long 0x1 0x1 ; Enable GCC_CNOC_SOUTH_QX_CBCR
  per.set.field &access_mode:0x174058 %long 0x1 0x1 ; Enable GCC_CONFIG_NOC_AT_CBCR
  per.set.field &access_mode:0x14716C %long 0x1 0x1 ; Enable GCC_CONFIG_NOC_LPASS_BOOT_CBCR
  per.set.field &access_mode:0x143004 %long 0x1 0x1 ; Enable GCC_CORE_CBCR
  per.set.field &access_mode:0x148000 %long 0x1 0x1 ; Enable GCC_CPUSS_AHB_CBCR
  per.set.field &access_mode:0x148010 %long 0x1 0x1 ; Enable GCC_CPUSS_AT_CBCR
  per.set.field &access_mode:0x148014 %long 0x1 0x1 ; Enable GCC_CPUSS_CONFIG_NOC_SF_CBCR
  per.set.field &access_mode:0x148004 %long 0x1 0x1 ; Enable GCC_CPUSS_GIC_CBCR
  per.set.field &access_mode:0x14800C %long 0x1 0x1 ; Enable GCC_CPUSS_TRIG_CBCR
  per.set.field &access_mode:0x184004 %long 0x1 0x1 ; Enable GCC_DCC_AHB_CBCR
  per.set.field &access_mode:0x144018 %long 0x1 0x1 ; Enable GCC_DDRSS_AT_CBCR
  per.set.field &access_mode:0x144010 %long 0x1 0x1 ; Enable GCC_DDRSS_CFG_AHB_CBCR
  per.set.field &access_mode:0x14400C %long 0x1 0x1 ; Enable GCC_DDRSS_CONFIG_NOC_SF_CBCR
  per.set.field &access_mode:0x144020 %long 0x1 0x1 ; Enable GCC_DDRSS_GIC_CBCR
  per.set.field &access_mode:0x17115C %long 0x1 0x1 ; Enable GCC_DDRSS_GPU_AXI_CBCR
  per.set.field &access_mode:0x14514C %long 0x1 0x1 ; Enable GCC_DDRSS_LPASS_SHUB_CBCR
  per.set.field &access_mode:0x11C354 %long 0x1 0x1 ; Enable GCC_DDRSS_MMNOC_HF_QX_CBCR
  per.set.field &access_mode:0x11C350 %long 0x1 0x1 ; Enable GCC_DDRSS_MMNOC_SF_CBCR
  per.set.field &access_mode:0x18A290 %long 0x1 0x1 ; Enable GCC_DDRSS_MODEM_CBCR
  per.set.field &access_mode:0x18A28C %long 0x1 0x1 ; Enable GCC_DDRSS_MSS_Q6_AXI_CBCR
  per.set.field &access_mode:0x110074 %long 0x1 0x1 ; Enable GCC_DDRSS_PCIE_SF_QTB_CBCR
  per.set.field &access_mode:0x144024 %long 0x1 0x1 ; Enable GCC_DDRSS_PWRCTL_CBCR
  per.set.field &access_mode:0x144008 %long 0x1 0x1 ; Enable GCC_DDRSS_SNOC_SF_AXI_CBCR
  per.set.field &access_mode:0x1833CC %long 0x1 0x1 ; Enable GCC_DDRSS_TCU_CBCR
  per.set.field &access_mode:0x144004 %long 0x1 0x1 ; Enable GCC_DDRSS_TURING_Q6_AXI_CBCR
  per.set.field &access_mode:0x14428C %long 0x1 0x1 ; Enable GCC_DDRSS_WPSS_AXI_CBCR
  per.set.field &access_mode:0x162004 %long 0x1 0x1 ; Enable GCC_DEBUG_CBCR
  per.set.field &access_mode:0x127004 %long 0x1 0x1 ; Enable GCC_DISP_AHB_CBCR
  per.set.field &access_mode:0x12700C %long 0x1 0x1 ; Enable GCC_DISP_HF_AXI_CBCR
  per.set.field &access_mode:0x127018 %long 0x1 0x1 ; Enable GCC_DISP_XO_CBCR
  per.set.field &access_mode:0x11F050 %long 0x1 0x1 ; Enable GCC_EAST_APB_CBCR
  per.set.field &access_mode:0x162008 %long 0x1 0x1 ; Enable GCC_FRQ_MEASURE_REF_CBCR
  per.set.field &access_mode:0x18B004 %long 0x1 0x1 ; Enable GCC_GLM_AHB_CBCR
  per.set.field &access_mode:0x18B008 %long 0x1 0x1 ; Enable GCC_GLM_CBCR
  per.set.field &access_mode:0x18B00C %long 0x1 0x1 ; Enable GCC_GLM_XO_CBCR
  per.set.field &access_mode:0x164000 %long 0x1 0x1 ; Enable GCC_GP1_CBCR
  per.set.field &access_mode:0x165000 %long 0x1 0x1 ; Enable GCC_GP2_CBCR
  per.set.field &access_mode:0x166000 %long 0x1 0x1 ; Enable GCC_GP3_CBCR
  per.set.field &access_mode:0x17100C %long 0x1 0x1 ; Enable GCC_GPU_AT_CBCR
  per.set.field &access_mode:0x171004 %long 0x1 0x1 ; Enable GCC_GPU_CFG_AHB_CBCR
  per.set.field &access_mode:0x171010 %long 0x1 0x1 ; Enable GCC_GPU_MEMNOC_GFX_CBCR
  per.set.field &access_mode:0x171018 %long 0x1 0x1 ; Enable GCC_GPU_SNOC_DVM_GFX_CBCR
  per.set.field &access_mode:0x171014 %long 0x1 0x1 ; Enable GCC_GPU_TRIG_CBCR
  per.set.field &access_mode:0x17A050 %long 0x1 0x1 ; Enable GCC_GPU_VS_CBCR
  per.set.field &access_mode:0x11B010 %long 0x1 0x1 ; Enable GCC_IMEM_CFG_AHB_CBCR
  per.set.field &access_mode:0x11B004 %long 0x1 0x1 ; Enable GCC_IMEM_CFG_QX_CBCR
  per.set.field &access_mode:0x189018 %long 0x1 0x1 ; Enable GCC_IPA_2X_CBCR
  per.set.field &access_mode:0x189030 %long 0x1 0x1 ; Enable GCC_IPA_AHB_CBCR
  per.set.field &access_mode:0x189038 %long 0x1 0x1 ; Enable GCC_IPA_APB_CBCR
  per.set.field &access_mode:0x18903C %long 0x1 0x1 ; Enable GCC_IPA_AT_CBCR
  per.set.field &access_mode:0x189024 %long 0x1 0x1 ; Enable GCC_IPA_CBCR
  per.set.field &access_mode:0x189034 %long 0x1 0x1 ; Enable GCC_IPA_XO_CBCR
  per.set.field &access_mode:0x125008 %long 0x1 0x1 ; Enable GCC_IPCC_AHB_CBCR
  per.set.field &access_mode:0x125004 %long 0x1 0x1 ; Enable GCC_IPCC_CORE_CBCR
  per.set.field &access_mode:0x147028 %long 0x1 0x1 ; Enable GCC_LPASS_AGGRE_NOC_DDRSS_SHUB_CBCR
  per.set.field &access_mode:0x147018 %long 0x1 0x1 ; Enable GCC_LPASS_AGGRE_NOC_MPU_CLIENT_DDRSS_SHUB_CBCR
  per.set.field &access_mode:0x147014 %long 0x1 0x1 ; Enable GCC_LPASS_AON_NOC_DDRSS_SHUB_CBCR
  per.set.field &access_mode:0x14700C %long 0x1 0x1 ; Enable GCC_LPASS_AT_CBCR
  per.set.field &access_mode:0x199040 %long 0x1 0x1 ; Enable GCC_LPASS_AUDIO_QTB_CBCR
  per.set.field &access_mode:0x147010 %long 0x1 0x1 ; Enable GCC_LPASS_AXIS2_CBCR
  per.set.field &access_mode:0x147000 %long 0x1 0x1 ; Enable GCC_LPASS_CFG_NOC_SWAY_CBCR
  per.set.field &access_mode:0x14701C %long 0x1 0x1 ; Enable GCC_LPASS_HW_AF_NOC_DDRSS_SHUB_CBCR
  per.set.field &access_mode:0x19905C %long 0x1 0x1 ; Enable GCC_LPASS_PWRCTL_CBCR
  per.set.field &access_mode:0x199050 %long 0x1 0x1 ; Enable GCC_LPASS_QDSS_TSCTR_CBCR
  per.set.field &access_mode:0x19904C %long 0x1 0x1 ; Enable GCC_LPASS_QOSGEN_EXTREF_CBCR
  per.set.field &access_mode:0x19903C %long 0x1 0x1 ; Enable GCC_LPASS_QTB_AHB_CBCR
  per.set.field &access_mode:0x199054 %long 0x1 0x1 ; Enable GCC_LPASS_QTB_AT_CBCR
  per.set.field &access_mode:0x147008 %long 0x1 0x1 ; Enable GCC_LPASS_TRIG_CBCR
  per.set.field &access_mode:0x199058 %long 0x1 0x1 ; Enable GCC_LPASS_XO_CBCR
  per.set.field &access_mode:0x17A058 %long 0x1 0x1 ; Enable GCC_MDSS_VS_0_CBCR
  per.set.field &access_mode:0x17A05C %long 0x1 0x1 ; Enable GCC_MDSS_VS_1_CBCR
  per.set.field &access_mode:0x144014 %long 0x1 0x1 ; Enable GCC_MEMNOC_CBCR
  per.set.field &access_mode:0x13D000 %long 0x1 0x1 ; Enable GCC_MEMRED_P2S_CBCR
  per.set.field &access_mode:0x11C044 %long 0x1 0x1 ; Enable GCC_MMNOC_HF_AHB_CFG_CBCR
  per.set.field &access_mode:0x11F054 %long 0x1 0x1 ; Enable GCC_MMNOC_HF_APB_CBCR
  per.set.field &access_mode:0x11C040 %long 0x1 0x1 ; Enable GCC_MMNOC_HF_AT_CBCR
  per.set.field &access_mode:0x11C05C %long 0x1 0x1 ; Enable GCC_MMNOC_HF_PWRCTL_CBCR
  per.set.field &access_mode:0x11C060 %long 0x1 0x1 ; Enable GCC_MMNOC_HF_QOSGEN_EXTREF_CBCR
  per.set.field &access_mode:0x11C050 %long 0x1 0x1 ; Enable GCC_MMNOC_HF_QX_CBCR
  per.set.field &access_mode:0x11C04C %long 0x1 0x1 ; Enable GCC_MMNOC_HF_TSCTR_CBCR
  per.set.field &access_mode:0x11C068 %long 0x1 0x1 ; Enable GCC_MMNOC_SF_AHB_CFG_CBCR
  per.set.field &access_mode:0x11F058 %long 0x1 0x1 ; Enable GCC_MMNOC_SF_APB_CBCR
  per.set.field &access_mode:0x11C064 %long 0x1 0x1 ; Enable GCC_MMNOC_SF_AT_CBCR
  per.set.field &access_mode:0x11C074 %long 0x1 0x1 ; Enable GCC_MMNOC_SF_CBCR
  per.set.field &access_mode:0x11C080 %long 0x1 0x1 ; Enable GCC_MMNOC_SF_PWRCTL_CBCR
  per.set.field &access_mode:0x11C084 %long 0x1 0x1 ; Enable GCC_MMNOC_SF_QOSGEN_EXTREF_CBCR
  per.set.field &access_mode:0x11C070 %long 0x1 0x1 ; Enable GCC_MMNOC_SF_TSCTR_CBCR
  per.set.field &access_mode:0x13B004 %long 0x1 0x1 ; Enable GCC_MMSS_AT_CBCR
  per.set.field &access_mode:0x13B008 %long 0x1 0x1 ; Enable GCC_MMSS_QMIP_CORE_CBCR
  per.set.field &access_mode:0x13B028 %long 0x1 0x1 ; Enable GCC_MMSS_QM_AHB_CBCR
  per.set.field &access_mode:0x13B00C %long 0x1 0x1 ; Enable GCC_MMSS_TRIG_CBCR
  per.set.field &access_mode:0x18301C %long 0x1 0x1 ; Enable GCC_MMU_TCU_CBCR
  per.set.field &access_mode:0x18A014 %long 0x1 0x1 ; Enable GCC_MSS_AT_CBCR
  per.set.field &access_mode:0x14D000 %long 0x1 0x1 ; Enable GCC_MSS_AXIS2_CBCR
  per.set.field &access_mode:0x18A000 %long 0x1 0x1 ; Enable GCC_MSS_CFG_AHB_CBCR
  per.set.field &access_mode:0x18A00C %long 0x1 0x1 ; Enable GCC_MSS_OFFLINE_AXI_CBCR
  per.set.field &access_mode:0x18A01C %long 0x1 0x1 ; Enable GCC_MSS_Q6_MEMNOC_AXI_CBCR
  per.set.field &access_mode:0x18A018 %long 0x1 0x1 ; Enable GCC_MSS_SNOC_AXI_CBCR
  per.set.field &access_mode:0x18A010 %long 0x1 0x1 ; Enable GCC_MSS_TRIG_CBCR
  per.set.field &access_mode:0x17A04C %long 0x1 0x1 ; Enable GCC_MSS_VS_CBCR
  per.set.field &access_mode:0x115004 %long 0x1 0x1 ; Enable GCC_NAV_AXI_CBCR
  per.set.field &access_mode:0x149004 %long 0x1 0x1 ; Enable GCC_NOC_BUS_TIMEOUT_EXTREF_CBCR
  per.set.field &access_mode:0x174048 %long 0x1 0x1 ; Enable GCC_NOC_CENTER_DCD_XO_CBCR
  per.set.field &access_mode:0x17403C %long 0x1 0x1 ; Enable GCC_NOC_EAST_DCD_XO_CBCR
  per.set.field &access_mode:0x145148 %long 0x1 0x1 ; Enable GCC_NOC_LPASS_DCD_XO_CBCR
  per.set.field &access_mode:0x174050 %long 0x1 0x1 ; Enable GCC_NOC_MMNOC_HF_CNOC_DCD_XO_CBCR
  per.set.field &access_mode:0x11C048 %long 0x1 0x1 ; Enable GCC_NOC_MMNOC_HF_DCD_XO_CBCR
  per.set.field &access_mode:0x174A08 %long 0x1 0x1 ; Enable GCC_NOC_MMNOC_SF_CNOC_DCD_XO_CBCR
  per.set.field &access_mode:0x11C06C %long 0x1 0x1 ; Enable GCC_NOC_MMNOC_SF_DCD_XO_CBCR
  per.set.field &access_mode:0x174040 %long 0x1 0x1 ; Enable GCC_NOC_NORTH_DCD_XO_CBCR
  per.set.field &access_mode:0x11004C %long 0x1 0x1 ; Enable GCC_NOC_PCIE_NORTH_DCD_XO_CBCR
  per.set.field &access_mode:0x174044 %long 0x1 0x1 ; Enable GCC_NOC_SOUTH_DCD_XO_CBCR
  per.set.field &access_mode:0x174038 %long 0x1 0x1 ; Enable GCC_NOC_WEST_DCD_XO_CBCR
  per.set.field &access_mode:0x11F044 %long 0x1 0x1 ; Enable GCC_NORTH_APB_CBCR
  per.set.field &access_mode:0x11F020 %long 0x1 0x1 ; Enable GCC_NORTH_AT_CBCR
  per.set.field &access_mode:0x19D050 %long 0x1 0x1 ; Enable GCC_NSP_QDSS_TSCTR_CBCR
  per.set.field &access_mode:0x19D04C %long 0x1 0x1 ; Enable GCC_NSP_QOSGEN_EXTREF_CBCR
  per.set.field &access_mode:0x16B03C %long 0x1 0x1 ; Enable GCC_PCIE_0_AUX_CBCR
  per.set.field &access_mode:0x16B038 %long 0x1 0x1 ; Enable GCC_PCIE_0_CFG_AHB_CBCR
  per.set.field &access_mode:0x16B02C %long 0x1 0x1 ; Enable GCC_PCIE_0_MSTR_AXI_CBCR
  per.set.field &access_mode:0x16B054 %long 0x1 0x1 ; Enable GCC_PCIE_0_PHY_RCHNG_CBCR
  per.set.field &access_mode:0x16B048 %long 0x1 0x1 ; Enable GCC_PCIE_0_PIPE_CBCR
  per.set.field &access_mode:0x16B098 %long 0x1 0x1 ; Enable GCC_PCIE_0_PIPE_DIV2_CBCR
  per.set.field &access_mode:0x16B020 %long 0x1 0x1 ; Enable GCC_PCIE_0_SLV_AXI_CBCR
  per.set.field &access_mode:0x16B01C %long 0x1 0x1 ; Enable GCC_PCIE_0_SLV_Q2A_AXI_CBCR
  per.set.field &access_mode:0x111004 %long 0x1 0x1 ; Enable GCC_PCIE_RSCC_CFG_AHB_CBCR
  per.set.field &access_mode:0x111008 %long 0x1 0x1 ; Enable GCC_PCIE_RSCC_XO_CBCR
  per.set.field &access_mode:0x13300C %long 0x1 0x1 ; Enable GCC_PDM2_CBCR
  per.set.field &access_mode:0x133004 %long 0x1 0x1 ; Enable GCC_PDM_AHB_CBCR
  per.set.field &access_mode:0x133008 %long 0x1 0x1 ; Enable GCC_PDM_XO4_CBCR
  per.set.field &access_mode:0x11F024 %long 0x1 0x1 ; Enable GCC_PHY_AT_CBCR
  per.set.field &access_mode:0x162014 %long 0x1 0x1 ; Enable GCC_PLL_TEST_CBCR
  per.set.field &access_mode:0x136004 %long 0x1 0x1 ; Enable GCC_PMU_AHB_CBCR
  per.set.field &access_mode:0x136008 %long 0x1 0x1 ; Enable GCC_PMU_CORE_CBCR
  per.set.field &access_mode:0x198004 %long 0x1 0x1 ; Enable GCC_PRNG_AHB_CBCR
  per.set.field &access_mode:0x11F00C %long 0x1 0x1 ; Enable GCC_QDSS_CENTER_AT_CBCR
  per.set.field &access_mode:0x11F008 %long 0x1 0x1 ; Enable GCC_QDSS_CFG_AHB_CBCR
  per.set.field &access_mode:0x11F004 %long 0x1 0x1 ; Enable GCC_QDSS_DAP_AHB_CBCR
  per.set.field &access_mode:0x11F03C %long 0x1 0x1 ; Enable GCC_QDSS_DAP_CBCR
  per.set.field &access_mode:0x11F028 %long 0x1 0x1 ; Enable GCC_QDSS_ETR_DDR_CBCR
  per.set.field &access_mode:0x139094 %long 0x1 0x1 ; Enable GCC_QDSS_ETR_USB_CBCR
  per.set.field &access_mode:0x11F02C %long 0x1 0x1 ; Enable GCC_QDSS_STM_CBCR
  per.set.field &access_mode:0x11F030 %long 0x1 0x1 ; Enable GCC_QDSS_TRACECLKIN_CBCR
  per.set.field &access_mode:0x11F038 %long 0x1 0x1 ; Enable GCC_QDSS_TRIG_CBCR
  per.set.field &access_mode:0x11F034 %long 0x1 0x1 ; Enable GCC_QDSS_TSCTR_CBCR
  per.set.field &access_mode:0x139090 %long 0x1 0x1 ; Enable GCC_QDSS_USB_PRIM_CBCR
  per.set.field &access_mode:0x11F05C %long 0x1 0x1 ; Enable GCC_QDSS_XO_CBCR
  per.set.field &access_mode:0x18200C %long 0x1 0x1 ; Enable GCC_QMIP_AGGRE_NOC_AHB_CBCR
  per.set.field &access_mode:0x126008 %long 0x1 0x1 ; Enable GCC_QMIP_CAMERA_NRT_AHB_CBCR
  per.set.field &access_mode:0x12600C %long 0x1 0x1 ; Enable GCC_QMIP_CAMERA_RT_AHB_CBCR
  per.set.field &access_mode:0x148008 %long 0x1 0x1 ; Enable GCC_QMIP_CPUSS_GIC_AHB_CBCR
  per.set.field &access_mode:0x127008 %long 0x1 0x1 ; Enable GCC_QMIP_DISP_AHB_CBCR
  per.set.field &access_mode:0x171008 %long 0x1 0x1 ; Enable GCC_QMIP_GPU_AHB_CBCR
  per.set.field &access_mode:0x147004 %long 0x1 0x1 ; Enable GCC_QMIP_LPASS_QTB_AHB_CBCR
  per.set.field &access_mode:0x18A004 %long 0x1 0x1 ; Enable GCC_QMIP_MSS_OFFLINE_CFG_AHB_CBCR
  per.set.field &access_mode:0x18A008 %long 0x1 0x1 ; Enable GCC_QMIP_MSS_Q6_CFG_AHB_CBCR
  per.set.field &access_mode:0x16B018 %long 0x1 0x1 ; Enable GCC_QMIP_PCIE_AHB_CBCR
  per.set.field &access_mode:0x145010 %long 0x1 0x1 ; Enable GCC_QMIP_TURING_NSP_AHB_CBCR
  per.set.field &access_mode:0x132008 %long 0x1 0x1 ; Enable GCC_QMIP_VIDEO_CVP_AHB_CBCR
  per.set.field &access_mode:0x132014 %long 0x1 0x1 ; Enable GCC_QMIP_VIDEO_CV_CPU_AHB_CBCR
  per.set.field &access_mode:0x13200C %long 0x1 0x1 ; Enable GCC_QMIP_VIDEO_VCODEC_AHB_CBCR
  per.set.field &access_mode:0x132010 %long 0x1 0x1 ; Enable GCC_QMIP_VIDEO_V_CPU_AHB_CBCR
  per.set.field &access_mode:0x14B004 %long 0x1 0x1 ; Enable GCC_QSPI_CNOC_PERIPH_AHB_CBCR
  per.set.field &access_mode:0x14B008 %long 0x1 0x1 ; Enable GCC_QSPI_CORE_CBCR
  per.set.field &access_mode:0x123018 %long 0x1 0x1 ; Enable GCC_QUPV3_WRAP0_CORE_2X_CBCR
  per.set.field &access_mode:0x123008 %long 0x1 0x1 ; Enable GCC_QUPV3_WRAP0_CORE_CBCR
  per.set.field &access_mode:0x11889C %long 0x1 0x1 ; Enable GCC_QUPV3_WRAP0_QSPI_REF_CBCR
  per.set.field &access_mode:0x118004 %long 0x1 0x1 ; Enable GCC_QUPV3_WRAP0_S0_CBCR
  per.set.field &access_mode:0x11813C %long 0x1 0x1 ; Enable GCC_QUPV3_WRAP0_S1_CBCR
  per.set.field &access_mode:0x118274 %long 0x1 0x1 ; Enable GCC_QUPV3_WRAP0_S2_CBCR
  per.set.field &access_mode:0x118284 %long 0x1 0x1 ; Enable GCC_QUPV3_WRAP0_S3_CBCR
  per.set.field &access_mode:0x1183BC %long 0x1 0x1 ; Enable GCC_QUPV3_WRAP0_S4_CBCR
  per.set.field &access_mode:0x1184F4 %long 0x1 0x1 ; Enable GCC_QUPV3_WRAP0_S5_CBCR
  per.set.field &access_mode:0x11862C %long 0x1 0x1 ; Enable GCC_QUPV3_WRAP0_S6_CBCR
  per.set.field &access_mode:0x118764 %long 0x1 0x1 ; Enable GCC_QUPV3_WRAP0_S7_CBCR
  per.set.field &access_mode:0x123168 %long 0x1 0x1 ; Enable GCC_QUPV3_WRAP1_CORE_2X_CBCR
  per.set.field &access_mode:0x123158 %long 0x1 0x1 ; Enable GCC_QUPV3_WRAP1_CORE_CBCR
  per.set.field &access_mode:0x11E9CC %long 0x1 0x1 ; Enable GCC_QUPV3_WRAP1_IBI_CTRL_2_CBCR
  per.set.field &access_mode:0x11E9D0 %long 0x1 0x1 ; Enable GCC_QUPV3_WRAP1_IBI_CTRL_3_CBCR
  per.set.field &access_mode:0x11E004 %long 0x1 0x1 ; Enable GCC_QUPV3_WRAP1_S0_CBCR
  per.set.field &access_mode:0x11E13C %long 0x1 0x1 ; Enable GCC_QUPV3_WRAP1_S1_CBCR
  per.set.field &access_mode:0x11E274 %long 0x1 0x1 ; Enable GCC_QUPV3_WRAP1_S2_CBCR
  per.set.field &access_mode:0x11E3AC %long 0x1 0x1 ; Enable GCC_QUPV3_WRAP1_S3_CBCR
  per.set.field &access_mode:0x11E4E4 %long 0x1 0x1 ; Enable GCC_QUPV3_WRAP1_S4_CBCR
  per.set.field &access_mode:0x11E61C %long 0x1 0x1 ; Enable GCC_QUPV3_WRAP1_S5_CBCR
  per.set.field &access_mode:0x11E754 %long 0x1 0x1 ; Enable GCC_QUPV3_WRAP1_S6_CBCR
  per.set.field &access_mode:0x11E88C %long 0x1 0x1 ; Enable GCC_QUPV3_WRAP1_S7_CBCR
  per.set.field &access_mode:0x123000 %long 0x1 0x1 ; Enable GCC_QUPV3_WRAP_0_M_AHB_CBCR
  per.set.field &access_mode:0x123004 %long 0x1 0x1 ; Enable GCC_QUPV3_WRAP_0_S_AHB_CBCR
  per.set.field &access_mode:0x11E9C4 %long 0x1 0x1 ; Enable GCC_QUPV3_WRAP_1_IBI_2_AHB_CBCR
  per.set.field &access_mode:0x11E9C8 %long 0x1 0x1 ; Enable GCC_QUPV3_WRAP_1_IBI_3_AHB_CBCR
  per.set.field &access_mode:0x123150 %long 0x1 0x1 ; Enable GCC_QUPV3_WRAP_1_M_AHB_CBCR
  per.set.field &access_mode:0x123154 %long 0x1 0x1 ; Enable GCC_QUPV3_WRAP_1_S_AHB_CBCR
  per.set.field &access_mode:0x14E008 %long 0x1 0x1 ; Enable GCC_RBCPR_CX_AHB_CBCR
  per.set.field &access_mode:0x14E004 %long 0x1 0x1 ; Enable GCC_RBCPR_CX_CBCR
  per.set.field &access_mode:0x154008 %long 0x1 0x1 ; Enable GCC_RBCPR_HMX_AHB_CBCR
  per.set.field &access_mode:0x154004 %long 0x1 0x1 ; Enable GCC_RBCPR_HMX_CBCR
  per.set.field &access_mode:0x120008 %long 0x1 0x1 ; Enable GCC_RBCPR_MMCX_AHB_CBCR
  per.set.field &access_mode:0x120004 %long 0x1 0x1 ; Enable GCC_RBCPR_MMCX_CBCR
  per.set.field &access_mode:0x11D008 %long 0x1 0x1 ; Enable GCC_RBCPR_MXA_AHB_CBCR
  per.set.field &access_mode:0x11D004 %long 0x1 0x1 ; Enable GCC_RBCPR_MXA_CBCR
  per.set.field &access_mode:0x14F008 %long 0x1 0x1 ; Enable GCC_RBCPR_MXC_AHB_CBCR
  per.set.field &access_mode:0x14F004 %long 0x1 0x1 ; Enable GCC_RBCPR_MXC_CBCR
  per.set.field &access_mode:0x11D02C %long 0x1 0x1 ; Enable GCC_RBCPR_NSP_AHB_CBCR
  per.set.field &access_mode:0x11D028 %long 0x1 0x1 ; Enable GCC_RBCPR_NSP_CBCR
  per.set.field &access_mode:0x146028 %long 0x1 0x1 ; Enable GCC_RDPM_CB_CBCR
  per.set.field &access_mode:0x14601C %long 0x1 0x1 ; Enable GCC_RDPM_CX_AHB_CBCR
  per.set.field &access_mode:0x146004 %long 0x1 0x1 ; Enable GCC_RDPM_CX_CBCR
  per.set.field &access_mode:0x146008 %long 0x1 0x1 ; Enable GCC_RDPM_CX_DRAGONLINK_CBCR
  per.set.field &access_mode:0x146020 %long 0x1 0x1 ; Enable GCC_RDPM_MXA_AHB_CBCR
  per.set.field &access_mode:0x14600C %long 0x1 0x1 ; Enable GCC_RDPM_MXA_CBCR
  per.set.field &access_mode:0x146010 %long 0x1 0x1 ; Enable GCC_RDPM_MXA_DRAGONLINK_CBCR
  per.set.field &access_mode:0x146024 %long 0x1 0x1 ; Enable GCC_RDPM_MXC_AHB_CBCR
  per.set.field &access_mode:0x146014 %long 0x1 0x1 ; Enable GCC_RDPM_MXC_CBCR
  per.set.field &access_mode:0x146018 %long 0x1 0x1 ; Enable GCC_RDPM_MXC_DRAGONLINK_CBCR
  per.set.field &access_mode:0x114010 %long 0x1 0x1 ; Enable GCC_SDCC2_AHB_CBCR
  per.set.field &access_mode:0x114004 %long 0x1 0x1 ; Enable GCC_SDCC2_APPS_CBCR
  per.set.field &access_mode:0x114014 %long 0x1 0x1 ; Enable GCC_SDCC2_AT_CBCR
  per.set.field &access_mode:0x14401C %long 0x1 0x1 ; Enable GCC_SHRM_CBCR
  per.set.field &access_mode:0x14301C %long 0x1 0x1 ; Enable GCC_SLEEP_CBCR
  per.set.field &access_mode:0x11F048 %long 0x1 0x1 ; Enable GCC_SOUTH_APB_CBCR
  per.set.field &access_mode:0x11F018 %long 0x1 0x1 ; Enable GCC_SOUTH_AT_CBCR
  per.set.field &access_mode:0x140010 %long 0x1 0x1 ; Enable GCC_SPDM_DEBUG_CY_CBCR
  per.set.field &access_mode:0x140004 %long 0x1 0x1 ; Enable GCC_SPDM_FF_CBCR
  per.set.field &access_mode:0x140008 %long 0x1 0x1 ; Enable GCC_SPDM_MEMNOC_CY_CBCR
  per.set.field &access_mode:0x140014 %long 0x1 0x1 ; Enable GCC_SPDM_PNOC_CY_CBCR
  per.set.field &access_mode:0x14000C %long 0x1 0x1 ; Enable GCC_SPDM_SNOC_CY_CBCR
  per.set.field &access_mode:0x176014 %long 0x1 0x1 ; Enable GCC_SYS_NOC_AHB_CFG_CBCR
  per.set.field &access_mode:0x176018 %long 0x1 0x1 ; Enable GCC_SYS_NOC_AT_CBCR
  per.set.field &access_mode:0x176004 %long 0x1 0x1 ; Enable GCC_SYS_NOC_AXI_CBCR
  per.set.field &access_mode:0x148298 %long 0x1 0x1 ; Enable GCC_SYS_NOC_CPUSS_AHB_CBCR
  per.set.field &access_mode:0x115008 %long 0x1 0x1 ; Enable GCC_SYS_NOC_NAV_QX_CBCR
  per.set.field &access_mode:0x17601C %long 0x1 0x1 ; Enable GCC_SYS_NOC_QOSGEN_EXTREF_CBCR
  per.set.field &access_mode:0x176008 %long 0x1 0x1 ; Enable GCC_SYS_NOC_SF_AXI_CBCR
  per.set.field &access_mode:0x134020 %long 0x1 0x1 ; Enable GCC_SYS_NOC_TME_QXM_CBCR
  per.set.field &access_mode:0x137008 %long 0x1 0x1 ; Enable GCC_TCSR_ACC_SERIAL_CBCR
  per.set.field &access_mode:0x137004 %long 0x1 0x1 ; Enable GCC_TCSR_AHB_CBCR
  per.set.field &access_mode:0x110070 %long 0x1 0x1 ; Enable GCC_TCU_ANOC_PCIE_QTB_CBCR
  per.set.field &access_mode:0x183158 %long 0x1 0x1 ; Enable GCC_TCU_ANOC_QTB1_CBCR
  per.set.field &access_mode:0x18315C %long 0x1 0x1 ; Enable GCC_TCU_ANOC_QTB2_CBCR
  per.set.field &access_mode:0x183018 %long 0x1 0x1 ; Enable GCC_TCU_CFG_QX_CBCR
  per.set.field &access_mode:0x199060 %long 0x1 0x1 ; Enable GCC_TCU_LPASS_AUDIO_QTB_CBCR
  per.set.field &access_mode:0x183164 %long 0x1 0x1 ; Enable GCC_TCU_MMNOC_QTB_HF01_CBCR
  per.set.field &access_mode:0x183168 %long 0x1 0x1 ; Enable GCC_TCU_MMNOC_QTB_HF23_CBCR
  per.set.field &access_mode:0x183160 %long 0x1 0x1 ; Enable GCC_TCU_MMNOC_QTB_SF_CBCR
  per.set.field &access_mode:0x19D060 %long 0x1 0x1 ; Enable GCC_TCU_TURING_Q6_QTB0_CBCR
  per.set.field &access_mode:0x121000 %long 0x1 0x1 ; Enable GCC_TIC_CBCR
  per.set.field &access_mode:0x121004 %long 0x1 0x1 ; Enable GCC_TIC_CFG_QX_CBCR
  per.set.field &access_mode:0x13A004 %long 0x1 0x1 ; Enable GCC_TLMM_AHB_CBCR
  per.set.field &access_mode:0x13A008 %long 0x1 0x1 ; Enable GCC_TLMM_CBCR
  per.set.field &access_mode:0x134004 %long 0x1 0x1 ; Enable GCC_TME_AHB_CBCR
  per.set.field &access_mode:0x13401C %long 0x1 0x1 ; Enable GCC_TME_AT_CBCR
  per.set.field &access_mode:0x134008 %long 0x1 0x1 ; Enable GCC_TME_BOOT_ROM_AHB_CBCR
  per.set.field &access_mode:0x13400C %long 0x1 0x1 ; Enable GCC_TME_SNOC_QXM_CBCR
  per.set.field &access_mode:0x134018 %long 0x1 0x1 ; Enable GCC_TME_TRIG_CBCR
  per.set.field &access_mode:0x14500C %long 0x1 0x1 ; Enable GCC_TURING_AT_CBCR
  per.set.field &access_mode:0x145008 %long 0x1 0x1 ; Enable GCC_TURING_CFG_AHB_CBCR
  per.set.field &access_mode:0x145000 %long 0x1 0x1 ; Enable GCC_TURING_MMNOC_SF_CBCR
  per.set.field &access_mode:0x19D048 %long 0x1 0x1 ; Enable GCC_TURING_NSP_AHB_CBCR
  per.set.field &access_mode:0x19D05C %long 0x1 0x1 ; Enable GCC_TURING_PWRCTL_CBCR
  per.set.field &access_mode:0x145004 %long 0x1 0x1 ; Enable GCC_TURING_Q6_AXI_CBCR
  per.set.field &access_mode:0x19D03C %long 0x1 0x1 ; Enable GCC_TURING_Q6_QTB0_CBCR
  per.set.field &access_mode:0x19D054 %long 0x1 0x1 ; Enable GCC_TURING_QTB_AT_CBCR
  per.set.field &access_mode:0x145014 %long 0x1 0x1 ; Enable GCC_TURING_TRIG_CBCR
  per.set.field &access_mode:0x19D058 %long 0x1 0x1 ; Enable GCC_TURING_XO_CBCR
  per.set.field &access_mode:0x1770D0 %long 0x1 0x1 ; Enable GCC_UFS_AT_CBCR
  per.set.field &access_mode:0x177024 %long 0x1 0x1 ; Enable GCC_UFS_PHY_AHB_CBCR
  per.set.field &access_mode:0x177018 %long 0x1 0x1 ; Enable GCC_UFS_PHY_AXI_CBCR
  per.set.field &access_mode:0x177074 %long 0x1 0x1 ; Enable GCC_UFS_PHY_ICE_CORE_CBCR
  per.set.field &access_mode:0x1770B0 %long 0x1 0x1 ; Enable GCC_UFS_PHY_PHY_AUX_CBCR
  per.set.field &access_mode:0x17702C %long 0x1 0x1 ; Enable GCC_UFS_PHY_RX_SYMBOL_0_CBCR
  per.set.field &access_mode:0x1770CC %long 0x1 0x1 ; Enable GCC_UFS_PHY_RX_SYMBOL_1_CBCR
  per.set.field &access_mode:0x177028 %long 0x1 0x1 ; Enable GCC_UFS_PHY_TX_SYMBOL_0_CBCR
  per.set.field &access_mode:0x177068 %long 0x1 0x1 ; Enable GCC_UFS_PHY_UNIPRO_CORE_CBCR
  per.set.field &access_mode:0x139018 %long 0x1 0x1 ; Enable GCC_USB30_PRIM_MASTER_CBCR
  per.set.field &access_mode:0x139028 %long 0x1 0x1 ; Enable GCC_USB30_PRIM_MOCK_UTMI_CBCR
  per.set.field &access_mode:0x139024 %long 0x1 0x1 ; Enable GCC_USB30_PRIM_SLEEP_CBCR
  per.set.field &access_mode:0x139060 %long 0x1 0x1 ; Enable GCC_USB3_PRIM_PHY_AUX_CBCR
  per.set.field &access_mode:0x139064 %long 0x1 0x1 ; Enable GCC_USB3_PRIM_PHY_COM_AUX_CBCR
  per.set.field &access_mode:0x139068 %long 0x1 0x1 ; Enable GCC_USB3_PRIM_PHY_PIPE_CBCR
  per.set.field &access_mode:0x17A010 %long 0x1 0x1 ; Enable GCC_VDDA_VS_CBCR
  per.set.field &access_mode:0x17A008 %long 0x1 0x1 ; Enable GCC_VDDCX_VS_CBCR
  per.set.field &access_mode:0x17A004 %long 0x1 0x1 ; Enable GCC_VDDMXC_VS_CBCR
  per.set.field &access_mode:0x17A00C %long 0x1 0x1 ; Enable GCC_VDDMX_VS_CBCR
  per.set.field &access_mode:0x132004 %long 0x1 0x1 ; Enable GCC_VIDEO_AHB_CBCR
  per.set.field &access_mode:0x132018 %long 0x1 0x1 ; Enable GCC_VIDEO_AXI0_CBCR
  per.set.field &access_mode:0x132024 %long 0x1 0x1 ; Enable GCC_VIDEO_AXI1_CBCR
  per.set.field &access_mode:0x132030 %long 0x1 0x1 ; Enable GCC_VIDEO_XO_CBCR
  per.set.field &access_mode:0x17A018 %long 0x1 0x1 ; Enable GCC_VS_CTRL_AHB_CBCR
  per.set.field &access_mode:0x17A014 %long 0x1 0x1 ; Enable GCC_VS_CTRL_CBCR
  per.set.field &access_mode:0x11F04C %long 0x1 0x1 ; Enable GCC_WEST_APB_CBCR
  per.set.field &access_mode:0x11F01C %long 0x1 0x1 ; Enable GCC_WEST_AT_CBCR
  per.set.field &access_mode:0x1A0158 %long 0x1 0x1 ; Enable GCC_WPSS_AHB_BDG_MST_CBCR
  per.set.field &access_mode:0x1A0154 %long 0x1 0x1 ; Enable GCC_WPSS_AHB_CBCR
  per.set.field &access_mode:0x1A0160 %long 0x1 0x1 ; Enable GCC_WPSS_AT_CBCR
  per.set.field &access_mode:0x1A0134 %long 0x1 0x1 ; Enable GCC_WPSS_AXI_CBCR
  per.set.field &access_mode:0x1A015C %long 0x1 0x1 ; Enable GCC_WPSS_M_AT_CBCR
  per.set.field &access_mode:0x1A016C %long 0x1 0x1 ; Enable GCC_WPSS_RSCP_CBCR
  per.set.field &access_mode:0x1A0168 %long 0x1 0x1 ; Enable GCC_WPSS_THROTTLE_AHB_CBCR
  per.set.field &access_mode:0x1A0138 %long 0x1 0x1 ; Enable GCC_WPSS_THROTTLE_AXI_CBCR
  per.set.field &access_mode:0x1A0164 %long 0x1 0x1 ; Enable GCC_WPSS_TRIG_CBCR
  per.set.field &access_mode:0x1A0170 %long 0x1 0x1 ; Enable GCC_WPSS_XO_CBCR
  per.set.field &access_mode:0x143010 %long 0x1 0x1 ; Enable GCC_XO_CBCR
  per.set.field &access_mode:0x143018 %long 0x1 0x1 ; Enable GCC_XO_DIV16_CBCR
  per.set.field &access_mode:0x143014 %long 0x1 0x1 ; Enable GCC_XO_DIV4_CBCR

)


if ("&subsystem"=="aoss_cc"||"&subsystem"=="all")
(
  per.set.field &access_mode:0xC2A8190 %long 0x1 0x0 ; Enable AOSS_CC_RPMH_ACCEL_GDSCR
  per.set.field &access_mode:0xC2A80E4 %long 0x1 0x0 ; Enable AOSS_CC_SWAO_GDSCR


  per.set.field &access_mode:0xC2A8010 %long 0x1 0x1 ; Enable AOSS_CC_AOP_BRIDGE_SPLITTER_CBCR
  per.set.field &access_mode:0xC2A8014 %long 0x1 0x1 ; Enable AOSS_CC_AOP_BUS_AHB_CBCR
  per.set.field &access_mode:0xC2A804C %long 0x1 0x1 ; Enable AOSS_CC_AOP_DAP_CBCR
  per.set.field &access_mode:0xC2A800C %long 0x1 0x1 ; Enable AOSS_CC_AOP_PROC_AHB_CBCR
  per.set.field &access_mode:0xC2A8008 %long 0x1 0x1 ; Enable AOSS_CC_AOP_PROC_DEBUG_CBCR
  per.set.field &access_mode:0xC2A8004 %long 0x1 0x1 ; Enable AOSS_CC_AOP_PROC_FREERUN_CBCR
  per.set.field &access_mode:0xC2A803C %long 0x1 0x1 ; Enable AOSS_CC_AOP_RO_CBCR
  per.set.field &access_mode:0xC2A8040 %long 0x1 0x1 ; Enable AOSS_CC_AOP_RO_DIV4_CBCR
  per.set.field &access_mode:0xC2A8048 %long 0x1 0x1 ; Enable AOSS_CC_AO_DAP_CBCR
  per.set.field &access_mode:0xC2A8020 %long 0x1 0x1 ; Enable AOSS_CC_BUS_CBCR
  per.set.field &access_mode:0xC2A8028 %long 0x1 0x1 ; Enable AOSS_CC_CB_DIV_CBCR
  per.set.field &access_mode:0xC2A817C %long 0x1 0x1 ; Enable AOSS_CC_DEBUG_CBCR
  per.set.field &access_mode:0xC2A8058 %long 0x1 0x1 ; Enable AOSS_CC_EUD_AT_CBCR
  per.set.field &access_mode:0xC2A80C0 %long 0x1 0x1 ; Enable AOSS_CC_IBI_CTRL0_CBCR
  per.set.field &access_mode:0xC2A80C4 %long 0x1 0x1 ; Enable AOSS_CC_IBI_CTRL1_CBCR
  per.set.field &access_mode:0xC2A80C8 %long 0x1 0x1 ; Enable AOSS_CC_IBI_CTRL2_CBCR
  per.set.field &access_mode:0xC2A80CC %long 0x1 0x1 ; Enable AOSS_CC_IBI_CTRL3_CBCR
  per.set.field &access_mode:0xC2A80D0 %long 0x1 0x1 ; Enable AOSS_CC_IBI_CTRL4_CBCR
  per.set.field &access_mode:0xC2A80D4 %long 0x1 0x1 ; Enable AOSS_CC_IBI_CTRL5_CBCR
  per.set.field &access_mode:0xC2A8024 %long 0x1 0x1 ; Enable AOSS_CC_ICBM_CBCR
  per.set.field &access_mode:0xC2A80DC %long 0x1 0x1 ; Enable AOSS_CC_INT_SLEEP_CBCR
  per.set.field &access_mode:0xC2A8030 %long 0x1 0x1 ; Enable AOSS_CC_MESSAGE_RAM_CBCR
  per.set.field &access_mode:0xC2A8188 %long 0x1 0x1 ; Enable AOSS_CC_PLL_TEST_CBCR
  per.set.field &access_mode:0xC2A8074 %long 0x1 0x1 ; Enable AOSS_CC_PMIC_ARB2_CBCR
  per.set.field &access_mode:0xC2A8070 %long 0x1 0x1 ; Enable AOSS_CC_PMIC_ARB_CBCR
  per.set.field &access_mode:0xC2A8078 %long 0x1 0x1 ; Enable AOSS_CC_PMIC_ARB_COMMON_CBCR
  per.set.field &access_mode:0xC2A8044 %long 0x1 0x1 ; Enable AOSS_CC_PWR_MUX_CTRL_CBCR
  per.set.field &access_mode:0xC2A8054 %long 0x1 0x1 ; Enable AOSS_CC_RO_CBCR
  per.set.field &access_mode:0xC2A81A4 %long 0x1 0x1 ; Enable AOSS_CC_RPMH_ACCEL_CBCR
  per.set.field &access_mode:0xC2A81B0 %long 0x1 0x1 ; Enable AOSS_CC_RPMH_ACCEL_CPRF_CBCR
  per.set.field &access_mode:0xC2A8064 %long 0x1 0x1 ; Enable AOSS_CC_RPMH_ACCEL_GDSC_CTRL_CBCR
  per.set.field &access_mode:0xC2A81B4 %long 0x1 0x1 ; Enable AOSS_CC_RPMH_ACCEL_GLOBAL_CNTR_CBCR
  per.set.field &access_mode:0xC2A806C %long 0x1 0x1 ; Enable AOSS_CC_RPMH_CBCR
  per.set.field &access_mode:0xC2A807C %long 0x1 0x1 ; Enable AOSS_CC_RPMH_GLOBAL_CNTR_CBCR
  per.set.field &access_mode:0xC2A80D8 %long 0x1 0x1 ; Enable AOSS_CC_SLEEP_CBCR
  per.set.field &access_mode:0xC2A8168 %long 0x1 0x1 ; Enable AOSS_CC_SPMI2_AOD_SER_CBCR
  per.set.field &access_mode:0xC2A8160 %long 0x1 0x1 ; Enable AOSS_CC_SPMI2_SER_CBCR
  per.set.field &access_mode:0xC2A8158 %long 0x1 0x1 ; Enable AOSS_CC_SPMI_AOD_SER_CBCR
  per.set.field &access_mode:0xC2A8150 %long 0x1 0x1 ; Enable AOSS_CC_SPMI_CFG_AHB_CBCR
  per.set.field &access_mode:0xC2A8154 %long 0x1 0x1 ; Enable AOSS_CC_SPMI_SER_CBCR
  per.set.field &access_mode:0xC2A8100 %long 0x1 0x1 ; Enable AOSS_CC_SWAO_AO_CBCR
  per.set.field &access_mode:0xC2A8118 %long 0x1 0x1 ; Enable AOSS_CC_SWAO_BUS_CBCR
  per.set.field &access_mode:0xC2A80FC %long 0x1 0x1 ; Enable AOSS_CC_SWAO_CBCR
  per.set.field &access_mode:0xC2A8060 %long 0x1 0x1 ; Enable AOSS_CC_SWAO_GDSC_CTRL_CBCR
  per.set.field &access_mode:0xC2A8104 %long 0x1 0x1 ; Enable AOSS_CC_SWAO_MEM_CBCR
  per.set.field &access_mode:0xC2A80F8 %long 0x1 0x1 ; Enable AOSS_CC_SWAO_RPMH_DEBUG_CBCR
  per.set.field &access_mode:0xC2A8114 %long 0x1 0x1 ; Enable AOSS_CC_SWAO_TS_AO_CBCR
  per.set.field &access_mode:0xC2A8110 %long 0x1 0x1 ; Enable AOSS_CC_SWAO_TS_CBCR
  per.set.field &access_mode:0xC2A8068 %long 0x1 0x1 ; Enable AOSS_CC_TSENS_HW_CBCR
  per.set.field &access_mode:0xC2A8050 %long 0x1 0x1 ; Enable AOSS_CC_WCSS_TS_CBCR
  per.set.field &access_mode:0xC2A805C %long 0x1 0x1 ; Enable AOSS_CC_XO_CBCR

)


if ("&subsystem"=="apss_cc"||"&subsystem"=="all")
(


  per.set.field &access_mode:0x17AA0080 %long 0x1 0x1 ; Enable APSS_CC_AHB_CBCR
  per.set.field &access_mode:0x17AA0108 %long 0x1 0x1 ; Enable APSS_CC_DEBUG_CBCR
  per.set.field &access_mode:0x17AA00A8 %long 0x1 0x1 ; Enable APSS_CC_EPCB_I_RX_DFD_CBCR
  per.set.field &access_mode:0x17AA0018 %long 0x1 0x1 ; Enable APSS_CC_GOLD_CBC_CBCR
  per.set.field &access_mode:0x17AA0038 %long 0x1 0x1 ; Enable APSS_CC_GOLD_PLUS_CBC_CBCR
  per.set.field &access_mode:0x17AA0068 %long 0x1 0x1 ; Enable APSS_CC_IPM_CBCR
  per.set.field &access_mode:0x17AA0028 %long 0x1 0x1 ; Enable APSS_CC_L3_CBC_CBCR
  per.set.field &access_mode:0x17AA004C %long 0x1 0x1 ; Enable APSS_CC_LMH_CBCR
  per.set.field &access_mode:0x17AA0050 %long 0x1 0x1 ; Enable APSS_CC_LMH_LITE_CBCR
  per.set.field &access_mode:0x17AA00A0 %long 0x1 0x1 ; Enable APSS_CC_MIBU_CBCR
  per.set.field &access_mode:0x17AA00A4 %long 0x1 0x1 ; Enable APSS_CC_MIBU_SYS_CBCR
  per.set.field &access_mode:0x17AA005C %long 0x1 0x1 ; Enable APSS_CC_OSM_CBCR
  per.set.field &access_mode:0x17AA0074 %long 0x1 0x1 ; Enable APSS_CC_PERIPH_CBCR
  per.set.field &access_mode:0x17AA0114 %long 0x1 0x1 ; Enable APSS_CC_PLL_TEST_CBCR
  per.set.field &access_mode:0x17AA0128 %long 0x1 0x1 ; Enable APSS_CC_PPU_CBCR
  per.set.field &access_mode:0x17AA0094 %long 0x1 0x1 ; Enable APSS_CC_RBCPR_CBCR
  per.set.field &access_mode:0x17AA0008 %long 0x1 0x1 ; Enable APSS_CC_SILVER_CBC_CBCR
  per.set.field &access_mode:0x17AA0084 %long 0x1 0x1 ; Enable APSS_CC_SLEEP_CBCR
  per.set.field &access_mode:0x17AA0098 %long 0x1 0x1 ; Enable APSS_CC_TSENS_APC0_LLM_CBCR
  per.set.field &access_mode:0x17AA009C %long 0x1 0x1 ; Enable APSS_CC_TSENS_APC1_LLM_CBCR
  per.set.field &access_mode:0x17AA0088 %long 0x1 0x1 ; Enable APSS_CC_XO_DFD_CBCR
  per.set.field &access_mode:0x17AA0090 %long 0x1 0x1 ; Enable APSS_CC_XO_HW_CTRL_CBCR
  per.set.field &access_mode:0x17AA008C %long 0x1 0x1 ; Enable APSS_CC_XO_RSCC_DFD_CBCR

)


if ("&subsystem"=="cam_cc"||"&subsystem"=="all")
(
  per.set.field &access_mode:0xADF0004 %long 0x1 0x0 ; Enable CAM_CC_BPS_GDSCR
  per.set.field &access_mode:0xADF1004 %long 0x1 0x0 ; Enable CAM_CC_IFE_0_GDSCR
  per.set.field &access_mode:0xADF2004 %long 0x1 0x0 ; Enable CAM_CC_IFE_1_GDSCR
  per.set.field &access_mode:0xADF2054 %long 0x1 0x0 ; Enable CAM_CC_IFE_2_GDSCR
  per.set.field &access_mode:0xADF0080 %long 0x1 0x0 ; Enable CAM_CC_IPE_0_GDSCR
  per.set.field &access_mode:0xADF3058 %long 0x1 0x0 ; Enable CAM_CC_SFE_0_GDSCR
  per.set.field &access_mode:0xADF30A8 %long 0x1 0x0 ; Enable CAM_CC_SFE_1_GDSCR
  per.set.field &access_mode:0xADF32BC %long 0x1 0x0 ; Enable CAM_CC_TITAN_TOP_GDSCR


  per.set.field &access_mode:0xADF004C %long 0x1 0x1 ; Enable CAM_CC_BPS_AHB_CBCR
  per.set.field &access_mode:0xADF0068 %long 0x1 0x1 ; Enable CAM_CC_BPS_CBCR
  per.set.field &access_mode:0xADF0030 %long 0x1 0x1 ; Enable CAM_CC_BPS_FAST_AHB_CBCR
  per.set.field &access_mode:0xADF0078 %long 0x1 0x1 ; Enable CAM_CC_BPS_SHIFT_CBCR
  per.set.field &access_mode:0xADF3284 %long 0x1 0x1 ; Enable CAM_CC_CAMNOC_AXI_NRT_CBCR
  per.set.field &access_mode:0xADF3274 %long 0x1 0x1 ; Enable CAM_CC_CAMNOC_AXI_RT_CBCR
  per.set.field &access_mode:0xADF3290 %long 0x1 0x1 ; Enable CAM_CC_CAMNOC_DCD_XO_CBCR
  per.set.field &access_mode:0xADF3294 %long 0x1 0x1 ; Enable CAM_CC_CAMNOC_XO_CBCR
  per.set.field &access_mode:0xADF31E4 %long 0x1 0x1 ; Enable CAM_CC_CCI_0_CBCR
  per.set.field &access_mode:0xADF3200 %long 0x1 0x1 ; Enable CAM_CC_CCI_1_CBCR
  per.set.field &access_mode:0xADF321C %long 0x1 0x1 ; Enable CAM_CC_CCI_2_CBCR
  per.set.field &access_mode:0xADF32D0 %long 0x1 0x1 ; Enable CAM_CC_CORE_AHB_CBCR
  per.set.field &access_mode:0xADF3220 %long 0x1 0x1 ; Enable CAM_CC_CPAS_AHB_CBCR
  per.set.field &access_mode:0xADF0074 %long 0x1 0x1 ; Enable CAM_CC_CPAS_BPS_CBCR
  per.set.field &access_mode:0xADF3160 %long 0x1 0x1 ; Enable CAM_CC_CPAS_CRE_CBCR
  per.set.field &access_mode:0xADF322C %long 0x1 0x1 ; Enable CAM_CC_CPAS_FAST_AHB_CBCR
  per.set.field &access_mode:0xADF103C %long 0x1 0x1 ; Enable CAM_CC_CPAS_IFE_0_CBCR
  per.set.field &access_mode:0xADF203C %long 0x1 0x1 ; Enable CAM_CC_CPAS_IFE_1_CBCR
  per.set.field &access_mode:0xADF208C %long 0x1 0x1 ; Enable CAM_CC_CPAS_IFE_2_CBCR
  per.set.field &access_mode:0xADF3024 %long 0x1 0x1 ; Enable CAM_CC_CPAS_IFE_LITE_CBCR
  per.set.field &access_mode:0xADF00B8 %long 0x1 0x1 ; Enable CAM_CC_CPAS_IPE_NPS_CBCR
  per.set.field &access_mode:0xADF3090 %long 0x1 0x1 ; Enable CAM_CC_CPAS_SFE_0_CBCR
  per.set.field &access_mode:0xADF30E0 %long 0x1 0x1 ; Enable CAM_CC_CPAS_SFE_1_CBCR
  per.set.field &access_mode:0xADF3164 %long 0x1 0x1 ; Enable CAM_CC_CRE_AHB_CBCR
  per.set.field &access_mode:0xADF315C %long 0x1 0x1 ; Enable CAM_CC_CRE_CBCR
  per.set.field &access_mode:0xADF50F8 %long 0x1 0x1 ; Enable CAM_CC_CSI0PHYTIMER_CBCR
  per.set.field &access_mode:0xADF511C %long 0x1 0x1 ; Enable CAM_CC_CSI1PHYTIMER_CBCR
  per.set.field &access_mode:0xADF513C %long 0x1 0x1 ; Enable CAM_CC_CSI2PHYTIMER_CBCR
  per.set.field &access_mode:0xADF515C %long 0x1 0x1 ; Enable CAM_CC_CSI3PHYTIMER_CBCR
  per.set.field &access_mode:0xADF517C %long 0x1 0x1 ; Enable CAM_CC_CSI4PHYTIMER_CBCR
  per.set.field &access_mode:0xADF3250 %long 0x1 0x1 ; Enable CAM_CC_CSID_CBCR
  per.set.field &access_mode:0xADF5100 %long 0x1 0x1 ; Enable CAM_CC_CSID_CSIPHY_RX_CBCR
  per.set.field &access_mode:0xADF50FC %long 0x1 0x1 ; Enable CAM_CC_CSIPHY0_CBCR
  per.set.field &access_mode:0xADF5120 %long 0x1 0x1 ; Enable CAM_CC_CSIPHY1_CBCR
  per.set.field &access_mode:0xADF5140 %long 0x1 0x1 ; Enable CAM_CC_CSIPHY2_CBCR
  per.set.field &access_mode:0xADF5160 %long 0x1 0x1 ; Enable CAM_CC_CSIPHY3_CBCR
  per.set.field &access_mode:0xADF5180 %long 0x1 0x1 ; Enable CAM_CC_CSIPHY4_CBCR
  per.set.field &access_mode:0xADF4008 %long 0x1 0x1 ; Enable CAM_CC_DEBUG_CBCR
  per.set.field &access_mode:0xADF3318 %long 0x1 0x1 ; Enable CAM_CC_DRV_AHB_CBCR
  per.set.field &access_mode:0xADF3314 %long 0x1 0x1 ; Enable CAM_CC_DRV_XO_CBCR
  per.set.field &access_mode:0xADF32EC %long 0x1 0x1 ; Enable CAM_CC_GDSC_CBCR
  per.set.field &access_mode:0xADF31C8 %long 0x1 0x1 ; Enable CAM_CC_ICP_AHB_CBCR
  per.set.field &access_mode:0xADF31BC %long 0x1 0x1 ; Enable CAM_CC_ICP_CBCR
  per.set.field &access_mode:0xADF1030 %long 0x1 0x1 ; Enable CAM_CC_IFE_0_CBCR
  per.set.field &access_mode:0xADF1048 %long 0x1 0x1 ; Enable CAM_CC_IFE_0_FAST_AHB_CBCR
  per.set.field &access_mode:0xADF1064 %long 0x1 0x1 ; Enable CAM_CC_IFE_0_SHIFT_CBCR
  per.set.field &access_mode:0xADF1044 %long 0x1 0x1 ; Enable CAM_CC_IFE_0_SPDM_CBCR
  per.set.field &access_mode:0xADF2030 %long 0x1 0x1 ; Enable CAM_CC_IFE_1_CBCR
  per.set.field &access_mode:0xADF2048 %long 0x1 0x1 ; Enable CAM_CC_IFE_1_FAST_AHB_CBCR
  per.set.field &access_mode:0xADF204C %long 0x1 0x1 ; Enable CAM_CC_IFE_1_SHIFT_CBCR
  per.set.field &access_mode:0xADF2044 %long 0x1 0x1 ; Enable CAM_CC_IFE_1_SPDM_CBCR
  per.set.field &access_mode:0xADF2080 %long 0x1 0x1 ; Enable CAM_CC_IFE_2_CBCR
  per.set.field &access_mode:0xADF2098 %long 0x1 0x1 ; Enable CAM_CC_IFE_2_FAST_AHB_CBCR
  per.set.field &access_mode:0xADF209C %long 0x1 0x1 ; Enable CAM_CC_IFE_2_SHIFT_CBCR
  per.set.field &access_mode:0xADF2094 %long 0x1 0x1 ; Enable CAM_CC_IFE_2_SPDM_CBCR
  per.set.field &access_mode:0xADF3050 %long 0x1 0x1 ; Enable CAM_CC_IFE_LITE_AHB_CBCR
  per.set.field &access_mode:0xADF3018 %long 0x1 0x1 ; Enable CAM_CC_IFE_LITE_CBCR
  per.set.field &access_mode:0xADF304C %long 0x1 0x1 ; Enable CAM_CC_IFE_LITE_CPHY_RX_CBCR
  per.set.field &access_mode:0xADF3040 %long 0x1 0x1 ; Enable CAM_CC_IFE_LITE_CSID_CBCR
  per.set.field &access_mode:0xADF00D0 %long 0x1 0x1 ; Enable CAM_CC_IPE_NPS_AHB_CBCR
  per.set.field &access_mode:0xADF00AC %long 0x1 0x1 ; Enable CAM_CC_IPE_NPS_CBCR
  per.set.field &access_mode:0xADF00D4 %long 0x1 0x1 ; Enable CAM_CC_IPE_NPS_FAST_AHB_CBCR
  per.set.field &access_mode:0xADF00CC %long 0x1 0x1 ; Enable CAM_CC_IPE_NPS_SPDM_CBCR
  per.set.field &access_mode:0xADF00BC %long 0x1 0x1 ; Enable CAM_CC_IPE_PPS_CBCR
  per.set.field &access_mode:0xADF00D8 %long 0x1 0x1 ; Enable CAM_CC_IPE_PPS_FAST_AHB_CBCR
  per.set.field &access_mode:0xADF00DC %long 0x1 0x1 ; Enable CAM_CC_IPE_SHIFT_CBCR
  per.set.field &access_mode:0xADF3180 %long 0x1 0x1 ; Enable CAM_CC_JPEG_CBCR
  per.set.field &access_mode:0xADF319C %long 0x1 0x1 ; Enable CAM_CC_JPEG_SPDM_CBCR
  per.set.field &access_mode:0xADF5018 %long 0x1 0x1 ; Enable CAM_CC_MCLK0_CBCR
  per.set.field &access_mode:0xADF5034 %long 0x1 0x1 ; Enable CAM_CC_MCLK1_CBCR
  per.set.field &access_mode:0xADF5050 %long 0x1 0x1 ; Enable CAM_CC_MCLK2_CBCR
  per.set.field &access_mode:0xADF506C %long 0x1 0x1 ; Enable CAM_CC_MCLK3_CBCR
  per.set.field &access_mode:0xADF5088 %long 0x1 0x1 ; Enable CAM_CC_MCLK4_CBCR
  per.set.field &access_mode:0xADF50A4 %long 0x1 0x1 ; Enable CAM_CC_MCLK5_CBCR
  per.set.field &access_mode:0xADF50C0 %long 0x1 0x1 ; Enable CAM_CC_MCLK6_CBCR
  per.set.field &access_mode:0xADF50DC %long 0x1 0x1 ; Enable CAM_CC_MCLK7_CBCR
  per.set.field &access_mode:0xADF401C %long 0x1 0x1 ; Enable CAM_CC_PLL_TEST_CBCR
  per.set.field &access_mode:0xADF32B4 %long 0x1 0x1 ; Enable CAM_CC_QDSS_DEBUG_CBCR
  per.set.field &access_mode:0xADF32B8 %long 0x1 0x1 ; Enable CAM_CC_QDSS_DEBUG_XO_CBCR
  per.set.field &access_mode:0xADF3084 %long 0x1 0x1 ; Enable CAM_CC_SFE_0_CBCR
  per.set.field &access_mode:0xADF309C %long 0x1 0x1 ; Enable CAM_CC_SFE_0_FAST_AHB_CBCR
  per.set.field &access_mode:0xADF30A0 %long 0x1 0x1 ; Enable CAM_CC_SFE_0_SHIFT_CBCR
  per.set.field &access_mode:0xADF3098 %long 0x1 0x1 ; Enable CAM_CC_SFE_0_SPDM_CBCR
  per.set.field &access_mode:0xADF30D4 %long 0x1 0x1 ; Enable CAM_CC_SFE_1_CBCR
  per.set.field &access_mode:0xADF30EC %long 0x1 0x1 ; Enable CAM_CC_SFE_1_FAST_AHB_CBCR
  per.set.field &access_mode:0xADF30F0 %long 0x1 0x1 ; Enable CAM_CC_SFE_1_SHIFT_CBCR
  per.set.field &access_mode:0xADF30E8 %long 0x1 0x1 ; Enable CAM_CC_SFE_1_SPDM_CBCR
  per.set.field &access_mode:0xADF3308 %long 0x1 0x1 ; Enable CAM_CC_SLEEP_CBCR
  per.set.field &access_mode:0xADF330C %long 0x1 0x1 ; Enable CAM_CC_TITAN_TOP_SHIFT_CBCR

)


if ("&subsystem"=="disp_cc"||"&subsystem"=="all")
(
  per.set.field &access_mode:0xAF09000 %long 0x1 0x0 ; Enable DISP_CC_MDSS_CORE_GDSCR
  per.set.field &access_mode:0xAF0B000 %long 0x1 0x0 ; Enable DISP_CC_MDSS_CORE_INT2_GDSCR


  per.set.field &access_mode:0xAF0D004 %long 0x1 0x1 ; Enable DISP_CC_DEBUG_CBCR
  per.set.field &access_mode:0xAF0E058 %long 0x1 0x1 ; Enable DISP_CC_MDSS_ACCU_CBCR
  per.set.field &access_mode:0xAF0A020 %long 0x1 0x1 ; Enable DISP_CC_MDSS_AHB1_CBCR
  per.set.field &access_mode:0xAF080A4 %long 0x1 0x1 ; Enable DISP_CC_MDSS_AHB_CBCR
  per.set.field &access_mode:0xAF08028 %long 0x1 0x1 ; Enable DISP_CC_MDSS_BYTE0_CBCR
  per.set.field &access_mode:0xAF0802C %long 0x1 0x1 ; Enable DISP_CC_MDSS_BYTE0_INTF_CBCR
  per.set.field &access_mode:0xAF08030 %long 0x1 0x1 ; Enable DISP_CC_MDSS_BYTE1_CBCR
  per.set.field &access_mode:0xAF08034 %long 0x1 0x1 ; Enable DISP_CC_MDSS_BYTE1_INTF_CBCR
  per.set.field &access_mode:0xAF08058 %long 0x1 0x1 ; Enable DISP_CC_MDSS_DPTX0_AUX_CBCR
  per.set.field &access_mode:0xAF0804C %long 0x1 0x1 ; Enable DISP_CC_MDSS_DPTX0_CRYPTO_CBCR
  per.set.field &access_mode:0xAF08040 %long 0x1 0x1 ; Enable DISP_CC_MDSS_DPTX0_LINK_CBCR
  per.set.field &access_mode:0xAF08048 %long 0x1 0x1 ; Enable DISP_CC_MDSS_DPTX0_LINK_INTF_CBCR
  per.set.field &access_mode:0xAF08050 %long 0x1 0x1 ; Enable DISP_CC_MDSS_DPTX0_PIXEL0_CBCR
  per.set.field &access_mode:0xAF08054 %long 0x1 0x1 ; Enable DISP_CC_MDSS_DPTX0_PIXEL1_CBCR
  per.set.field &access_mode:0xAF08044 %long 0x1 0x1 ; Enable DISP_CC_MDSS_DPTX0_USB_ROUTER_LINK_INTF_CBCR
  per.set.field &access_mode:0xAF08074 %long 0x1 0x1 ; Enable DISP_CC_MDSS_DPTX1_AUX_CBCR
  per.set.field &access_mode:0xAF08070 %long 0x1 0x1 ; Enable DISP_CC_MDSS_DPTX1_CRYPTO_CBCR
  per.set.field &access_mode:0xAF08064 %long 0x1 0x1 ; Enable DISP_CC_MDSS_DPTX1_LINK_CBCR
  per.set.field &access_mode:0xAF0806C %long 0x1 0x1 ; Enable DISP_CC_MDSS_DPTX1_LINK_INTF_CBCR
  per.set.field &access_mode:0xAF0805C %long 0x1 0x1 ; Enable DISP_CC_MDSS_DPTX1_PIXEL0_CBCR
  per.set.field &access_mode:0xAF08060 %long 0x1 0x1 ; Enable DISP_CC_MDSS_DPTX1_PIXEL1_CBCR
  per.set.field &access_mode:0xAF08068 %long 0x1 0x1 ; Enable DISP_CC_MDSS_DPTX1_USB_ROUTER_LINK_INTF_CBCR
  per.set.field &access_mode:0xAF0808C %long 0x1 0x1 ; Enable DISP_CC_MDSS_DPTX2_AUX_CBCR
  per.set.field &access_mode:0xAF08088 %long 0x1 0x1 ; Enable DISP_CC_MDSS_DPTX2_CRYPTO_CBCR
  per.set.field &access_mode:0xAF08080 %long 0x1 0x1 ; Enable DISP_CC_MDSS_DPTX2_LINK_CBCR
  per.set.field &access_mode:0xAF08084 %long 0x1 0x1 ; Enable DISP_CC_MDSS_DPTX2_LINK_INTF_CBCR
  per.set.field &access_mode:0xAF08078 %long 0x1 0x1 ; Enable DISP_CC_MDSS_DPTX2_PIXEL0_CBCR
  per.set.field &access_mode:0xAF0807C %long 0x1 0x1 ; Enable DISP_CC_MDSS_DPTX2_PIXEL1_CBCR
  per.set.field &access_mode:0xAF0809C %long 0x1 0x1 ; Enable DISP_CC_MDSS_DPTX3_AUX_CBCR
  per.set.field &access_mode:0xAF080A0 %long 0x1 0x1 ; Enable DISP_CC_MDSS_DPTX3_CRYPTO_CBCR
  per.set.field &access_mode:0xAF08094 %long 0x1 0x1 ; Enable DISP_CC_MDSS_DPTX3_LINK_CBCR
  per.set.field &access_mode:0xAF08098 %long 0x1 0x1 ; Enable DISP_CC_MDSS_DPTX3_LINK_INTF_CBCR
  per.set.field &access_mode:0xAF08090 %long 0x1 0x1 ; Enable DISP_CC_MDSS_DPTX3_PIXEL0_CBCR
  per.set.field &access_mode:0xAF08038 %long 0x1 0x1 ; Enable DISP_CC_MDSS_ESC0_CBCR
  per.set.field &access_mode:0xAF0803C %long 0x1 0x1 ; Enable DISP_CC_MDSS_ESC1_CBCR
  per.set.field &access_mode:0xAF0A004 %long 0x1 0x1 ; Enable DISP_CC_MDSS_MDP1_CBCR
  per.set.field &access_mode:0xAF0800C %long 0x1 0x1 ; Enable DISP_CC_MDSS_MDP_CBCR
  per.set.field &access_mode:0xAF0A010 %long 0x1 0x1 ; Enable DISP_CC_MDSS_MDP_LUT1_CBCR
  per.set.field &access_mode:0xAF08018 %long 0x1 0x1 ; Enable DISP_CC_MDSS_MDP_LUT_CBCR
  per.set.field &access_mode:0xAF0C004 %long 0x1 0x1 ; Enable DISP_CC_MDSS_NON_GDSC_AHB_CBCR
  per.set.field &access_mode:0xAF08004 %long 0x1 0x1 ; Enable DISP_CC_MDSS_PCLK0_CBCR
  per.set.field &access_mode:0xAF08008 %long 0x1 0x1 ; Enable DISP_CC_MDSS_PCLK1_CBCR
  per.set.field &access_mode:0xAF0C00C %long 0x1 0x1 ; Enable DISP_CC_MDSS_RSCC_AHB_CBCR
  per.set.field &access_mode:0xAF0C008 %long 0x1 0x1 ; Enable DISP_CC_MDSS_RSCC_VSYNC_CBCR
  per.set.field &access_mode:0xAF0E01C %long 0x1 0x1 ; Enable DISP_CC_MDSS_SPDM_DEBUG_CBCR
  per.set.field &access_mode:0xAF0E010 %long 0x1 0x1 ; Enable DISP_CC_MDSS_SPDM_DP_CRYPTO_CBCR
  per.set.field &access_mode:0xAF0E018 %long 0x1 0x1 ; Enable DISP_CC_MDSS_SPDM_DP_PIXEL1_CBCR
  per.set.field &access_mode:0xAF0E014 %long 0x1 0x1 ; Enable DISP_CC_MDSS_SPDM_DP_PIXEL_CBCR
  per.set.field &access_mode:0xAF0E00C %long 0x1 0x1 ; Enable DISP_CC_MDSS_SPDM_MDP_CBCR
  per.set.field &access_mode:0xAF0E004 %long 0x1 0x1 ; Enable DISP_CC_MDSS_SPDM_PCLK0_CBCR
  per.set.field &access_mode:0xAF0E008 %long 0x1 0x1 ; Enable DISP_CC_MDSS_SPDM_PCLK1_CBCR
  per.set.field &access_mode:0xAF0A01C %long 0x1 0x1 ; Enable DISP_CC_MDSS_VSYNC1_CBCR
  per.set.field &access_mode:0xAF08024 %long 0x1 0x1 ; Enable DISP_CC_MDSS_VSYNC_CBCR
  per.set.field &access_mode:0xAF0D010 %long 0x1 0x1 ; Enable DISP_CC_PLL_TEST_CBCR
  per.set.field &access_mode:0xAF0E074 %long 0x1 0x1 ; Enable DISP_CC_SLEEP_CBCR
  per.set.field &access_mode:0xAF0E054 %long 0x1 0x1 ; Enable DISP_CC_XO_CBCR

)


if ("&subsystem"=="dpcc"||"&subsystem"=="all")
(
  per.set.field &access_mode:0x240A859C %long 0x1 0x0 ; Enable DPCC_LPI_LB_GDSCR
  per.set.field &access_mode:0x240A81BC %long 0x1 0x0 ; Enable DPCC_MC5_GDSCR
  per.set.field &access_mode:0x240A80E4 %long 0x1 0x0 ; Enable DPCC_SHUB_GDSCR


  per.set.field &access_mode:0x240A82D8 %long 0x1 0x1 ; Enable DPCC_AHB2PHY_CBCR
  per.set.field &access_mode:0x240A82E8 %long 0x1 0x1 ; Enable DPCC_CFG_CBCR
  per.set.field &access_mode:0x240A82F0 %long 0x1 0x1 ; Enable DPCC_CH02_DCNOC_CBCR
  per.set.field &access_mode:0x240A82CC %long 0x1 0x1 ; Enable DPCC_CH02_DDRSS_TOP_XO_CBCR
  per.set.field &access_mode:0x240A82DC %long 0x1 0x1 ; Enable DPCC_CH02_TGU_XO_CBCR
  per.set.field &access_mode:0x240A8230 %long 0x1 0x1 ; Enable DPCC_CH0_MC5_ATB_CBCR
  per.set.field &access_mode:0x240A8220 %long 0x1 0x1 ; Enable DPCC_CH0_MC5_CFG_CBCR
  per.set.field &access_mode:0x240A81F0 %long 0x1 0x1 ; Enable DPCC_CH0_MC5_SHUB_CBCR
  per.set.field &access_mode:0x240A81E0 %long 0x1 0x1 ; Enable DPCC_CH0_MC5_SLEEP_CBCR
  per.set.field &access_mode:0x240A81D0 %long 0x1 0x1 ; Enable DPCC_CH0_MC5_XO_CBCR
  per.set.field &access_mode:0x240A82F4 %long 0x1 0x1 ; Enable DPCC_CH13_DCNOC_CBCR
  per.set.field &access_mode:0x240A82D0 %long 0x1 0x1 ; Enable DPCC_CH13_DDRSS_TOP_XO_CBCR
  per.set.field &access_mode:0x240A82E0 %long 0x1 0x1 ; Enable DPCC_CH13_TGU_XO_CBCR
  per.set.field &access_mode:0x240A8234 %long 0x1 0x1 ; Enable DPCC_CH1_MC5_ATB_CBCR
  per.set.field &access_mode:0x240A8224 %long 0x1 0x1 ; Enable DPCC_CH1_MC5_CFG_CBCR
  per.set.field &access_mode:0x240A81FC %long 0x1 0x1 ; Enable DPCC_CH1_MC5_SHUB_CBCR
  per.set.field &access_mode:0x240A81E4 %long 0x1 0x1 ; Enable DPCC_CH1_MC5_SLEEP_CBCR
  per.set.field &access_mode:0x240A81D4 %long 0x1 0x1 ; Enable DPCC_CH1_MC5_XO_CBCR
  per.set.field &access_mode:0x240A8238 %long 0x1 0x1 ; Enable DPCC_CH2_MC5_ATB_CBCR
  per.set.field &access_mode:0x240A8228 %long 0x1 0x1 ; Enable DPCC_CH2_MC5_CFG_CBCR
  per.set.field &access_mode:0x240A8208 %long 0x1 0x1 ; Enable DPCC_CH2_MC5_SHUB_CBCR
  per.set.field &access_mode:0x240A81E8 %long 0x1 0x1 ; Enable DPCC_CH2_MC5_SLEEP_CBCR
  per.set.field &access_mode:0x240A81D8 %long 0x1 0x1 ; Enable DPCC_CH2_MC5_XO_CBCR
  per.set.field &access_mode:0x240A823C %long 0x1 0x1 ; Enable DPCC_CH3_MC5_ATB_CBCR
  per.set.field &access_mode:0x240A822C %long 0x1 0x1 ; Enable DPCC_CH3_MC5_CFG_CBCR
  per.set.field &access_mode:0x240A8214 %long 0x1 0x1 ; Enable DPCC_CH3_MC5_SHUB_CBCR
  per.set.field &access_mode:0x240A81EC %long 0x1 0x1 ; Enable DPCC_CH3_MC5_SLEEP_CBCR
  per.set.field &access_mode:0x240A81DC %long 0x1 0x1 ; Enable DPCC_CH3_MC5_XO_CBCR
  per.set.field &access_mode:0x240A815C %long 0x1 0x1 ; Enable DPCC_CMPNOC_CBCR
  per.set.field &access_mode:0x240A8174 %long 0x1 0x1 ; Enable DPCC_CNOC_SF_CBCR
  per.set.field &access_mode:0x240A82EC %long 0x1 0x1 ; Enable DPCC_DCH_DCNOC_CBCR
  per.set.field &access_mode:0x240A8310 %long 0x1 0x1 ; Enable DPCC_DCNOC_SHRM_CBCR
  per.set.field &access_mode:0x240A82C8 %long 0x1 0x1 ; Enable DPCC_DDRSS_TOP_XO_CBCR
  per.set.field &access_mode:0x240A80D0 %long 0x1 0x1 ; Enable DPCC_DEBUG_CBCR
  per.set.field &access_mode:0x240A8580 %long 0x1 0x1 ; Enable DPCC_DPM_CB_CBCR
  per.set.field &access_mode:0x240A830C %long 0x1 0x1 ; Enable DPCC_DPM_CFG_CBCR
  per.set.field &access_mode:0x240A8588 %long 0x1 0x1 ; Enable DPCC_DPM_CORE_CBCR
  per.set.field &access_mode:0x240A8584 %long 0x1 0x1 ; Enable DPCC_DPM_SHUB_CBCR
  per.set.field &access_mode:0x240A858C %long 0x1 0x1 ; Enable DPCC_DPM_TPDM_CMB_CBCR
  per.set.field &access_mode:0x240A8198 %long 0x1 0x1 ; Enable DPCC_GEMNOC_ATB_CBCR
  per.set.field &access_mode:0x240A8184 %long 0x1 0x1 ; Enable DPCC_GEMNOC_CFG_CBCR
  per.set.field &access_mode:0x240A8154 %long 0x1 0x1 ; Enable DPCC_GEMNOC_PWRCTL_CBCR
  per.set.field &access_mode:0x240A8148 %long 0x1 0x1 ; Enable DPCC_GEMNOC_SHUB_CBCR
  per.set.field &access_mode:0x240A81AC %long 0x1 0x1 ; Enable DPCC_GEMNOC_TS_CBCR
  per.set.field &access_mode:0x240A8120 %long 0x1 0x1 ; Enable DPCC_GEMNOC_XO_CBCR
  per.set.field &access_mode:0x240A8178 %long 0x1 0x1 ; Enable DPCC_GIC_CBCR
  per.set.field &access_mode:0x240A8160 %long 0x1 0x1 ; Enable DPCC_GPU_CBCR
  per.set.field &access_mode:0x240A8300 %long 0x1 0x1 ; Enable DPCC_LAGG_CFG_CBCR
  per.set.field &access_mode:0x240A8144 %long 0x1 0x1 ; Enable DPCC_LAGG_SHUB_CBCR
  per.set.field &access_mode:0x240A8134 %long 0x1 0x1 ; Enable DPCC_LLCC0_APB_CBCR
  per.set.field &access_mode:0x240A819C %long 0x1 0x1 ; Enable DPCC_LLCC0_ATB_CBCR
  per.set.field &access_mode:0x240A8188 %long 0x1 0x1 ; Enable DPCC_LLCC0_CFG_CBCR
  per.set.field &access_mode:0x240A8124 %long 0x1 0x1 ; Enable DPCC_LLCC0_SHUB_CBCR
  per.set.field &access_mode:0x240A8138 %long 0x1 0x1 ; Enable DPCC_LLCC1_APB_CBCR
  per.set.field &access_mode:0x240A81A0 %long 0x1 0x1 ; Enable DPCC_LLCC1_ATB_CBCR
  per.set.field &access_mode:0x240A818C %long 0x1 0x1 ; Enable DPCC_LLCC1_CFG_CBCR
  per.set.field &access_mode:0x240A8128 %long 0x1 0x1 ; Enable DPCC_LLCC1_SHUB_CBCR
  per.set.field &access_mode:0x240A813C %long 0x1 0x1 ; Enable DPCC_LLCC2_APB_CBCR
  per.set.field &access_mode:0x240A81A4 %long 0x1 0x1 ; Enable DPCC_LLCC2_ATB_CBCR
  per.set.field &access_mode:0x240A8190 %long 0x1 0x1 ; Enable DPCC_LLCC2_CFG_CBCR
  per.set.field &access_mode:0x240A812C %long 0x1 0x1 ; Enable DPCC_LLCC2_SHUB_CBCR
  per.set.field &access_mode:0x240A8140 %long 0x1 0x1 ; Enable DPCC_LLCC3_APB_CBCR
  per.set.field &access_mode:0x240A81A8 %long 0x1 0x1 ; Enable DPCC_LLCC3_ATB_CBCR
  per.set.field &access_mode:0x240A8194 %long 0x1 0x1 ; Enable DPCC_LLCC3_CFG_CBCR
  per.set.field &access_mode:0x240A8130 %long 0x1 0x1 ; Enable DPCC_LLCC3_SHUB_CBCR
  per.set.field &access_mode:0x240A8158 %long 0x1 0x1 ; Enable DPCC_LPASS_CBCR
  per.set.field &access_mode:0x240A82FC %long 0x1 0x1 ; Enable DPCC_LPINOC_CFG_CBCR
  per.set.field &access_mode:0x240A82D4 %long 0x1 0x1 ; Enable DPCC_LPINOC_XO_CBCR
  per.set.field &access_mode:0x240A85D0 %long 0x1 0x1 ; Enable DPCC_LPI_LB0_CFG_CBCR
  per.set.field &access_mode:0x240A85C0 %long 0x1 0x1 ; Enable DPCC_LPI_LB0_PWRCTL_CBCR
  per.set.field &access_mode:0x240A85B0 %long 0x1 0x1 ; Enable DPCC_LPI_LB0_SHUB_CBCR
  per.set.field &access_mode:0x240A85D4 %long 0x1 0x1 ; Enable DPCC_LPI_LB1_CFG_CBCR
  per.set.field &access_mode:0x240A85C4 %long 0x1 0x1 ; Enable DPCC_LPI_LB1_PWRCTL_CBCR
  per.set.field &access_mode:0x240A85B4 %long 0x1 0x1 ; Enable DPCC_LPI_LB1_SHUB_CBCR
  per.set.field &access_mode:0x240A85D8 %long 0x1 0x1 ; Enable DPCC_LPI_LB2_CFG_CBCR
  per.set.field &access_mode:0x240A85C8 %long 0x1 0x1 ; Enable DPCC_LPI_LB2_PWRCTL_CBCR
  per.set.field &access_mode:0x240A85B8 %long 0x1 0x1 ; Enable DPCC_LPI_LB2_SHUB_CBCR
  per.set.field &access_mode:0x240A85DC %long 0x1 0x1 ; Enable DPCC_LPI_LB3_CFG_CBCR
  per.set.field &access_mode:0x240A85CC %long 0x1 0x1 ; Enable DPCC_LPI_LB3_PWRCTL_CBCR
  per.set.field &access_mode:0x240A85BC %long 0x1 0x1 ; Enable DPCC_LPI_LB3_SHUB_CBCR
  per.set.field &access_mode:0x240A8284 %long 0x1 0x1 ; Enable DPCC_MCCC_CBCR
  per.set.field &access_mode:0x240A82F8 %long 0x1 0x1 ; Enable DPCC_MCCC_CFG_CBCR
  per.set.field &access_mode:0x240A8280 %long 0x1 0x1 ; Enable DPCC_MCCC_XO_CBCR
  per.set.field &access_mode:0x240A8314 %long 0x1 0x1 ; Enable DPCC_MC_SRC0_CBCR
  per.set.field &access_mode:0x240A8318 %long 0x1 0x1 ; Enable DPCC_MC_SRC1_CBCR
  per.set.field &access_mode:0x240A8164 %long 0x1 0x1 ; Enable DPCC_MDSP_CBCR
  per.set.field &access_mode:0x240A816C %long 0x1 0x1 ; Enable DPCC_MNOC_HF_CBCR
  per.set.field &access_mode:0x240A8170 %long 0x1 0x1 ; Enable DPCC_MNOC_SF_CBCR
  per.set.field &access_mode:0x240A8168 %long 0x1 0x1 ; Enable DPCC_MODEM_CBCR
  per.set.field &access_mode:0x240A81B0 %long 0x1 0x1 ; Enable DPCC_PCIE_SF_CBCR
  per.set.field &access_mode:0x240A8248 %long 0x1 0x1 ; Enable DPCC_PHY0_SLEEP_CBCR
  per.set.field &access_mode:0x240A8244 %long 0x1 0x1 ; Enable DPCC_PHY0_XO_CBCR
  per.set.field &access_mode:0x240A824C %long 0x1 0x1 ; Enable DPCC_PHY0_XO_REF_CBCR
  per.set.field &access_mode:0x240A8254 %long 0x1 0x1 ; Enable DPCC_PHY1_SLEEP_CBCR
  per.set.field &access_mode:0x240A8250 %long 0x1 0x1 ; Enable DPCC_PHY1_XO_CBCR
  per.set.field &access_mode:0x240A8258 %long 0x1 0x1 ; Enable DPCC_PHY1_XO_REF_CBCR
  per.set.field &access_mode:0x240A80DC %long 0x1 0x1 ; Enable DPCC_PLL_TEST_CBCR
  per.set.field &access_mode:0x240A8594 %long 0x1 0x1 ; Enable DPCC_PWRCTL_CBCR
  per.set.field &access_mode:0x240A8308 %long 0x1 0x1 ; Enable DPCC_QMIP_CFG_CBCR
  per.set.field &access_mode:0x240A8304 %long 0x1 0x1 ; Enable DPCC_REGS_CFG_CBCR
  per.set.field &access_mode:0x240A8264 %long 0x1 0x1 ; Enable DPCC_SHRM_CBCR
  per.set.field &access_mode:0x240A8270 %long 0x1 0x1 ; Enable DPCC_SHRM_DEBUG_CBCR
  per.set.field &access_mode:0x240A8278 %long 0x1 0x1 ; Enable DPCC_SHRM_RCG_CBCR
  per.set.field &access_mode:0x240A8274 %long 0x1 0x1 ; Enable DPCC_SHRM_TPDM_CMB_CBCR
  per.set.field &access_mode:0x240A8260 %long 0x1 0x1 ; Enable DPCC_SHRM_XO_CBCR
  per.set.field &access_mode:0x240A817C %long 0x1 0x1 ; Enable DPCC_SNOC_SF_CBCR
  per.set.field &access_mode:0x240A8180 %long 0x1 0x1 ; Enable DPCC_SYS_TCU_CBCR
  per.set.field &access_mode:0x240A81B4 %long 0x1 0x1 ; Enable DPCC_WLAN_Q6_CBCR
  per.set.field &access_mode:0x240A82BC %long 0x1 0x1 ; Enable DPCC_XO_CBCR
  per.set.field &access_mode:0x240A82C0 %long 0x1 0x1 ; Enable DPCC_XO_DIV_16_CBCR

)


if ("&subsystem"=="gpu_cc"||"&subsystem"=="all")
(
  per.set.field &access_mode:0x3D9908C %long 0x1 0x0 ; Enable GPUCC_GPU_CC_CX_GDSCR
  per.set.field &access_mode:0x3D99034 %long 0x1 0x0 ; Enable GPUCC_GPU_CC_GX_GDSCR


  per.set.field &access_mode:0x3D99188 %long 0x1 0x1 ; Enable GPUCC_GPU_CC_ACD_AHB_CBCR
  per.set.field &access_mode:0x3D99184 %long 0x1 0x1 ; Enable GPUCC_GPU_CC_ACD_CXO_CBCR
  per.set.field &access_mode:0x3D990C8 %long 0x1 0x1 ; Enable GPUCC_GPU_CC_AHB_CBCR
  per.set.field &access_mode:0x3D99190 %long 0x1 0x1 ; Enable GPUCC_GPU_CC_CB_CBCR
  per.set.field &access_mode:0x3D990CC %long 0x1 0x1 ; Enable GPUCC_GPU_CC_CRC_AHB_CBCR
  per.set.field &access_mode:0x3D99004 %long 0x1 0x1 ; Enable GPUCC_GPU_CC_CXO_AON_CBCR
  per.set.field &access_mode:0x3D990F0 %long 0x1 0x1 ; Enable GPUCC_GPU_CC_CXO_CBCR
  per.set.field &access_mode:0x3D99108 %long 0x1 0x1 ; Enable GPUCC_GPU_CC_CX_ACCU_SHIFT_CBCR
  per.set.field &access_mode:0x3D990D8 %long 0x1 0x1 ; Enable GPUCC_GPU_CC_CX_APB_CBCR
  per.set.field &access_mode:0x3D990F8 %long 0x1 0x1 ; Enable GPUCC_GPU_CC_CX_FF_CBCR
  per.set.field &access_mode:0x3D99110 %long 0x1 0x1 ; Enable GPUCC_GPU_CC_CX_GFX3D_CBCR
  per.set.field &access_mode:0x3D99114 %long 0x1 0x1 ; Enable GPUCC_GPU_CC_CX_GFX3D_SLV_CBCR
  per.set.field &access_mode:0x3D990E4 %long 0x1 0x1 ; Enable GPUCC_GPU_CC_CX_GMU_CBCR
  per.set.field &access_mode:0x3D990D0 %long 0x1 0x1 ; Enable GPUCC_GPU_CC_CX_QDSS_AT_CBCR
  per.set.field &access_mode:0x3D990E0 %long 0x1 0x1 ; Enable GPUCC_GPU_CC_CX_QDSS_TRIG_CBCR
  per.set.field &access_mode:0x3D990D4 %long 0x1 0x1 ; Enable GPUCC_GPU_CC_CX_QDSS_TSCTR_CBCR
  per.set.field &access_mode:0x3D99144 %long 0x1 0x1 ; Enable GPUCC_GPU_CC_DEBUG_CBCR
  per.set.field &access_mode:0x3D99148 %long 0x1 0x1 ; Enable GPUCC_GPU_CC_DEBUG_MEASURE_CBCR
  per.set.field &access_mode:0x3D9900C %long 0x1 0x1 ; Enable GPUCC_GPU_CC_DEMET_CBCR
  per.set.field &access_mode:0x3D99008 %long 0x1 0x1 ; Enable GPUCC_GPU_CC_FREQ_MEASURE_CBCR
  per.set.field &access_mode:0x3D99084 %long 0x1 0x1 ; Enable GPUCC_GPU_CC_GX_ACCU_SHIFT_CBCR
  per.set.field &access_mode:0x3D99074 %long 0x1 0x1 ; Enable GPUCC_GPU_CC_GX_CXO_CBCR
  per.set.field &access_mode:0x3D9907C %long 0x1 0x1 ; Enable GPUCC_GPU_CC_GX_FF_CBCR
  per.set.field &access_mode:0x3D99060 %long 0x1 0x1 ; Enable GPUCC_GPU_CC_GX_GFX3D_CBCR
  per.set.field &access_mode:0x3D99080 %long 0x1 0x1 ; Enable GPUCC_GPU_CC_GX_GFX3D_RDVM_CBCR
  per.set.field &access_mode:0x3D99078 %long 0x1 0x1 ; Enable GPUCC_GPU_CC_GX_GMU_CBCR
  per.set.field &access_mode:0x3D99070 %long 0x1 0x1 ; Enable GPUCC_GPU_CC_GX_QDSS_TSCTR_CBCR
  per.set.field &access_mode:0x3D9906C %long 0x1 0x1 ; Enable GPUCC_GPU_CC_GX_VSENSE_CBCR
  per.set.field &access_mode:0x3D99198 %long 0x1 0x1 ; Enable GPUCC_GPU_CC_HUB_AON_CBCR
  per.set.field &access_mode:0x3D990F4 %long 0x1 0x1 ; Enable GPUCC_GPU_CC_HUB_CX_INT_CBCR
  per.set.field &access_mode:0x3D990FC %long 0x1 0x1 ; Enable GPUCC_GPU_CC_MEMNOC_GFX_CBCR
  per.set.field &access_mode:0x3D99158 %long 0x1 0x1 ; Enable GPUCC_GPU_CC_MND1X_0_GFX3D_CBCR
  per.set.field &access_mode:0x3D9915C %long 0x1 0x1 ; Enable GPUCC_GPU_CC_MND1X_1_GFX3D_CBCR
  per.set.field &access_mode:0x3D99154 %long 0x1 0x1 ; Enable GPUCC_GPU_CC_PLL_TEST_CBCR
  per.set.field &access_mode:0x3D99138 %long 0x1 0x1 ; Enable GPUCC_GPU_CC_RBCPR_AHB_CBCR
  per.set.field &access_mode:0x3D99134 %long 0x1 0x1 ; Enable GPUCC_GPU_CC_RBCPR_CBCR
  per.set.field &access_mode:0x3D990DC %long 0x1 0x1 ; Enable GPUCC_GPU_CC_SLEEP_CBCR

)


if ("&subsystem"=="lpass_aon_cc"||"&subsystem"=="all")
(
  per.set.field &access_mode:0x6E26100 %long 0x1 0x0 ; Enable LPASS_AON_CC_LPASS_0_LPMLA_GDSCR
  per.set.field &access_mode:0x6E27100 %long 0x1 0x0 ; Enable LPASS_AON_CC_LPASS_1_LPMLA_GDSCR
  per.set.field &access_mode:0x6E22100 %long 0x1 0x0 ; Enable LPASS_AON_CC_LPASS_AON_CAM_GDSCR
  per.set.field &access_mode:0x6E21104 %long 0x1 0x0 ; Enable LPASS_AON_CC_LPASS_AON_NOC_GDSCR
  per.set.field &access_mode:0x6E11090 %long 0x1 0x0 ; Enable LPASS_AON_CC_LPASS_AUDIO_HM_GDSCR
  per.set.field &access_mode:0x6E20090 %long 0x1 0x0 ; Enable LPASS_AON_CC_LPASS_PDC_HM_GDSCR
  per.set.field &access_mode:0x6E25100 %long 0x1 0x0 ; Enable LPASS_AON_CC_LPASS_SSC_GDSCR


  per.set.field &access_mode:0x6E220A4 %long 0x1 0x1 ; Enable LPASS_AON_CC_AON_CAM1_CSIPHYTIMER_CBCR
  per.set.field &access_mode:0x6E22098 %long 0x1 0x1 ; Enable LPASS_AON_CC_AON_CAM1_CSIPHY_0_CBCR
  per.set.field &access_mode:0x6E220A8 %long 0x1 0x1 ; Enable LPASS_AON_CC_AON_CAM1_MCLK_CBCR
  per.set.field &access_mode:0x6E2205C %long 0x1 0x1 ; Enable LPASS_AON_CC_AON_CAM_AHB_CBCR
  per.set.field &access_mode:0x6E22060 %long 0x1 0x1 ; Enable LPASS_AON_CC_AON_CAM_AHB_NIU_CBCR
  per.set.field &access_mode:0x6E12034 %long 0x1 0x1 ; Enable LPASS_AON_CC_AON_CAM_AT_CBCR
  per.set.field &access_mode:0x6E220D4 %long 0x1 0x1 ; Enable LPASS_AON_CC_AON_CAM_CORE_CBCR
  per.set.field &access_mode:0x6E220E8 %long 0x1 0x1 ; Enable LPASS_AON_CC_AON_CAM_CSID_CBCR
  per.set.field &access_mode:0x6E22080 %long 0x1 0x1 ; Enable LPASS_AON_CC_AON_CAM_CSID_CSIPHY_0_RX_CBCR
  per.set.field &access_mode:0x6E22094 %long 0x1 0x1 ; Enable LPASS_AON_CC_AON_CAM_CSIPHYTIMER_CBCR
  per.set.field &access_mode:0x6E22084 %long 0x1 0x1 ; Enable LPASS_AON_CC_AON_CAM_CSIPHY_0_CBCR
  per.set.field &access_mode:0x6E2204C %long 0x1 0x1 ; Enable LPASS_AON_CC_AON_CAM_DBG_CBCR
  per.set.field &access_mode:0x6E1205C %long 0x1 0x1 ; Enable LPASS_AON_CC_AON_CAM_DBG_TSCTR_CBCR
  per.set.field &access_mode:0x6E220E4 %long 0x1 0x1 ; Enable LPASS_AON_CC_AON_CAM_GDS_ACCU_SHIFT_CBCR
  per.set.field &access_mode:0x6E220A0 %long 0x1 0x1 ; Enable LPASS_AON_CC_AON_CAM_MCLK_CBCR
  per.set.field &access_mode:0x6E2203C %long 0x1 0x1 ; Enable LPASS_AON_CC_AON_CAM_NOC_CBCR
  per.set.field &access_mode:0x6E22040 %long 0x1 0x1 ; Enable LPASS_AON_CC_AON_CAM_NOC_NIU_CBCR
  per.set.field &access_mode:0x6E1103C %long 0x1 0x1 ; Enable LPASS_AON_CC_AON_H_CBCR
  per.set.field &access_mode:0x6E1201C %long 0x1 0x1 ; Enable LPASS_AON_CC_AON_NOC_AT_CBCR
  per.set.field &access_mode:0x6E12030 %long 0x1 0x1 ; Enable LPASS_AON_CC_AON_NOC_QDSS_TSCTR_CBCR
  per.set.field &access_mode:0x6E10028 %long 0x1 0x1 ; Enable LPASS_AON_CC_AON_NOC_XO_CBCR
  per.set.field &access_mode:0x6E12020 %long 0x1 0x1 ; Enable LPASS_AON_CC_AT_CBCR
  per.set.field &access_mode:0x6E11014 %long 0x1 0x1 ; Enable LPASS_AON_CC_AUDIO_HM_H_CBCR
  per.set.field &access_mode:0x6E1106C %long 0x1 0x1 ; Enable LPASS_AON_CC_AUDIO_HM_NIU_CBCR
  per.set.field &access_mode:0x6E1107C %long 0x1 0x1 ; Enable LPASS_AON_CC_AUDIO_HM_NIU_MASTER_CBCR
  per.set.field &access_mode:0x6E18010 %long 0x1 0x1 ; Enable LPASS_AON_CC_AUDIO_HM_SLEEP_CBCR
  per.set.field &access_mode:0x6E11404 %long 0x1 0x1 ; Enable LPASS_AON_CC_BROADCAST_CBCR
  per.set.field &access_mode:0x6E1D00C %long 0x1 0x1 ; Enable LPASS_AON_CC_CPR_CBCR
  per.set.field &access_mode:0x6E11050 %long 0x1 0x1 ; Enable LPASS_AON_CC_CPR_H_CBCR
  per.set.field &access_mode:0x6E11010 %long 0x1 0x1 ; Enable LPASS_AON_CC_CSR_H_CBCR
  per.set.field &access_mode:0x6E12058 %long 0x1 0x1 ; Enable LPASS_AON_CC_DBG_TSCTR_CBCR
  per.set.field &access_mode:0x6E12084 %long 0x1 0x1 ; Enable LPASS_AON_CC_DEBUG_CBCR
  per.set.field &access_mode:0x6E2621C %long 0x1 0x1 ; Enable LPASS_AON_CC_ENPU_SCHEDULER_CBCR
  per.set.field &access_mode:0x6E26200 %long 0x1 0x1 ; Enable LPASS_AON_CC_ENPU_SCHEDULER_H_CBCR
  per.set.field &access_mode:0x6E26230 %long 0x1 0x1 ; Enable LPASS_AON_CC_ENPU_SCHEDULER_QSB_CBCR
  per.set.field &access_mode:0x6E0B020 %long 0x1 0x1 ; Enable LPASS_AON_CC_EXT_IF1_EBIT_CBCR
  per.set.field &access_mode:0x6E0B01C %long 0x1 0x1 ; Enable LPASS_AON_CC_EXT_IF1_IBIT_CBCR
  per.set.field &access_mode:0x6E1C00C %long 0x1 0x1 ; Enable LPASS_AON_CC_ICB_LINK_CBCR
  per.set.field &access_mode:0x6E26024 %long 0x1 0x1 ; Enable LPASS_AON_CC_LPASS_0_LPMLA_AHB_ODSC_CBCR
  per.set.field &access_mode:0x6E26504 %long 0x1 0x1 ; Enable LPASS_AON_CC_LPASS_0_LPMLA_ENPU_NOC_AT_CBCR
  per.set.field &access_mode:0x6E26500 %long 0x1 0x1 ; Enable LPASS_AON_CC_LPASS_0_LPMLA_ENPU_NOC_QDSS_TSCTR_CBCR
  per.set.field &access_mode:0x6E26000 %long 0x1 0x1 ; Enable LPASS_AON_CC_LPASS_0_LPMLA_H_CBCR
  per.set.field &access_mode:0x6E26120 %long 0x1 0x1 ; Enable LPASS_AON_CC_LPASS_0_LPMLA_NOC_CBCR
  per.set.field &access_mode:0x6E2612C %long 0x1 0x1 ; Enable LPASS_AON_CC_LPASS_0_LPMLA_NOC_XO_CBCR
  per.set.field &access_mode:0x6E27024 %long 0x1 0x1 ; Enable LPASS_AON_CC_LPASS_1_LPMLA_AHB_ODSC_CBCR
  per.set.field &access_mode:0x6E27504 %long 0x1 0x1 ; Enable LPASS_AON_CC_LPASS_1_LPMLA_ENPU_NOC_AT_CBCR
  per.set.field &access_mode:0x6E27500 %long 0x1 0x1 ; Enable LPASS_AON_CC_LPASS_1_LPMLA_ENPU_NOC_QDSS_TSCTR_CBCR
  per.set.field &access_mode:0x6E27000 %long 0x1 0x1 ; Enable LPASS_AON_CC_LPASS_1_LPMLA_H_CBCR
  per.set.field &access_mode:0x6E27200 %long 0x1 0x1 ; Enable LPASS_AON_CC_LPASS_1_LPMLA_NOC_CBCR
  per.set.field &access_mode:0x6E2712C %long 0x1 0x1 ; Enable LPASS_AON_CC_LPASS_1_LPMLA_NOC_XO_CBCR
  per.set.field &access_mode:0x6E12018 %long 0x1 0x1 ; Enable LPASS_AON_CC_LPI_NOC_DBG_CBCR
  per.set.field &access_mode:0x6E21008 %long 0x1 0x1 ; Enable LPASS_AON_CC_LPI_NOC_HS_CBCR
  per.set.field &access_mode:0x6E11300 %long 0x1 0x1 ; Enable LPASS_AON_CC_LPI_NOC_LS_CBCR
  per.set.field &access_mode:0x6E09000 %long 0x1 0x1 ; Enable LPASS_AON_CC_LPI_NOC_MPU_CFG_CBCR
  per.set.field &access_mode:0x6E10020 %long 0x1 0x1 ; Enable LPASS_AON_CC_LPI_NOC_XO_CBCR
  per.set.field &access_mode:0x6E1104C %long 0x1 0x1 ; Enable LPASS_AON_CC_MCC_ACCESS_CBCR
  per.set.field &access_mode:0x6E12014 %long 0x1 0x1 ; Enable LPASS_AON_CC_PCLKDBG_CBCR
  per.set.field &access_mode:0x6E20004 %long 0x1 0x1 ; Enable LPASS_AON_CC_PDC_GDS_CBCR
  per.set.field &access_mode:0x6E1100C %long 0x1 0x1 ; Enable LPASS_AON_CC_PDC_H_CBCR
  per.set.field &access_mode:0x6E12080 %long 0x1 0x1 ; Enable LPASS_AON_CC_PLL_LV_TEST_CBCR
  per.set.field &access_mode:0x6E1101C %long 0x1 0x1 ; Enable LPASS_AON_CC_Q6_AHBM_CBCR
  per.set.field &access_mode:0x6E11020 %long 0x1 0x1 ; Enable LPASS_AON_CC_Q6_AHBS_CBCR
  per.set.field &access_mode:0x6E12010 %long 0x1 0x1 ; Enable LPASS_AON_CC_Q6_ATBM_CBCR
  per.set.field &access_mode:0x6E21034 %long 0x1 0x1 ; Enable LPASS_AON_CC_Q6_AXIM_CBCR
  per.set.field &access_mode:0x6E2102C %long 0x1 0x1 ; Enable LPASS_AON_CC_Q6_AXIS_CBCR
  per.set.field &access_mode:0x6E1001C %long 0x1 0x1 ; Enable LPASS_AON_CC_Q6_XO_CBCR
  per.set.field &access_mode:0x6E11070 %long 0x1 0x1 ; Enable LPASS_AON_CC_QSM_XO_CBCR
  per.set.field &access_mode:0x6E1800C %long 0x1 0x1 ; Enable LPASS_AON_CC_RO_CBCR
  per.set.field &access_mode:0x6E29020 %long 0x1 0x1 ; Enable LPASS_AON_CC_SDC_BUS_HCLK_CBCR
  per.set.field &access_mode:0x6E29104 %long 0x1 0x1 ; Enable LPASS_AON_CC_SDC_CTI_CBCR
  per.set.field &access_mode:0x6E29108 %long 0x1 0x1 ; Enable LPASS_AON_CC_SDC_CTI_PCLK_CBCR
  per.set.field &access_mode:0x6E29114 %long 0x1 0x1 ; Enable LPASS_AON_CC_SDC_DAP_CBCR
  per.set.field &access_mode:0x6E29028 %long 0x1 0x1 ; Enable LPASS_AON_CC_SDC_MEM_HCLK_CBCR
  per.set.field &access_mode:0x6E2900C %long 0x1 0x1 ; Enable LPASS_AON_CC_SDC_PROC_FCLK_CBCR
  per.set.field &access_mode:0x6E29010 %long 0x1 0x1 ; Enable LPASS_AON_CC_SDC_PROC_HCLK_CBCR
  per.set.field &access_mode:0x6E2910C %long 0x1 0x1 ; Enable LPASS_AON_CC_SDC_QDSS_CBCR
  per.set.field &access_mode:0x6E29050 %long 0x1 0x1 ; Enable LPASS_AON_CC_SDC_SLEEP_CBCR
  per.set.field &access_mode:0x6E29110 %long 0x1 0x1 ; Enable LPASS_AON_CC_SDC_TS_CBCR
  per.set.field &access_mode:0x6E1A018 %long 0x1 0x1 ; Enable LPASS_AON_CC_SEQUENCER_MCLK_CBCR
  per.set.field &access_mode:0x6E18004 %long 0x1 0x1 ; Enable LPASS_AON_CC_SLEEP_CBCR
  per.set.field &access_mode:0x6E25004 %long 0x1 0x1 ; Enable LPASS_AON_CC_SSC_H_MASTER_CBCR
  per.set.field &access_mode:0x6E25000 %long 0x1 0x1 ; Enable LPASS_AON_CC_SSC_H_SLAVE_CBCR
  per.set.field &access_mode:0x6E10030 %long 0x1 0x1 ; Enable LPASS_AON_CC_TLMM_XO_CBCR
  per.set.field &access_mode:0x6E1B00C %long 0x1 0x1 ; Enable LPASS_AON_CC_TX_MCLK_2X_CBCR
  per.set.field &access_mode:0x6E1B014 %long 0x1 0x1 ; Enable LPASS_AON_CC_TX_MCLK_CBCR
  per.set.field &access_mode:0x6E1A00C %long 0x1 0x1 ; Enable LPASS_AON_CC_VA_2X_CBCR
  per.set.field &access_mode:0x6E1A014 %long 0x1 0x1 ; Enable LPASS_AON_CC_VA_CBCR
  per.set.field &access_mode:0x6E11054 %long 0x1 0x1 ; Enable LPASS_AON_CC_VA_H_CBCR
  per.set.field &access_mode:0x6E11060 %long 0x1 0x1 ; Enable LPASS_AON_CC_VA_MEM0_CBCR
  per.set.field &access_mode:0x6E1105C %long 0x1 0x1 ; Enable LPASS_AON_CC_VA_NIU_CBCR
  per.set.field &access_mode:0x6E11080 %long 0x1 0x1 ; Enable LPASS_AON_CC_VA_NIU_MASTER_CBCR
  per.set.field &access_mode:0x6E09018 %long 0x1 0x1 ; Enable LPASS_AON_CC_VA_XPU2_CLIENT_CBCR
  per.set.field &access_mode:0x6E1D038 %long 0x1 0x1 ; Enable LPASS_AON_CC_VS_VDDCX_CBCR
  per.set.field &access_mode:0x6E1D02C %long 0x1 0x1 ; Enable LPASS_AON_CC_VS_VDDMX_CBCR
  per.set.field &access_mode:0x6E1002C %long 0x1 0x1 ; Enable LPASS_AON_CC_XO_DIV16_CBCR
  per.set.field &access_mode:0x726A000 %long 0x1 0x1 ; Enable LPASS_LPASS_LPI_TCM_256KB_BLOCK0_CBCR
  per.set.field &access_mode:0x726A004 %long 0x1 0x1 ; Enable LPASS_LPASS_LPI_TCM_256KB_BLOCK1_CBCR
  per.set.field &access_mode:0x726A000 %long 0x1 0x1 ; Enable LPASS_LPASS_LPI_TCM_256KB_blockn_CBCR
  per.set.field &access_mode:0x726A300 %long 0x1 0x1 ; Enable LPASS_LPASS_LPI_TCM_AXIS_HS_CBCR
  per.set.field &access_mode:0x6848020 %long 0x1 0x1 ; Enable LPASS_QDSP6SS_CORE_CBCR
  per.set.field &access_mode:0x6849008 %long 0x1 0x1 ; Enable LPASS_QDSP6SS_DEBUG_CBCR
  per.set.field &access_mode:0x6848060 %long 0x1 0x1 ; Enable LPASS_QDSP6SS_MON_CBCR
  per.set.field &access_mode:0x68006C0 %long 0x1 0x1 ; Enable LPASS_QDSP6SS_VEC_CORE_CBCR
  per.set.field &access_mode:0x68006B0 %long 0x1 0x1 ; Enable LPASS_QDSP6SS_VEC_VU_CBCR

)


if ("&subsystem"=="lpass_audio_cc"||"&subsystem"=="all")
(


  per.set.field &access_mode:0x6BEE050 %long 0x1 0x1 ; Enable LPASS_AUDIO_CC_BT_SWR_2X_CBCR
  per.set.field &access_mode:0x6BEE054 %long 0x1 0x1 ; Enable LPASS_AUDIO_CC_BT_SWR_CBCR
  per.set.field &access_mode:0x6BE7000 %long 0x1 0x1 ; Enable LPASS_AUDIO_CC_BUS_CBCR
  per.set.field &access_mode:0x6BEE034 %long 0x1 0x1 ; Enable LPASS_AUDIO_CC_BUS_TIMEOUT_CBCR
  per.set.field &access_mode:0x6BEE004 %long 0x1 0x1 ; Enable LPASS_AUDIO_CC_CODEC_MEM0_CBCR
  per.set.field &access_mode:0x6BEE010 %long 0x1 0x1 ; Enable LPASS_AUDIO_CC_CODEC_MEM1_CBCR
  per.set.field &access_mode:0x6BEE01C %long 0x1 0x1 ; Enable LPASS_AUDIO_CC_CODEC_MEM2_CBCR
  per.set.field &access_mode:0x6BEE028 %long 0x1 0x1 ; Enable LPASS_AUDIO_CC_CODEC_MEM3_CBCR
  per.set.field &access_mode:0x6BEE000 %long 0x1 0x1 ; Enable LPASS_AUDIO_CC_CODEC_MEM_CBCR
  per.set.field &access_mode:0x6BF5004 %long 0x1 0x1 ; Enable LPASS_AUDIO_CC_DEBUG_CBCR
  per.set.field &access_mode:0x6BD8020 %long 0x1 0x1 ; Enable LPASS_AUDIO_CC_EXT_IF1_EBIT_CBCR
  per.set.field &access_mode:0x6BD801C %long 0x1 0x1 ; Enable LPASS_AUDIO_CC_EXT_IF1_IBIT_CBCR
  per.set.field &access_mode:0x6BD9020 %long 0x1 0x1 ; Enable LPASS_AUDIO_CC_EXT_IF2_EBIT_CBCR
  per.set.field &access_mode:0x6BD901C %long 0x1 0x1 ; Enable LPASS_AUDIO_CC_EXT_IF2_IBIT_CBCR
  per.set.field &access_mode:0x6BDC020 %long 0x1 0x1 ; Enable LPASS_AUDIO_CC_EXT_IF4_EBIT_CBCR
  per.set.field &access_mode:0x6BDC01C %long 0x1 0x1 ; Enable LPASS_AUDIO_CC_EXT_IF4_IBIT_CBCR
  per.set.field &access_mode:0x6BDD020 %long 0x1 0x1 ; Enable LPASS_AUDIO_CC_EXT_IF5_EBIT_CBCR
  per.set.field &access_mode:0x6BDD01C %long 0x1 0x1 ; Enable LPASS_AUDIO_CC_EXT_IF5_IBIT_CBCR
  per.set.field &access_mode:0x6BE8018 %long 0x1 0x1 ; Enable LPASS_AUDIO_CC_EXT_MCLK0_CBCR
  per.set.field &access_mode:0x6BE9018 %long 0x1 0x1 ; Enable LPASS_AUDIO_CC_EXT_MCLK1_CBCR
  per.set.field &access_mode:0x6BE1018 %long 0x1 0x1 ; Enable LPASS_AUDIO_CC_LPAIF_PCMOE_CBCR
  per.set.field &access_mode:0x6BEC0CC %long 0x1 0x1 ; Enable LPASS_AUDIO_CC_RX_MCLK_2X_CBCR
  per.set.field &access_mode:0x6BEC0D4 %long 0x1 0x1 ; Enable LPASS_AUDIO_CC_RX_MCLK_CBCR
  per.set.field &access_mode:0x6BEC0E4 %long 0x1 0x1 ; Enable LPASS_AUDIO_CC_RX_MCLK_MCLK2_2X_CBCR
  per.set.field &access_mode:0x6BDB000 %long 0x1 0x1 ; Enable LPASS_AUDIO_CC_SAMPLING_CBCR
  per.set.field &access_mode:0x6BD5018 %long 0x1 0x1 ; Enable LPASS_AUDIO_CC_SLIMBUS_CBCR
  per.set.field &access_mode:0x6BD501C %long 0x1 0x1 ; Enable LPASS_AUDIO_CC_SLIMBUS_CORE_CBCR
  per.set.field &access_mode:0x6BEC0DC %long 0x1 0x1 ; Enable LPASS_AUDIO_CC_TX_MCLK_2X_RX_CBCR
  per.set.field &access_mode:0x6BED010 %long 0x1 0x1 ; Enable LPASS_AUDIO_CC_TX_MCLK_2X_WSA2_CBCR
  per.set.field &access_mode:0x6BEA0F0 %long 0x1 0x1 ; Enable LPASS_AUDIO_CC_TX_MCLK_2X_WSA_CBCR
  per.set.field &access_mode:0x6BEC0E0 %long 0x1 0x1 ; Enable LPASS_AUDIO_CC_TX_MCLK_RX_CBCR
  per.set.field &access_mode:0x6BED00C %long 0x1 0x1 ; Enable LPASS_AUDIO_CC_TX_MCLK_WSA2_CBCR
  per.set.field &access_mode:0x6BEA0F4 %long 0x1 0x1 ; Enable LPASS_AUDIO_CC_TX_MCLK_WSA_CBCR
  per.set.field &access_mode:0x6BED000 %long 0x1 0x1 ; Enable LPASS_AUDIO_CC_WSA2_MCLK_2X_CBCR
  per.set.field &access_mode:0x6BEA0E4 %long 0x1 0x1 ; Enable LPASS_AUDIO_CC_WSA2_MCLK_BIT_SRC_CBCR
  per.set.field &access_mode:0x6BED004 %long 0x1 0x1 ; Enable LPASS_AUDIO_CC_WSA2_MCLK_CBCR
  per.set.field &access_mode:0x6BEA0CC %long 0x1 0x1 ; Enable LPASS_AUDIO_CC_WSA_MCLK_2X_CBCR
  per.set.field &access_mode:0x6BEA0D8 %long 0x1 0x1 ; Enable LPASS_AUDIO_CC_WSA_MCLK_BIT_SRC_CBCR
  per.set.field &access_mode:0x6BEA0D4 %long 0x1 0x1 ; Enable LPASS_AUDIO_CC_WSA_MCLK_CBCR
  per.set.field &access_mode:0x6BDB004 %long 0x1 0x1 ; Enable LPASS_AUDIO_CC_XO_CBCR
  per.set.field &access_mode:0x6BD1000 %long 0x1 0x1 ; Enable LPASS_AUDIO_CC_XPU2_CLIENT_CBCR

)


if ("&subsystem"=="lpass_core_cc"||"&subsystem"=="all")
(
  per.set.field &access_mode:0x7E00000 %long 0x1 0x0 ; Enable LPASS_LPASS_CORE_HM_GDSCR


  per.set.field &access_mode:0x7B1D014 %long 0x1 0x1 ; Enable LPASS_LPASS_CORE_CC_AVSYNC_ATIME_CBCR
  per.set.field &access_mode:0x7B24000 %long 0x1 0x1 ; Enable LPASS_LPASS_CORE_CC_AVSYNC_STC_CBCR
  per.set.field &access_mode:0x7B43000 %long 0x1 0x1 ; Enable LPASS_LPASS_CORE_CC_BUS_TIMEOUT_CORE_CBCR
  per.set.field &access_mode:0x7B27000 %long 0x1 0x1 ; Enable LPASS_LPASS_CORE_CC_CORE_CBCR
  per.set.field &access_mode:0x7B56008 %long 0x1 0x1 ; Enable LPASS_LPASS_CORE_CC_DEBUG_CBCR
  per.set.field &access_mode:0x7B1801C %long 0x1 0x1 ; Enable LPASS_LPASS_CORE_CC_EXT_IF0_EBIT_CBCR
  per.set.field &access_mode:0x7B18018 %long 0x1 0x1 ; Enable LPASS_LPASS_CORE_CC_EXT_IF0_IBIT_CBCR
  per.set.field &access_mode:0x7B1901C %long 0x1 0x1 ; Enable LPASS_LPASS_CORE_CC_EXT_IF1_EBIT_CBCR
  per.set.field &access_mode:0x7B19018 %long 0x1 0x1 ; Enable LPASS_LPASS_CORE_CC_EXT_IF1_IBIT_CBCR
  per.set.field &access_mode:0x7B1A01C %long 0x1 0x1 ; Enable LPASS_LPASS_CORE_CC_EXT_IF2_EBIT_CBCR
  per.set.field &access_mode:0x7B1A018 %long 0x1 0x1 ; Enable LPASS_LPASS_CORE_CC_EXT_IF2_IBIT_CBCR
  per.set.field &access_mode:0x7B28014 %long 0x1 0x1 ; Enable LPASS_LPASS_CORE_CC_EXT_MCLK0_CBCR
  per.set.field &access_mode:0x7B29014 %long 0x1 0x1 ; Enable LPASS_LPASS_CORE_CC_EXT_MCLK1_CBCR
  per.set.field &access_mode:0x7B48014 %long 0x1 0x1 ; Enable LPASS_LPASS_CORE_CC_HW_AF_CBCR
  per.set.field &access_mode:0x7B48024 %long 0x1 0x1 ; Enable LPASS_LPASS_CORE_CC_HW_AF_NOC_CBCR
  per.set.field &access_mode:0x7B26000 %long 0x1 0x1 ; Enable LPASS_LPASS_CORE_CC_LPM_CORE_CBCR
  per.set.field &access_mode:0x7B26004 %long 0x1 0x1 ; Enable LPASS_LPASS_CORE_CC_LPM_MEM0_CORE_CBCR
  per.set.field &access_mode:0x7B21014 %long 0x1 0x1 ; Enable LPASS_LPASS_CORE_CC_PCMOE_CBCR
  per.set.field &access_mode:0x7B56014 %long 0x1 0x1 ; Enable LPASS_LPASS_CORE_CC_PLL_TEST_CBCR
  per.set.field &access_mode:0x7B2D000 %long 0x1 0x1 ; Enable LPASS_LPASS_CORE_CC_Q6SS_AXIM2_CORE_CBCR
  per.set.field &access_mode:0x7B1E014 %long 0x1 0x1 ; Enable LPASS_LPASS_CORE_CC_RESAMPLER_CBCR
  per.set.field &access_mode:0x7B13008 %long 0x1 0x1 ; Enable LPASS_LPASS_CORE_CC_SAMPLING_CBCR
  per.set.field &access_mode:0x7B22008 %long 0x1 0x1 ; Enable LPASS_LPASS_CORE_CC_SLEEP_CBCR
  per.set.field &access_mode:0x7B2B000 %long 0x1 0x1 ; Enable LPASS_LPASS_CORE_CC_SYSNOC_MPORT_CORE_CBCR
  per.set.field &access_mode:0x7B2C000 %long 0x1 0x1 ; Enable LPASS_LPASS_CORE_CC_SYSNOC_SWAY_CORE_CBCR
  per.set.field &access_mode:0x7B1300C %long 0x1 0x1 ; Enable LPASS_LPASS_CORE_CC_XO_CBCR
  per.set.field &access_mode:0x7E06000 %long 0x1 0x1 ; Enable LPASS_LPASS_TOP_CC_AGGNOC_LS_CBCR
  per.set.field &access_mode:0x7E07000 %long 0x1 0x1 ; Enable LPASS_LPASS_TOP_CC_AGGNOC_MPU_LS_CBCR
  per.set.field &access_mode:0x7E09000 %long 0x1 0x1 ; Enable LPASS_LPASS_TOP_CC_LPASS_CORE_SWAY_AHB_LS_CBCR
  per.set.field &access_mode:0x7E06008 %long 0x1 0x1 ; Enable LPASS_LPASS_TOP_CC_LPI_AGGNOC_LS_CBCR

)


if ("&subsystem"=="lpass_lpmla_cc"||"&subsystem"=="all")
(


  per.set.field &access_mode:0x6E48010 %long 0x1 0x1 ; Enable LPASS_LPMLA_CC_BUS_CBCR
  per.set.field &access_mode:0x6E483EC %long 0x1 0x1 ; Enable LPASS_LPMLA_CC_DEBUG_CBCR
  per.set.field &access_mode:0x6E4A0FC %long 0x1 0x1 ; Enable LPASS_LPMLA_CC_LPASS_0_LPMLA_CBCR
  per.set.field &access_mode:0x6E4B124 %long 0x1 0x1 ; Enable LPASS_LPMLA_CC_LPASS_1_LPMLA_CBCR
  per.set.field &access_mode:0x6E48008 %long 0x1 0x1 ; Enable LPASS_LPMLA_CC_XO_CBCR

)


if ("&subsystem"=="lpicc"||"&subsystem"=="all")
(
  per.set.field &access_mode:0x24320650 %long 0x1 0x0 ; Enable LPICC_LPINOC_GDSCR
  per.set.field &access_mode:0x24320618 %long 0x1 0x0 ; Enable LPICC_LPI_LB_GDSCR


  per.set.field &access_mode:0x24320604 %long 0x1 0x1 ; Enable LPICC_CFG_CBCR
  per.set.field &access_mode:0x243200D0 %long 0x1 0x1 ; Enable LPICC_DEBUG_CBCR
  per.set.field &access_mode:0x24320610 %long 0x1 0x1 ; Enable LPICC_LPASS_AON_NOC_CBCR
  per.set.field &access_mode:0x2432060C %long 0x1 0x1 ; Enable LPICC_LPASS_LPINOC_CBCR
  per.set.field &access_mode:0x24323000 %long 0x1 0x1 ; Enable LPICC_LPINOC_ATB_CBCR
  per.set.field &access_mode:0x24320690 %long 0x1 0x1 ; Enable LPICC_LPINOC_CBCR
  per.set.field &access_mode:0x24320698 %long 0x1 0x1 ; Enable LPICC_LPINOC_CFG_CBCR
  per.set.field &access_mode:0x24320694 %long 0x1 0x1 ; Enable LPICC_LPINOC_PWRCTL_CBCR
  per.set.field &access_mode:0x243206A0 %long 0x1 0x1 ; Enable LPICC_LPINOC_XO_CBCR
  per.set.field &access_mode:0x2432062C %long 0x1 0x1 ; Enable LPICC_LPI_LB0_LPINOC_CBCR
  per.set.field &access_mode:0x24320630 %long 0x1 0x1 ; Enable LPICC_LPI_LB1_LPINOC_CBCR
  per.set.field &access_mode:0x24320634 %long 0x1 0x1 ; Enable LPICC_LPI_LB2_LPINOC_CBCR
  per.set.field &access_mode:0x24320638 %long 0x1 0x1 ; Enable LPICC_LPI_LB3_LPINOC_CBCR
  per.set.field &access_mode:0x24320648 %long 0x1 0x1 ; Enable LPICC_LPI_LB_CFG_CBCR
  per.set.field &access_mode:0x24320644 %long 0x1 0x1 ; Enable LPICC_LPI_LB_CH13_CFG_CBCR
  per.set.field &access_mode:0x24320640 %long 0x1 0x1 ; Enable LPICC_LPI_LB_CH13_PWRCTL_CBCR
  per.set.field &access_mode:0x2432063C %long 0x1 0x1 ; Enable LPICC_LPI_LB_PWRCTL_CBCR
  per.set.field &access_mode:0x243205F8 %long 0x1 0x1 ; Enable LPICC_XO_CBCR
  per.set.field &access_mode:0x243205FC %long 0x1 0x1 ; Enable LPICC_XO_DIV_16_CBCR

)


if ("&subsystem"=="mss_cc"||"&subsystem"=="all")
(


  per.set.field &access_mode:0x41AF418 %long 0x1 0x1 ; Enable MSS_CC_AXI_CRYPTO_CBCR
  per.set.field &access_mode:0x41AF410 %long 0x1 0x1 ; Enable MSS_CC_AXI_OFFLINE_CBCR
  per.set.field &access_mode:0x41AF534 %long 0x1 0x1 ; Enable MSS_CC_BIT_COXM2_CBCR
  per.set.field &access_mode:0x41AF54C %long 0x1 0x1 ; Enable MSS_CC_BIT_COXM_CBCR
  per.set.field &access_mode:0x41AF430 %long 0x1 0x1 ; Enable MSS_CC_BUS_CONFIG_CBCR
  per.set.field &access_mode:0x41AF44C %long 0x1 0x1 ; Enable MSS_CC_BUS_COXM2_CBCR
  per.set.field &access_mode:0x41AF440 %long 0x1 0x1 ; Enable MSS_CC_BUS_COXM_CBCR
  per.set.field &access_mode:0x41AF484 %long 0x1 0x1 ; Enable MSS_CC_BUS_CRYPTO_CBCR
  per.set.field &access_mode:0x41AF490 %long 0x1 0x1 ; Enable MSS_CC_BUS_GERAN_ENCRYPT_ACC_CBCR
  per.set.field &access_mode:0x41AF494 %long 0x1 0x1 ; Enable MSS_CC_BUS_NAV_CBCR
  per.set.field &access_mode:0x41AF47C %long 0x1 0x1 ; Enable MSS_CC_BUS_OFFLINE_CBCR
  per.set.field &access_mode:0x41AF498 %long 0x1 0x1 ; Enable MSS_CC_BUS_Q6_ALT_CBCR
  per.set.field &access_mode:0x41AF470 %long 0x1 0x1 ; Enable MSS_CC_BUS_Q6_CBCR
  per.set.field &access_mode:0x41AF434 %long 0x1 0x1 ; Enable MSS_CC_BUS_RFC_CBCR
  per.set.field &access_mode:0x41AF49C %long 0x1 0x1 ; Enable MSS_CC_BUS_RSCC_CBCR
  per.set.field &access_mode:0x41AF480 %long 0x1 0x1 ; Enable MSS_CC_BUS_STMR_CBCR
  per.set.field &access_mode:0x41AF474 %long 0x1 0x1 ; Enable MSS_CC_BUS_TIMEOUT_CBCR
  per.set.field &access_mode:0x41AF458 %long 0x1 0x1 ; Enable MSS_CC_BUS_UIM0_CBCR
  per.set.field &access_mode:0x41AF464 %long 0x1 0x1 ; Enable MSS_CC_BUS_UIM1_CBCR
  per.set.field &access_mode:0x41AF478 %long 0x1 0x1 ; Enable MSS_CC_BUS_VQ6SS_CBCR
  per.set.field &access_mode:0x41AF4E8 %long 0x1 0x1 ; Enable MSS_CC_CARD_SRC_UIM0_CBCR
  per.set.field &access_mode:0x41AF4EC %long 0x1 0x1 ; Enable MSS_CC_CARD_SRC_UIM1_CBCR
  per.set.field &access_mode:0x41AF4A8 %long 0x1 0x1 ; Enable MSS_CC_DRAGON_CBCR
  per.set.field &access_mode:0x41AF558 %long 0x1 0x1 ; Enable MSS_CC_OFFLINE_AUX_CBCR
  per.set.field &access_mode:0x41AF41C %long 0x1 0x1 ; Enable MSS_CC_Q6VQ6_AXIM1_CBCR
  per.set.field &access_mode:0x41AF4CC %long 0x1 0x1 ; Enable MSS_CC_RFFE_2XO_CBCR
  per.set.field &access_mode:0x41AF4C4 %long 0x1 0x1 ; Enable MSS_CC_RFFE_4XO_CBCR
  per.set.field &access_mode:0x41AF4D4 %long 0x1 0x1 ; Enable MSS_CC_RFFE_XO_CBCR
  per.set.field &access_mode:0x41AF4B8 %long 0x1 0x1 ; Enable MSS_CC_TCM_OFFLINE_CBCR
  per.set.field &access_mode:0x41AF4B4 %long 0x1 0x1 ; Enable MSS_CC_TCM_Q6_CBCR
  per.set.field &access_mode:0x41AF504 %long 0x1 0x1 ; Enable MSS_CC_UART_BIT_UIM0_CBCR
  per.set.field &access_mode:0x41AF51C %long 0x1 0x1 ; Enable MSS_CC_UART_BIT_UIM1_CBCR
  per.set.field &access_mode:0x41AF400 %long 0x1 0x1 ; Enable MSS_CC_XO_CX_CBCR
  per.set.field &access_mode:0x41AF404 %long 0x1 0x1 ; Enable MSS_CC_XO_CX_Q6_CBCR
  per.set.field &access_mode:0x41AF408 %long 0x1 0x1 ; Enable MSS_CC_XO_CX_VQ6_CBCR
  per.set.field &access_mode:0x41AF40C %long 0x1 0x1 ; Enable MSS_CC_XO_RSCC_CBCR

)


if ("&subsystem"=="mss_q6_cc"||"&subsystem"=="all")
(


  per.set.field &access_mode:0x40C8140 %long 0x1 0x1 ; Enable MSS_QDSP6SS_ACD_XO_CBCR
  per.set.field &access_mode:0x40C8040 %long 0x1 0x1 ; Enable MSS_QDSP6SS_CORE_CBCR
  per.set.field &access_mode:0x40C8168 %long 0x1 0x1 ; Enable MSS_QDSP6SS_DEBUG_CBCR
  per.set.field &access_mode:0x40C80A0 %long 0x1 0x1 ; Enable MSS_QDSP6SS_L2ITCM_SLPGEN_CBCR
  per.set.field &access_mode:0x40C8080 %long 0x1 0x1 ; Enable MSS_QDSP6SS_L2MEM_SLPGEN_CBCR
  per.set.field &access_mode:0x40C80C0 %long 0x1 0x1 ; Enable MSS_QDSP6SS_L2VTCM_SLPGEN_CBCR
  per.set.field &access_mode:0x40C80E0 %long 0x1 0x1 ; Enable MSS_QDSP6SS_MDC_SLPGEN_CBCR
  per.set.field &access_mode:0x40C8120 %long 0x1 0x1 ; Enable MSS_QDSP6SS_MON_CBCR
  per.set.field &access_mode:0x40C8060 %long 0x1 0x1 ; Enable MSS_QDSP6SS_SLPGEN_CBCR
  per.set.field &access_mode:0x40806C0 %long 0x1 0x1 ; Enable MSS_QDSP6SS_VEC_CORE_CBCR
  per.set.field &access_mode:0x40806B0 %long 0x1 0x1 ; Enable MSS_QDSP6SS_VEC_VU_CBCR
  per.set.field &access_mode:0x44006C0 %long 0x1 0x1 ; Enable MSS_VQ6_QDSP6SS_VEC_CORE_CBCR
  per.set.field &access_mode:0x44006B0 %long 0x1 0x1 ; Enable MSS_VQ6_QDSP6SS_VEC_VU_CBCR

)


if ("&subsystem"=="nav_cc"||"&subsystem"=="all")
(
  per.set.field &access_mode:0x4818004 %long 0x1 0x0 ; Enable MSS_NAV_CC_NAV_CORE_GDSCR
  per.set.field &access_mode:0x48180D4 %long 0x1 0x0 ; Enable MSS_NAV_CC_NAV_IUSS_GDSCR


  per.set.field &access_mode:0x4818088 %long 0x1 0x1 ; Enable MSS_NAV_CC_ADC1_CBCR
  per.set.field &access_mode:0x48180B8 %long 0x1 0x1 ; Enable MSS_NAV_CC_ADC1_FIFO_WR_CBCR
  per.set.field &access_mode:0x481808C %long 0x1 0x1 ; Enable MSS_NAV_CC_ADC2_CBCR
  per.set.field &access_mode:0x48180BC %long 0x1 0x1 ; Enable MSS_NAV_CC_ADC2_FIFO_WR_CBCR
  per.set.field &access_mode:0x4818090 %long 0x1 0x1 ; Enable MSS_NAV_CC_BP1_CBCR
  per.set.field &access_mode:0x481809C %long 0x1 0x1 ; Enable MSS_NAV_CC_BP2P2_CBCR
  per.set.field &access_mode:0x4818098 %long 0x1 0x1 ; Enable MSS_NAV_CC_BP2P_CBCR
  per.set.field &access_mode:0x4818094 %long 0x1 0x1 ; Enable MSS_NAV_CC_BP2_CBCR
  per.set.field &access_mode:0x48180A0 %long 0x1 0x1 ; Enable MSS_NAV_CC_BP3_CBCR
  per.set.field &access_mode:0x48180A4 %long 0x1 0x1 ; Enable MSS_NAV_CC_BP4_CBCR
  per.set.field &access_mode:0x48180A8 %long 0x1 0x1 ; Enable MSS_NAV_CC_BP5_CBCR
  per.set.field &access_mode:0x48180B0 %long 0x1 0x1 ; Enable MSS_NAV_CC_BP_LB_CBCR
  per.set.field &access_mode:0x48180AC %long 0x1 0x1 ; Enable MSS_NAV_CC_BP_MBS_CBCR
  per.set.field &access_mode:0x4818044 %long 0x1 0x1 ; Enable MSS_NAV_CC_CP_CBCR
  per.set.field &access_mode:0x48180F4 %long 0x1 0x1 ; Enable MSS_NAV_CC_DBE_SYS_TO_IUSS_CBCR
  per.set.field &access_mode:0x48180B4 %long 0x1 0x1 ; Enable MSS_NAV_CC_DFE_DBG_CBCR
  per.set.field &access_mode:0x4818084 %long 0x1 0x1 ; Enable MSS_NAV_CC_DFE_SYS_CBCR
  per.set.field &access_mode:0x4818068 %long 0x1 0x1 ; Enable MSS_NAV_CC_DMA_AHB2AXI_CBCR
  per.set.field &access_mode:0x4818048 %long 0x1 0x1 ; Enable MSS_NAV_CC_DMA_CBCR
  per.set.field &access_mode:0x481804C %long 0x1 0x1 ; Enable MSS_NAV_CC_DP_CBCR
  per.set.field &access_mode:0x481805C %long 0x1 0x1 ; Enable MSS_NAV_CC_GNSS_5G_CAPTURE_CBCR
  per.set.field &access_mode:0x48180E8 %long 0x1 0x1 ; Enable MSS_NAV_CC_IUSS_PDMEM_CBCR
  per.set.field &access_mode:0x48180C8 %long 0x1 0x1 ; Enable MSS_NAV_CC_MODEM_RAW_STMR_CBCR
  per.set.field &access_mode:0x4818040 %long 0x1 0x1 ; Enable MSS_NAV_CC_NAV_SYS_CBCR
  per.set.field &access_mode:0x4818064 %long 0x1 0x1 ; Enable MSS_NAV_CC_NAV_SYS_DBG_CBCR
  per.set.field &access_mode:0x48180C0 %long 0x1 0x1 ; Enable MSS_NAV_CC_SNOC_CBCR
  per.set.field &access_mode:0x4818060 %long 0x1 0x1 ; Enable MSS_NAV_CC_SNOC_DBG_CBCR
  per.set.field &access_mode:0x48180C4 %long 0x1 0x1 ; Enable MSS_NAV_CC_STMR_XO_CBCR
  per.set.field &access_mode:0x48180F8 %long 0x1 0x1 ; Enable MSS_NAV_CC_STMR_XO_TO_IUSS_CBCR
  per.set.field &access_mode:0x4818050 %long 0x1 0x1 ; Enable MSS_NAV_CC_UMEM_CBCR
  per.set.field &access_mode:0x48180CC %long 0x1 0x1 ; Enable MSS_NAV_CC_XO_SRC_CBCR

)


if ("&subsystem"=="scc"||"&subsystem"=="all")
(


  per.set.field &access_mode:0x7A01024 %long 0x1 0x1 ; Enable SSC_SCC_AHB2AHB_M_CBCR
  per.set.field &access_mode:0x7A01020 %long 0x1 0x1 ; Enable SSC_SCC_AHB2AHB_S_CBCR
  per.set.field &access_mode:0x7A01040 %long 0x1 0x1 ; Enable SSC_SCC_AHB_TIMEOUT_CBCR
  per.set.field &access_mode:0x7A0201C %long 0x1 0x1 ; Enable SSC_SCC_CCD_AHB2AHB_M_CBCR
  per.set.field &access_mode:0x7A0106C %long 0x1 0x1 ; Enable SSC_SCC_CCD_AHB2AHB_S_CBCR
  per.set.field &access_mode:0x7A02020 %long 0x1 0x1 ; Enable SSC_SCC_CCD_CBCR
  per.set.field &access_mode:0x7A02028 %long 0x1 0x1 ; Enable SSC_SCC_CCD_DBG_CBCR
  per.set.field &access_mode:0x7A02024 %long 0x1 0x1 ; Enable SSC_SCC_CCD_HCLK_CBCR
  per.set.field &access_mode:0x7A0101C %long 0x1 0x1 ; Enable SSC_SCC_CRIF_CBCR
  per.set.field &access_mode:0x7A01028 %long 0x1 0x1 ; Enable SSC_SCC_CSR_H_CBCR
  per.set.field &access_mode:0x7A0A084 %long 0x1 0x1 ; Enable SSC_SCC_DEBUG_CBCR
  per.set.field &access_mode:0x7A10018 %long 0x1 0x1 ; Enable SSC_SCC_GPIO_CBCR
  per.set.field &access_mode:0x7A01064 %long 0x1 0x1 ; Enable SSC_SCC_IBI_AHB2AHB_S_CBCR
  per.set.field &access_mode:0x7A01054 %long 0x1 0x1 ; Enable SSC_SCC_MPU_CLIENT_CBCR
  per.set.field &access_mode:0x7A0105C %long 0x1 0x1 ; Enable SSC_SCC_MPU_CONFIG_CBCR
  per.set.field &access_mode:0x7A0301C %long 0x1 0x1 ; Enable SSC_SCC_QUPV3_2XCORE_CBCR
  per.set.field &access_mode:0x7A0302C %long 0x1 0x1 ; Enable SSC_SCC_QUPV3_CORE_CBCR
  per.set.field &access_mode:0x7A0104C %long 0x1 0x1 ; Enable SSC_SCC_QUPV3_M_HCLK_CBCR
  per.set.field &access_mode:0x7A04130 %long 0x1 0x1 ; Enable SSC_SCC_QUPV3_SE0_CBCR
  per.set.field &access_mode:0x7A0E130 %long 0x1 0x1 ; Enable SSC_SCC_QUPV3_SE10_CBCR
  per.set.field &access_mode:0x7A05130 %long 0x1 0x1 ; Enable SSC_SCC_QUPV3_SE1_CBCR
  per.set.field &access_mode:0x7A06130 %long 0x1 0x1 ; Enable SSC_SCC_QUPV3_SE2_CBCR
  per.set.field &access_mode:0x7A07130 %long 0x1 0x1 ; Enable SSC_SCC_QUPV3_SE3_CBCR
  per.set.field &access_mode:0x7A08130 %long 0x1 0x1 ; Enable SSC_SCC_QUPV3_SE4_CBCR
  per.set.field &access_mode:0x7A09130 %long 0x1 0x1 ; Enable SSC_SCC_QUPV3_SE5_CBCR
  per.set.field &access_mode:0x7A0A130 %long 0x1 0x1 ; Enable SSC_SCC_QUPV3_SE6_CBCR
  per.set.field &access_mode:0x7A0B130 %long 0x1 0x1 ; Enable SSC_SCC_QUPV3_SE7_CBCR
  per.set.field &access_mode:0x7A0C130 %long 0x1 0x1 ; Enable SSC_SCC_QUPV3_SE8_CBCR
  per.set.field &access_mode:0x7A0D130 %long 0x1 0x1 ; Enable SSC_SCC_QUPV3_SE9_CBCR
  per.set.field &access_mode:0x7A01048 %long 0x1 0x1 ; Enable SSC_SCC_QUPV3_S_HCLK_CBCR
  per.set.field &access_mode:0x7A0F004 %long 0x1 0x1 ; Enable SSC_SCC_SLEEP_CBCR
  per.set.field &access_mode:0x7A01030 %long 0x1 0x1 ; Enable SSC_SCC_SMEM_CBCR

)


if ("&subsystem"=="tcsr_cc"||"&subsystem"=="all")
(



)


if ("&subsystem"=="tme_cc"||"&subsystem"=="all")
(
  per.set.field &access_mode:0x221E42A4 %long 0x1 0x0 ; Enable TME_CC_TME_HW_LAYER_GDSCR


  per.set.field &access_mode:0x221E4A7C %long 0x1 0x1 ; Enable TME_CC_AHB_CBCR
  per.set.field &access_mode:0x221E4450 %long 0x1 0x1 ; Enable TME_CC_APB_CBCR
  per.set.field &access_mode:0x221E4454 %long 0x1 0x1 ; Enable TME_CC_AT_CBCR
  per.set.field &access_mode:0x221E4290 %long 0x1 0x1 ; Enable TME_CC_CNOC_BRIDGE_CBCR
  per.set.field &access_mode:0x221E429C %long 0x1 0x1 ; Enable TME_CC_CNOC_BRIDGE_CPU_XPU4_CBCR
  per.set.field &access_mode:0x221E4154 %long 0x1 0x1 ; Enable TME_CC_CPU_BUS_CBCR
  per.set.field &access_mode:0x221E4140 %long 0x1 0x1 ; Enable TME_CC_CPU_CORE_COMPLEX_CBCR
  per.set.field &access_mode:0x221E4144 %long 0x1 0x1 ; Enable TME_CC_CPU_CORE_DEBUG_CBCR
  per.set.field &access_mode:0x221E415C %long 0x1 0x1 ; Enable TME_CC_CPU_ROM_XO_CBCR
  per.set.field &access_mode:0x221E4158 %long 0x1 0x1 ; Enable TME_CC_CPU_RTC_CBCR
  per.set.field &access_mode:0x221E4148 %long 0x1 0x1 ; Enable TME_CC_CPU_SRAM_QTIMER_INTC_CBCR
  per.set.field &access_mode:0x221E4A78 %long 0x1 0x1 ; Enable TME_CC_CRI_CM_CBCR
  per.set.field &access_mode:0x221E5004 %long 0x1 0x1 ; Enable TME_CC_DEBUG_CBCR
  per.set.field &access_mode:0x221E4930 %long 0x1 0x1 ; Enable TME_CC_FUSE_CTRL_CBCR
  per.set.field &access_mode:0x221E4940 %long 0x1 0x1 ; Enable TME_CC_FUSE_CTRL_DEBUG_VECTOR_CBCR
  per.set.field &access_mode:0x221E4934 %long 0x1 0x1 ; Enable TME_CC_FUSE_CTRL_LOCAL_DIG_CBCR
  per.set.field &access_mode:0x221E4408 %long 0x1 0x1 ; Enable TME_CC_HSDMA_CBCR
  per.set.field &access_mode:0x221E444C %long 0x1 0x1 ; Enable TME_CC_HW_LAYER_AHB_BRIDGE_CBCR
  per.set.field &access_mode:0x221E43E8 %long 0x1 0x1 ; Enable TME_CC_HW_LAYER_AHB_CBCR
  per.set.field &access_mode:0x221E43F4 %long 0x1 0x1 ; Enable TME_CC_HW_LAYER_CSR_CBCR
  per.set.field &access_mode:0x221E43F8 %long 0x1 0x1 ; Enable TME_CC_HW_LAYER_DEBUG_CBCR
  per.set.field &access_mode:0x221E43F0 %long 0x1 0x1 ; Enable TME_CC_HW_LAYER_RSC_CBCR
  per.set.field &access_mode:0x221E43EC %long 0x1 0x1 ; Enable TME_CC_HW_LAYER_XPU_CBCR
  per.set.field &access_mode:0x221E441C %long 0x1 0x1 ; Enable TME_CC_INFIFO_0_CBCR
  per.set.field &access_mode:0x221E4428 %long 0x1 0x1 ; Enable TME_CC_INFIFO_1_CBCR
  per.set.field &access_mode:0x221E43FC %long 0x1 0x1 ; Enable TME_CC_KEYTABLE_CBCR
  per.set.field &access_mode:0x221E4458 %long 0x1 0x1 ; Enable TME_CC_KEYTABLE_DIV_CBCR
  per.set.field &access_mode:0x221E4434 %long 0x1 0x1 ; Enable TME_CC_OUTFIFO_0_CBCR
  per.set.field &access_mode:0x221E4440 %long 0x1 0x1 ; Enable TME_CC_OUTFIFO_1_CBCR
  per.set.field &access_mode:0x221E46C0 %long 0x1 0x1 ; Enable TME_CC_PKA_CBCR
  per.set.field &access_mode:0x221E47F8 %long 0x1 0x1 ; Enable TME_CC_PRNG_CBCR
  per.set.field &access_mode:0x221E4134 %long 0x1 0x1 ; Enable TME_CC_RVSS_SS_CBCR
  per.set.field &access_mode:0x221E4588 %long 0x1 0x1 ; Enable TME_CC_SEQ_CORE_CBCR
  per.set.field &access_mode:0x221E47FC %long 0x1 0x1 ; Enable TME_CC_SEQ_ROM_XO_CBCR
  per.set.field &access_mode:0x221E4CDC %long 0x1 0x1 ; Enable TME_CC_SLEEP_CBCR
  per.set.field &access_mode:0x221E4944 %long 0x1 0x1 ; Enable TME_CC_SP_FUSE_CTRL_CBCR
  per.set.field &access_mode:0x221E440C %long 0x1 0x1 ; Enable TME_CC_SYMM_CRYPTO_0_CBCR
  per.set.field &access_mode:0x221E4414 %long 0x1 0x1 ; Enable TME_CC_SYMM_CRYPTO_0_LIB_CBCR
  per.set.field &access_mode:0x221E4410 %long 0x1 0x1 ; Enable TME_CC_SYMM_CRYPTO_1_CBCR
  per.set.field &access_mode:0x221E4418 %long 0x1 0x1 ; Enable TME_CC_SYMM_CRYPTO_1_LIB_CBCR
  per.set.field &access_mode:0x221E4BAC %long 0x1 0x1 ; Enable TME_CC_XO_CBCR
  per.set.field &access_mode:0x221E4CE4 %long 0x1 0x1 ; Enable TME_CC_XO_DIV_CBCR

)


if ("&subsystem"=="turing_cc"||"&subsystem"=="all")
(
  per.set.field &access_mode:0x32008200 %long 0x1 0x0 ; Enable TURING_NSPAUX_GDSCR


  per.set.field &access_mode:0x32008218 %long 0x1 0x1 ; Enable TURING_CENG_AHBS_CBCR
  per.set.field &access_mode:0x32008220 %long 0x1 0x1 ; Enable TURING_CENG_CBCR
  per.set.field &access_mode:0x32009008 %long 0x1 0x1 ; Enable TURING_DEBUG_CBCR
  per.set.field &access_mode:0x32008044 %long 0x1 0x1 ; Enable TURING_NSPAUX_ACCU_XO_CBCR
  per.set.field &access_mode:0x32008040 %long 0x1 0x1 ; Enable TURING_NSPAUX_XO_CBCR
  per.set.field &access_mode:0x3200821C %long 0x1 0x1 ; Enable TURING_NSPNOC_AHBS_CBCR
  per.set.field &access_mode:0x32008240 %long 0x1 0x1 ; Enable TURING_NSPNOC_APB_CBCR
  per.set.field &access_mode:0x3200823C %long 0x1 0x1 ; Enable TURING_NSPNOC_ATB_CBCR
  per.set.field &access_mode:0x3200822C %long 0x1 0x1 ; Enable TURING_NSPNOC_CBCR
  per.set.field &access_mode:0x32009018 %long 0x1 0x1 ; Enable TURING_PLL_TEST_CBCR
  per.set.field &access_mode:0x32008410 %long 0x1 0x1 ; Enable TURING_Q6SS_AHBM_AON_CBCR
  per.set.field &access_mode:0x32008414 %long 0x1 0x1 ; Enable TURING_Q6SS_AHBS_AON_CBCR
  per.set.field &access_mode:0x32008418 %long 0x1 0x1 ; Enable TURING_Q6SS_ALT_RESET_AON_CBCR
  per.set.field &access_mode:0x3200843C %long 0x1 0x1 ; Enable TURING_Q6SS_LLM_CURR_SSC_CBCR
  per.set.field &access_mode:0x32008438 %long 0x1 0x1 ; Enable TURING_Q6SS_LLM_TEMP_SSC_CBCR
  per.set.field &access_mode:0x32008424 %long 0x1 0x1 ; Enable TURING_Q6SS_LMH_CBCR
  per.set.field &access_mode:0x32008404 %long 0x1 0x1 ; Enable TURING_Q6SS_Q6_AXIM_CBCR
  per.set.field &access_mode:0x3200800C %long 0x1 0x1 ; Enable TURING_TURING_WRAPPER_AON_CBCR
  per.set.field &access_mode:0x32008014 %long 0x1 0x1 ; Enable TURING_TURING_WRAPPER_BUS_TIMEOUT_AON_CBCR
  per.set.field &access_mode:0x32008010 %long 0x1 0x1 ; Enable TURING_TURING_WRAPPER_CNOC_SWAY_AON_CBCR
  per.set.field &access_mode:0x32008018 %long 0x1 0x1 ; Enable TURING_TURING_WRAPPER_RSCC_AON_CBCR
  per.set.field &access_mode:0x32008050 %long 0x1 0x1 ; Enable TURING_XO_CBCR
  per.set.field &access_mode:0x32008058 %long 0x1 0x1 ; Enable TURING_XO_CDIV_CBCR

)


if ("&subsystem"=="turing_q6_cc"||"&subsystem"=="all")
(


  per.set.field &access_mode:0x32348188 %long 0x1 0x1 ; Enable TURING_QDSP6SS_ACD_AHBS_CBCR
  per.set.field &access_mode:0x323481C8 %long 0x1 0x1 ; Enable TURING_QDSP6SS_ACD_SCAN_CBCR
  per.set.field &access_mode:0x32348120 %long 0x1 0x1 ; Enable TURING_QDSP6SS_ACD_XO_CBCR
  per.set.field &access_mode:0x32348040 %long 0x1 0x1 ; Enable TURING_QDSP6SS_CORE_CBCR
  per.set.field &access_mode:0x32348148 %long 0x1 0x1 ; Enable TURING_QDSP6SS_DEBUG_CBCR
  per.set.field &access_mode:0x323480A0 %long 0x1 0x1 ; Enable TURING_QDSP6SS_L2ITCM_SLPGEN_CBCR
  per.set.field &access_mode:0x32348080 %long 0x1 0x1 ; Enable TURING_QDSP6SS_L2MEM_SLPGEN_CBCR
  per.set.field &access_mode:0x323480C0 %long 0x1 0x1 ; Enable TURING_QDSP6SS_L2VTCM_SLPGEN_CBCR
  per.set.field &access_mode:0x32348100 %long 0x1 0x1 ; Enable TURING_QDSP6SS_MON_CBCR
  per.set.field &access_mode:0x32348168 %long 0x1 0x1 ; Enable TURING_QDSP6SS_PLL_AHBS_CBCR
  per.set.field &access_mode:0x32348060 %long 0x1 0x1 ; Enable TURING_QDSP6SS_SLPGEN_CBCR

)


if ("&subsystem"=="video_cc"||"&subsystem"=="all")
(
  per.set.field &access_mode:0xAAF804C %long 0x1 0x0 ; Enable VCODEC_VIDEO_CC_MVS0C_GDSCR
  per.set.field &access_mode:0xAAF80A4 %long 0x1 0x0 ; Enable VCODEC_VIDEO_CC_MVS0_GDSCR
  per.set.field &access_mode:0xAAF8078 %long 0x1 0x0 ; Enable VCODEC_VIDEO_CC_MVS1C_GDSCR
  per.set.field &access_mode:0xAAF80CC %long 0x1 0x0 ; Enable VCODEC_VIDEO_CC_MVS1_GDSCR


  per.set.field &access_mode:0xAAF80F4 %long 0x1 0x1 ; Enable VCODEC_VIDEO_CC_AHB_CBCR
  per.set.field &access_mode:0xAAF80FC %long 0x1 0x1 ; Enable VCODEC_VIDEO_CC_DEBUG_CBCR
  per.set.field &access_mode:0xAAF8064 %long 0x1 0x1 ; Enable VCODEC_VIDEO_CC_MVS0C_CBCR
  per.set.field &access_mode:0xAAF8148 %long 0x1 0x1 ; Enable VCODEC_VIDEO_CC_MVS0C_SHIFT_CBCR
  per.set.field &access_mode:0xAAF80B8 %long 0x1 0x1 ; Enable VCODEC_VIDEO_CC_MVS0_CBCR
  per.set.field &access_mode:0xAAF8144 %long 0x1 0x1 ; Enable VCODEC_VIDEO_CC_MVS0_SHIFT_CBCR
  per.set.field &access_mode:0xAAF8090 %long 0x1 0x1 ; Enable VCODEC_VIDEO_CC_MVS1C_CBCR
  per.set.field &access_mode:0xAAF8150 %long 0x1 0x1 ; Enable VCODEC_VIDEO_CC_MVS1C_SHIFT_CBCR
  per.set.field &access_mode:0xAAF80E0 %long 0x1 0x1 ; Enable VCODEC_VIDEO_CC_MVS1_CBCR
  per.set.field &access_mode:0xAAF814C %long 0x1 0x1 ; Enable VCODEC_VIDEO_CC_MVS1_SHIFT_CBCR
  per.set.field &access_mode:0xAAF8108 %long 0x1 0x1 ; Enable VCODEC_VIDEO_CC_PLL_TEST_CBCR
  per.set.field &access_mode:0xAAF8140 %long 0x1 0x1 ; Enable VCODEC_VIDEO_CC_SLEEP_CBCR
  per.set.field &access_mode:0xAAF8124 %long 0x1 0x1 ; Enable VCODEC_VIDEO_CC_XO_CBCR

)


if ("&subsystem"=="wpss"||"&subsystem"=="all")
(


  per.set.field &access_mode:0x8A48020 %long 0x1 0x1 ; Enable WPSS_Q6SS_QDSP6SS_CORE_CBCR
  per.set.field &access_mode:0x8A49008 %long 0x1 0x1 ; Enable WPSS_Q6SS_QDSP6SS_DEBUG_CBCR
  per.set.field &access_mode:0x8A48060 %long 0x1 0x1 ; Enable WPSS_Q6SS_QDSP6SS_MON_CBCR
  per.set.field &access_mode:0x8A006C0 %long 0x1 0x1 ; Enable WPSS_Q6SS_QDSP6SS_VEC_CORE_CBCR
  per.set.field &access_mode:0x8A006B0 %long 0x1 0x1 ; Enable WPSS_Q6SS_QDSP6SS_VEC_VU_CBCR

)

