#include <limits.h>
&soc { 
  OEMInfo { 
    compatible = "qcom,oeminfo";
    /*This order is strictly relevant to the internal functionality of the driver 
    *and is not pertinent information to the user. This is because the driver, 
    *in its current state, cannot support more than one input type simultaneously.
    *There are considerations for future versions of the driver to support such 
    *functionality, if requested. But as delivered, a declaration of more than one 
    *"OEMDevice" in the DT file will cause a failure of the driver's initialization
    */
    OEMDevices { 
      SOCGpio{
        Gpio = <124 125 126 127>;
        OEMVariant = <UINT_MAX UCHAR_MAX 0 1 2 3 4 5 6 7 8 9>;
      };
    };
  };
};
