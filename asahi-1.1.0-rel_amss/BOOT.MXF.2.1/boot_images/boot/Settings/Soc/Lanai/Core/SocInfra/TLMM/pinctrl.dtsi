#include "gpio-dt.h"

&tlmm {
#if 0
  qup2_se0_l0: qup2_se0_l0 {
    mux = <0 1>;
  };
  ibi_i3c_qup2_se0_sda: ibi_i3c_qup2_se0_sda {
    mux = <0 2>;
  };
  phase_flag_status_loc_0: phase_flag_status_loc_0 {
    mux = <0 3>;
  };
  dbg_bus_out_loca_0: dbg_bus_out_loca_0 {
    mux = <0 4>;
  };
  qup2_se0_l1: qup2_se0_l1 {
    mux = <1 1>;
  };
  ibi_i3c_qup2_se0_scl: ibi_i3c_qup2_se0_scl {
    mux = <1 2>;
  };
  phase_flag_status_loc_1: phase_flag_status_loc_1 {
    mux = <1 3>;
  };
  dbg_bus_out_loca_1: dbg_bus_out_loca_1 {
    mux = <1 4>;
  };
  qup2_se0_l2: qup2_se0_l2 {
    mux = <2 1>;
  };
  qup2_se0_l3: qup2_se0_l3 {
    mux = <3 1>;
  };
  phase_flag_status_loc_2: phase_flag_status_loc_2 {
    mux = <3 2>;
  };
  dbg_bus_out_loca_2: dbg_bus_out_loca_2 {
    mux = <3 3>;
  };
  qdss_gpio_tracedata_locb_6: qdss_gpio_tracedata_locb_6 {
    mux = <3 4>;
  };
  qup2_se1_l0: qup2_se1_l0 {
    mux = <4 1>;
  };
  ibi_i3c_qup2_se1_sda: ibi_i3c_qup2_se1_sda {
    mux = <4 2>;
  };
  phase_flag_status_loc_3: phase_flag_status_loc_3 {
    mux = <4 3>;
  };
  dbg_bus_out_loca_3: dbg_bus_out_loca_3 {
    mux = <4 4>;
  };
  qup2_se1_l1: qup2_se1_l1 {
    mux = <5 1>;
  };
  ibi_i3c_qup2_se1_scl: ibi_i3c_qup2_se1_scl {
    mux = <5 2>;
  };
  phase_flag_status_loc_4: phase_flag_status_loc_4 {
    mux = <5 3>;
  };
  dbg_bus_out_loca_4: dbg_bus_out_loca_4 {
    mux = <5 4>;
  };
  qup2_se1_l2: qup2_se1_l2 {
    mux = <6 1>;
  };
  qup2_se1_l3: qup2_se1_l3 {
    mux = <7 1>;
  };
  phase_flag_status_loc_5: phase_flag_status_loc_5 {
    mux = <7 2>;
  };
  dbg_bus_out_loca_5: dbg_bus_out_loca_5 {
    mux = <7 3>;
  };
  qdss_gpio_tracedata_locb_15: qdss_gpio_tracedata_locb_15 {
    mux = <7 4>;
  };
  qup2_se2_l0: qup2_se2_l0 {
    mux = <8 1>;
  };
  ibi_i3c_qup2_se2_sda: ibi_i3c_qup2_se2_sda {
    mux = <8 2>;
  };
  tb_trig_sdc2: tb_trig_sdc2 {
    mux = <8 3>;
  };
  phase_flag_status_loc_6: phase_flag_status_loc_6 {
    mux = <8 4>;
  };
  tgu_ch0_trigout: tgu_ch0_trigout {
    mux = <8 5>;
  };
  dbg_bus_out_loca_6: dbg_bus_out_loca_6 {
    mux = <8 6>;
  };
  qdss_gpio_tracedata_locb_4: qdss_gpio_tracedata_locb_4 {
    mux = <8 7>;
  };
  qup2_se2_l1: qup2_se2_l1 {
    mux = <9 1>;
  };
  ibi_i3c_qup2_se2_scl: ibi_i3c_qup2_se2_scl {
    mux = <9 2>;
  };
  phase_flag_status_loc_7: phase_flag_status_loc_7 {
    mux = <9 3>;
  };
  tgu_ch1_trigout: tgu_ch1_trigout {
    mux = <9 4>;
  };
  dbg_bus_out_loca_7: dbg_bus_out_loca_7 {
    mux = <9 5>;
  };
  qup2_se2_l2: qup2_se2_l2 {
    mux = <10 1>;
  };
  cci_timer2: cci_timer2 {
    mux = <10 2>;
  };
  tgu_ch2_trigout: tgu_ch2_trigout {
    mux = <10 3>;
  };
  qup2_se2_l3: qup2_se2_l3 {
    mux = <11 1>;
  };
  cci_timer3: cci_timer3 {
    mux = <11 2>;
  };
  phase_flag_status_loc_8: phase_flag_status_loc_8 {
    mux = <11 3>;
  };
  tgu_ch3_trigout: tgu_ch3_trigout {
    mux = <11 4>;
  };
  dbg_bus_out_loca_8: dbg_bus_out_loca_8 {
    mux = <11 5>;
  };
  qup2_se3_l0: qup2_se3_l0 {
    mux = <12 1>;
  };
  cci_i2c_sda3: cci_i2c_sda3 {
    mux = <12 2>;
  };
  ibi_i3c_qup2_se3_sda: ibi_i3c_qup2_se3_sda {
    mux = <12 3>;
  };
  qup2_se2_l6: qup2_se2_l6 {
    mux = <12 4>;
  };
  phase_flag_status_loc_9: phase_flag_status_loc_9 {
    mux = <12 5>;
  };
  dbg_bus_out_loca_9: dbg_bus_out_loca_9 {
    mux = <12 6>;
  };
  qup2_se3_l1: qup2_se3_l1 {
    mux = <13 1>;
  };
  cci_i2c_scl3: cci_i2c_scl3 {
    mux = <13 2>;
  };
  ibi_i3c_qup2_se3_scl: ibi_i3c_qup2_se3_scl {
    mux = <13 3>;
  };
  qup2_se2_l4: qup2_se2_l4 {
    mux = <13 4>;
  };
  phase_flag_status_loc_18: phase_flag_status_loc_18 {
    mux = <13 5>;
  };
  dbg_bus_out_loca_18: dbg_bus_out_loca_18 {
    mux = <13 6>;
  };
  qdss_gpio_tracedata_locb_13: qdss_gpio_tracedata_locb_13 {
    mux = <13 7>;
  };
  qup2_se3_l2: qup2_se3_l2 {
    mux = <14 1>;
  };
  qup2_se3_l3: qup2_se3_l3 {
    mux = <15 1>;
  };
  cci_async_in0: cci_async_in0 {
    mux = <15 2>;
  };
  qup2_se2_l5: qup2_se2_l5 {
    mux = <15 3>;
  };
  phase_flag_status_loc_10: phase_flag_status_loc_10 {
    mux = <15 4>;
  };
  dbg_bus_out_loca_10: dbg_bus_out_loca_10 {
    mux = <15 5>;
  };
  qdss_gpio_tracedata_locb_14: qdss_gpio_tracedata_locb_14 {
    mux = <15 6>;
  };
  qup2_se4_l0: qup2_se4_l0 {
    mux = <16 1>;
  };
  phase_flag_status_loc_11: phase_flag_status_loc_11 {
    mux = <16 2>;
  };
  dbg_bus_out_loca_11: dbg_bus_out_loca_11 {
    mux = <16 3>;
  };
  qup2_se4_l1: qup2_se4_l1 {
    mux = <17 1>;
  };
  phase_flag_status_loc_12: phase_flag_status_loc_12 {
    mux = <17 2>;
  };
  dbg_bus_out_loca_12: dbg_bus_out_loca_12 {
    mux = <17 3>;
  };
  qup2_se4_l2: qup2_se4_l2 {
    mux = <18 1>;
  };
  qup2_se4_l3: qup2_se4_l3 {
    mux = <19 1>;
  };
  phase_flag_status_loc_13: phase_flag_status_loc_13 {
    mux = <19 2>;
  };
  dbg_bus_out_loca_13: dbg_bus_out_loca_13 {
    mux = <19 3>;
  };
  qup2_se5_l0: qup2_se5_l0 {
    mux = <20 1>;
  };
  qup2_se5_l1: qup2_se5_l1 {
    mux = <21 1>;
  };
  qup2_se5_l2: qup2_se5_l2 {
    mux = <22 1>;
  };
  qup2_se5_l3: qup2_se5_l3 {
    mux = <23 1>;
  };
  qup2_se5_l6: qup2_se5_l6 {
    mux = <23 2>;
  };
  qup2_se6_l0: qup2_se6_l0 {
    mux = <24 1>;
  };
  qup2_se6_l1: qup2_se6_l1 {
    mux = <25 1>;
  };
  qup2_se6_l2: qup2_se6_l2 {
    mux = <26 1>;
  };
  qup2_se6_l3: qup2_se6_l3 {
    mux = <27 1>;
  };
  qdss_cti_trig1_in_mirb: qdss_cti_trig1_in_mirb {
    mux = <27 2>;
  };
  qup2_se7_l0: qup2_se7_l0 {
    mux = <28 1>;
  };
  qup2_se7_l1: qup2_se7_l1 {
    mux = <29 1>;
  };
  usb_phy_ps_mirb: usb_phy_ps_mirb {
    mux = <29 2>;
  };
  qup2_se7_l2: qup2_se7_l2 {
    mux = <30 1>;
  };
  qup2_se7_l3: qup2_se7_l3 {
    mux = <31 1>;
  };
  qdss_cti_trig0_in_mirb: qdss_cti_trig0_in_mirb {
    mux = <31 2>;
  };
  qup1_se0_l0: qup1_se0_l0 {
    mux = <32 1>;
  };
  ibi_i3c_qup1_se0_sda: ibi_i3c_qup1_se0_sda {
    mux = <32 2>;
  };
  qup1_se0_l1: qup1_se0_l1 {
    mux = <33 1>;
  };
  ibi_i3c_qup1_se0_scl: ibi_i3c_qup1_se0_scl {
    mux = <33 2>;
  };
  qup1_se0_l2: qup1_se0_l2 {
    mux = <34 1>;
  };
  qup1_se0_l3: qup1_se0_l3 {
    mux = <35 1>;
  };
  qup1_se1_l0: qup1_se1_l0 {
    mux = <36 1>;
  };
  do_not_expose_qup3_qspi_data_0: do_not_expose_qup3_qspi_data_0 {
    mux = <36 2>;
  };
  ibi_i3c_qup1_se1_sda: ibi_i3c_qup1_se1_sda {
    mux = <36 3>;
  };
  qup1_se1_l1: qup1_se1_l1 {
    mux = <37 1>;
  };
  do_not_expose_qup3_qspi_data_1: do_not_expose_qup3_qspi_data_1 {
    mux = <37 2>;
  };
  ibi_i3c_qup1_se1_scl: ibi_i3c_qup1_se1_scl {
    mux = <37 3>;
  };
  qup1_se1_l2: qup1_se1_l2 {
    mux = <38 1>;
  };
  do_not_expose_qup3_qspi_data_2: do_not_expose_qup3_qspi_data_2 {
    mux = <38 2>;
  };
  qup1_se1_l3: qup1_se1_l3 {
    mux = <39 1>;
  };
  do_not_expose_qup3_qspi_data_3: do_not_expose_qup3_qspi_data_3 {
    mux = <39 2>;
  };
  qup1_se2_l0: qup1_se2_l0 {
    mux = <40 1>;
  };
  ddr_bist_fail: ddr_bist_fail {
    mux = <40 2>;
  };
  dbg_bus_out_locb_23: dbg_bus_out_locb_23 {
    mux = <40 3>;
  };
  qup1_se2_l1: qup1_se2_l1 {
    mux = <41 1>;
  };
  ddr_bist_start: ddr_bist_start {
    mux = <41 2>;
  };
  dbg_bus_out_locb_28: dbg_bus_out_locb_28 {
    mux = <41 3>;
  };
  qup1_se2_l2: qup1_se2_l2 {
    mux = <42 1>;
  };
  qup1_se2_l3: qup1_se2_l3 {
    mux = <43 1>;
  };
  dbg_bus_out_locb_27: dbg_bus_out_locb_27 {
    mux = <43 2>;
  };
  qup1_se3_l0: qup1_se3_l0 {
    mux = <44 1>;
  };
  qup1_se2_l4: qup1_se2_l4 {
    mux = <44 2>;
  };
  ddr_bist_complete: ddr_bist_complete {
    mux = <44 3>;
  };
  ddr_pxi1_test_tri_mirnat: ddr_pxi1_test_tri_mirnat {
    mux = <44 4>;
  };
  qup1_se3_l1: qup1_se3_l1 {
    mux = <45 1>;
  };
  qup1_se2_l5: qup1_se2_l5 {
    mux = <45 2>;
  };
  ddr_bist_stop: ddr_bist_stop {
    mux = <45 3>;
  };
  ddr_pxi1_test_done_mirnat: ddr_pxi1_test_done_mirnat {
    mux = <45 4>;
  };
  qup1_se3_l2: qup1_se3_l2 {
    mux = <46 1>;
  };
  qup1_se2_l6: qup1_se2_l6 {
    mux = <46 2>;
  };
  ddr_pxi3_test_done_mirnat: ddr_pxi3_test_done_mirnat {
    mux = <46 3>;
  };
  qup1_se3_l3: qup1_se3_l3 {
    mux = <47 1>;
  };
  uim0_present: uim0_present {
    mux = <47 2>;
  };
  dp_hot_plug_detect: dp_hot_plug_detect {
    mux = <47 3>;
  };
  ddr_pxi3_test_tri_mirnat: ddr_pxi3_test_tri_mirnat {
    mux = <47 4>;
  };
  qup1_se4_l0: qup1_se4_l0 {
    mux = <48 1>;
  };
  ibi_i3c_qup1_se4_sda: ibi_i3c_qup1_se4_sda {
    mux = <48 2>;
  };
  qup1_se4_l1: qup1_se4_l1 {
    mux = <49 1>;
  };
  ibi_i3c_qup1_se4_scl: ibi_i3c_qup1_se4_scl {
    mux = <49 2>;
  };
  qup1_se4_l2: qup1_se4_l2 {
    mux = <50 1>;
  };
  aoss_cti_debug_data0: aoss_cti_debug_data0 {
    mux = <50 2>;
  };
  qup1_se4_l3: qup1_se4_l3 {
    mux = <51 1>;
  };
  aoss_cti_debug_data1: aoss_cti_debug_data1 {
    mux = <51 2>;
  };
  ddr_pxi2_test_done_mirnat: ddr_pxi2_test_done_mirnat {
    mux = <51 3>;
  };
  qup1_se5_l0: qup1_se5_l0 {
    mux = <52 1>;
  };
  qup1_se5_l1: qup1_se5_l1 {
    mux = <53 1>;
  };
  gp_mn: gp_mn {
    mux = <53 2>;
  };
  qup1_se5_l2: qup1_se5_l2 {
    mux = <54 1>;
  };
  usb_phy_ps_mira: usb_phy_ps_mira {
    mux = <54 2>;
  };
  qup1_se5_l3: qup1_se5_l3 {
    mux = <55 1>;
  };
  qup1_se6_l0: qup1_se6_l0 {
    mux = <56 1>;
  };
  ibi_i3c_qup1_se6_sda: ibi_i3c_qup1_se6_sda {
    mux = <56 2>;
  };
  qspi_data_2: qspi_data_2 {
    mux = <56 3>;
  };
  sdc4_data_2: sdc4_data_2 {
    mux = <56 4>;
  };
  qup1_se6_l1: qup1_se6_l1 {
    mux = <57 1>;
  };
  ibi_i3c_qup1_se6_scl: ibi_i3c_qup1_se6_scl {
    mux = <57 2>;
  };
  qspi_data_3: qspi_data_3 {
    mux = <57 3>;
  };
  sdc4_data_3: sdc4_data_3 {
    mux = <57 4>;
  };
  qup1_se6_l2: qup1_se6_l2 {
    mux = <58 1>;
  };
  qspi_cs_n_0: qspi_cs_n_0 {
    mux = <58 2>;
  };
  tb_trig_sdc4: tb_trig_sdc4 {
    mux = <58 3>;
  };
  tsense_pwm1_out_mirnat: tsense_pwm1_out_mirnat {
    mux = <58 4>;
  };
  tsense_pwm2_out_mirnat: tsense_pwm2_out_mirnat {
    mux = <58 5>;
  };
  tsense_pwm3_out_mirnat: tsense_pwm3_out_mirnat {
    mux = <58 6>;
  };
  qup1_se6_l3: qup1_se6_l3 {
    mux = <59 1>;
  };
  qspi_cs_n_1: qspi_cs_n_1 {
    mux = <59 3>;
  };
  sdc4_cmd: sdc4_cmd {
    mux = <59 4>;
  };
  qup1_se7_l0: qup1_se7_l0 {
    mux = <60 1>;
  };
  aoss_cti_debug_data2: aoss_cti_debug_data2 {
    mux = <60 2>;
  };
  vsense_trigger_mirnat: vsense_trigger_mirnat {
    mux = <60 3>;
  };
  qup1_se7_l1: qup1_se7_l1 {
    mux = <61 1>;
  };
  aoss_cti_debug_data3: aoss_cti_debug_data3 {
    mux = <61 2>;
  };
  qup1_se7_l2: qup1_se7_l2 {
    mux = <62 1>;
  };
  ddr_pxi2_test_tri_mirnat: ddr_pxi2_test_tri_mirnat {
    mux = <62 2>;
  };
  qup1_se7_l3: qup1_se7_l3 {
    mux = <63 1>;
  };
  sdc2_cdc_dtest_out_mirnat_0: sdc2_cdc_dtest_out_mirnat_0 {
    mux = <63 2>;
  };
  i2chub0_se0_l0: i2chub0_se0_l0 {
    mux = <64 1>;
  };
  i2chub0_se0_l1: i2chub0_se0_l1 {
    mux = <65 1>;
  };
  i2chub0_se1_l0: i2chub0_se1_l0 {
    mux = <66 1>;
  };
  i2chub0_se1_l1: i2chub0_se1_l1 {
    mux = <67 1>;
  };
  i2chub0_se2_l0: i2chub0_se2_l0 {
    mux = <68 1>;
  };
  pll_bist_sync: pll_bist_sync {
    mux = <68 2>;
  };
  i2chub0_se2_l1: i2chub0_se2_l1 {
    mux = <69 1>;
  };
  i2chub0_se3_l0: i2chub0_se3_l0 {
    mux = <70 1>;
  };
  gp_pdm_mirb_2: gp_pdm_mirb_2 {
    mux = <70 2>;
  };
  sdc2_cdc_dtest_out_mirnat_1: sdc2_cdc_dtest_out_mirnat_1 {
    mux = <70 3>;
  };
  i2chub0_se3_l1: i2chub0_se3_l1 {
    mux = <71 1>;
  };
  gp_pdm_mirb_1: gp_pdm_mirb_1 {
    mux = <71 2>;
  };
  atest_usb0_testdataout0_mirnat_2: atest_usb0_testdataout0_mirnat_2 {
    mux = <71 3>;
  };
  i2chub0_se4_l0: i2chub0_se4_l0 {
    mux = <72 1>;
  };
  gp_pdm_mirb_0: gp_pdm_mirb_0 {
    mux = <72 2>;
  };
  atest_usb0_testdataout0_mirnat_3: atest_usb0_testdataout0_mirnat_3 {
    mux = <72 3>;
  };
  i2chub0_se4_l1: i2chub0_se4_l1 {
    mux = <73 1>;
  };
  jitter_bist_ref_clk: jitter_bist_ref_clk {
    mux = <73 2>;
  };
  i2chub0_se5_l0: i2chub0_se5_l0 {
    mux = <74 1>;
  };
  atest_usb0_atereset_mirnat: atest_usb0_atereset_mirnat {
    mux = <74 2>;
  };
  i2chub0_se5_l1: i2chub0_se5_l1 {
    mux = <75 1>;
  };
  ddr_pxi0_test_done_mirnat: ddr_pxi0_test_done_mirnat {
    mux = <75 2>;
  };
  i2chub0_se6_l0: i2chub0_se6_l0 {
    mux = <76 1>;
  };
  ddr_pxi0_test_tri_mirnat: ddr_pxi0_test_tri_mirnat {
    mux = <76 2>;
  };
  uim1_present: uim1_present {
    mux = <76 3>;
  };
  i2chub0_se6_l1: i2chub0_se6_l1 {
    mux = <77 1>;
  };
  i2chub0_se7_l0: i2chub0_se7_l0 {
    mux = <78 1>;
  };
  qdss_cti_trig0_out_mira: qdss_cti_trig0_out_mira {
    mux = <78 2>;
  };
  i2chub0_se7_l1: i2chub0_se7_l1 {
    mux = <79 1>;
  };
  qdss_cti_trig1_out_mira: qdss_cti_trig1_out_mira {
    mux = <79 2>;
  };
  i2chub0_se9_l0: i2chub0_se9_l0 {
    mux = <80 1>;
  };
  dbg_bus_out_locb_30: dbg_bus_out_locb_30 {
    mux = <80 2>;
  };
  i2chub0_se9_l1: i2chub0_se9_l1 {
    mux = <81 1>;
  };
  qdss_cti_trig0_out_mirb: qdss_cti_trig0_out_mirb {
    mux = <82 1>;
  };
  qdss_cti_trig1_out_mirb: qdss_cti_trig1_out_mirb {
    mux = <83 1>;
  };
  mdp_vsync_p_mira: mdp_vsync_p_mira {
    mux = <86 1>;
  };
  mdp_vsync0_out: mdp_vsync0_out {
    mux = <86 2>;
  };
  mdp_vsync1_out: mdp_vsync1_out {
    mux = <86 3>;
  };
  gcc_gp1_clk_mirb: gcc_gp1_clk_mirb {
    mux = <86 4>;
  };
  mdp_vsync_s_mira: mdp_vsync_s_mira {
    mux = <87 1>;
  };
  mdp_vsync2_out: mdp_vsync2_out {
    mux = <87 2>;
  };
  mdp_vsync3_out: mdp_vsync3_out {
    mux = <87 3>;
  };
  gcc_gp2_clk_mirb: gcc_gp2_clk_mirb {
    mux = <87 4>;
  };
  dbg_bus_out_locb_24: dbg_bus_out_locb_24 {
    mux = <87 5>;
  };
  mdp_vsync_e: mdp_vsync_e {
    mux = <88 1>;
  };
  gcc_gp3_clk_mirb: gcc_gp3_clk_mirb {
    mux = <88 2>;
  };
  dbg_bus_out_locb_29: dbg_bus_out_locb_29 {
    mux = <88 3>;
  };
  usb1_hs_ac_en: usb1_hs_ac_en {
    mux = <89 1>;
  };
  gnss_adc_dtest_l1_mirnat_0: gnss_adc_dtest_l1_mirnat_0 {
    mux = <89 2>;
  };
  gnss_adc_dtest_l1_mirnat_1: gnss_adc_dtest_l1_mirnat_1 {
    mux = <90 1>;
  };
  dbg_bus_out_locb_31: dbg_bus_out_locb_31 {
    mux = <91 1>;
  };
  gnss_adc_dtest_l5_mirnat_0: gnss_adc_dtest_l5_mirnat_0 {
    mux = <91 2>;
  };
  dbg_out_clk: dbg_out_clk {
    mux = <92 1>;
  };
  gnss_adc_dtest_l5_mirnat_1: gnss_adc_dtest_l5_mirnat_1 {
    mux = <92 2>;
  };
  sd_write_protect: sd_write_protect {
    mux = <93 1>;
  };
  cmu_rng_entropy_test_out_mirb_0: cmu_rng_entropy_test_out_mirb_0 {
    mux = <94 1>;
  };
  phase_flag_status_loc_14: phase_flag_status_loc_14 {
    mux = <94 2>;
  };
  tmess_prng_rosc_test_out_0: tmess_prng_rosc_test_out_0 {
    mux = <94 3>;
  };
  dbg_bus_out_loca_14: dbg_bus_out_loca_14 {
    mux = <94 4>;
  };
  pcie0_clk_req_n: pcie0_clk_req_n {
    mux = <95 1>;
  };
  cmu_rng_entropy_test_out_mirb_1: cmu_rng_entropy_test_out_mirb_1 {
    mux = <95 2>;
  };
  phase_flag_status_loc_15: phase_flag_status_loc_15 {
    mux = <95 3>;
  };
  tmess_prng_rosc_test_out_1: tmess_prng_rosc_test_out_1 {
    mux = <95 4>;
  };
  dbg_bus_out_loca_15: dbg_bus_out_loca_15 {
    mux = <95 5>;
  };
  cmu_rng_entropy_test_out_mirb_2: cmu_rng_entropy_test_out_mirb_2 {
    mux = <96 1>;
  };
  phase_flag_status_loc_16: phase_flag_status_loc_16 {
    mux = <96 2>;
  };
  tmess_prng_rosc_test_out_2: tmess_prng_rosc_test_out_2 {
    mux = <96 3>;
  };
  dbg_bus_out_loca_16: dbg_bus_out_loca_16 {
    mux = <96 4>;
  };
  pcie1_clk_req_n: pcie1_clk_req_n {
    mux = <98 1>;
  };
  cam_mclk0: cam_mclk0 {
    mux = <100 1>;
  };
  qdss_gpio_tracedata_locb_11: qdss_gpio_tracedata_locb_11 {
    mux = <100 2>;
  };
  cam_mclk1: cam_mclk1 {
    mux = <101 1>;
  };
  qdss_gpio_tracedata_locb_12: qdss_gpio_tracedata_locb_12 {
    mux = <101 2>;
  };
  cam_aon_mclk2: cam_aon_mclk2 {
    mux = <102 1>;
  };
  qdss_gpio_tracedata_locb_0: qdss_gpio_tracedata_locb_0 {
    mux = <102 2>;
  };
  cam_mclk3: cam_mclk3 {
    mux = <103 1>;
  };
  qdss_gpio_tracedata_locb_1: qdss_gpio_tracedata_locb_1 {
    mux = <103 2>;
  };
  cam_aon_mclk4: cam_aon_mclk4 {
    mux = <104 1>;
  };
  qdss_gpio_tracedata_locb_2: qdss_gpio_tracedata_locb_2 {
    mux = <104 2>;
  };
  cam_mclk5: cam_mclk5 {
    mux = <105 1>;
  };
  qdss_gpio_tracedata_locb_3: qdss_gpio_tracedata_locb_3 {
    mux = <105 2>;
  };
  cam_mclk7: cam_mclk7 {
    mux = <106 1>;
  };
  pll_clk_aux: pll_clk_aux {
    mux = <106 2>;
  };
  cam_mclk6: cam_mclk6 {
    mux = <108 1>;
  };
  cci_timer0: cci_timer0 {
    mux = <109 1>;
  };
  phase_flag_status_loc_17: phase_flag_status_loc_17 {
    mux = <109 2>;
  };
  tmess_prng_rosc_test_out_3: tmess_prng_rosc_test_out_3 {
    mux = <109 3>;
  };
  dbg_bus_out_loca_17: dbg_bus_out_loca_17 {
    mux = <109 4>;
  };
  cci_timer1: cci_timer1 {
    mux = <110 1>;
  };
  cci_timer4: cci_timer4 {
    mux = <111 1>;
  };
  phase_flag_status_loc_19: phase_flag_status_loc_19 {
    mux = <111 2>;
  };
  dbg_bus_out_loca_19: dbg_bus_out_loca_19 {
    mux = <111 3>;
  };
  cci_i2c_sda4: cci_i2c_sda4 {
    mux = <112 1>;
  };
  cmu_rng_entropy_test_out_mirb_3: cmu_rng_entropy_test_out_mirb_3 {
    mux = <112 2>;
  };
  phase_flag_status_loc_20: phase_flag_status_loc_20 {
    mux = <112 3>;
  };
  dbg_bus_out_loca_20: dbg_bus_out_loca_20 {
    mux = <112 4>;
  };
  cci_i2c_sda0: cci_i2c_sda0 {
    mux = <113 1>;
  };
  phase_flag_status_loc_21: phase_flag_status_loc_21 {
    mux = <113 2>;
  };
  dbg_bus_out_loca_21: dbg_bus_out_loca_21 {
    mux = <113 3>;
  };
  qdss_gpio_tracedata_locb_7: qdss_gpio_tracedata_locb_7 {
    mux = <113 4>;
  };
  cci_i2c_scl0: cci_i2c_scl0 {
    mux = <114 1>;
  };
  phase_flag_status_loc_22: phase_flag_status_loc_22 {
    mux = <114 2>;
  };
  dbg_bus_out_loca_22: dbg_bus_out_loca_22 {
    mux = <114 3>;
  };
  qdss_gpio_tracedata_locb_8: qdss_gpio_tracedata_locb_8 {
    mux = <114 4>;
  };
  cci_i2c_sda1: cci_i2c_sda1 {
    mux = <115 1>;
  };
  phase_flag_status_loc_23: phase_flag_status_loc_23 {
    mux = <115 2>;
  };
  dbg_bus_out_loca_23: dbg_bus_out_loca_23 {
    mux = <115 3>;
  };
  qdss_gpio_traceclk_locb: qdss_gpio_traceclk_locb {
    mux = <115 4>;
  };
  cci_i2c_scl1: cci_i2c_scl1 {
    mux = <116 1>;
  };
  phase_flag_status_loc_24: phase_flag_status_loc_24 {
    mux = <116 2>;
  };
  dbg_bus_out_loca_24: dbg_bus_out_loca_24 {
    mux = <116 3>;
  };
  qdss_gpio_tracectl_locb: qdss_gpio_tracectl_locb {
    mux = <116 4>;
  };
  cci_i2c_sda2: cci_i2c_sda2 {
    mux = <117 1>;
  };
  phase_flag_status_loc_25: phase_flag_status_loc_25 {
    mux = <117 2>;
  };
  dbg_bus_out_loca_25: dbg_bus_out_loca_25 {
    mux = <117 3>;
  };
  qdss_gpio_tracedata_locb_9: qdss_gpio_tracedata_locb_9 {
    mux = <117 4>;
  };
  cci_i2c_scl2: cci_i2c_scl2 {
    mux = <118 1>;
  };
  phase_flag_status_loc_26: phase_flag_status_loc_26 {
    mux = <118 2>;
  };
  dbg_bus_out_loca_26: dbg_bus_out_loca_26 {
    mux = <118 3>;
  };
  qdss_gpio_tracedata_locb_10: qdss_gpio_tracedata_locb_10 {
    mux = <118 4>;
  };
  cci_i2c_sda5: cci_i2c_sda5 {
    mux = <119 1>;
  };
  phase_flag_status_loc_27: phase_flag_status_loc_27 {
    mux = <119 2>;
  };
  dbg_bus_out_loca_27: dbg_bus_out_loca_27 {
    mux = <119 3>;
  };
  cci_i2c_scl5: cci_i2c_scl5 {
    mux = <120 1>;
  };
  phase_flag_status_loc_28: phase_flag_status_loc_28 {
    mux = <120 2>;
  };
  dbg_bus_out_loca_28: dbg_bus_out_loca_28 {
    mux = <120 3>;
  };
  i2s1_sck: i2s1_sck {
    mux = <121 1>;
  };
  dbg_bus_out_locb_8: dbg_bus_out_locb_8 {
    mux = <121 2>;
  };
  i2s1_data0: i2s1_data0 {
    mux = <122 1>;
  };
  cmu_rng_entropy_test_out_mira_3: cmu_rng_entropy_test_out_mira_3 {
    mux = <122 2>;
  };
  dbg_bus_out_locb_7: dbg_bus_out_locb_7 {
    mux = <122 3>;
  };
  i2s1_ws: i2s1_ws {
    mux = <123 1>;
  };
  dbg_bus_out_locb_6: dbg_bus_out_locb_6 {
    mux = <123 2>;
  };
  i2s1_data1: i2s1_data1 {
    mux = <124 1>;
  };
  audio_ext_mclk1: audio_ext_mclk1 {
    mux = <124 2>;
  };
  audio_ref_clk: audio_ref_clk {
    mux = <124 3>;
  };
  dbg_bus_out_locb_5: dbg_bus_out_locb_5 {
    mux = <124 4>;
  };
  audio_ext_mclk0: audio_ext_mclk0 {
    mux = <125 1>;
  };
  dbg_bus_out_locb_4: dbg_bus_out_locb_4 {
    mux = <125 2>;
  };
  i2s0_sck: i2s0_sck {
    mux = <126 1>;
  };
  gp_pdm_mira_0: gp_pdm_mira_0 {
    mux = <126 2>;
  };
  dbg_bus_out_locb_3: dbg_bus_out_locb_3 {
    mux = <126 3>;
  };
  i2s0_data0: i2s0_data0 {
    mux = <127 1>;
  };
  cmu_rng_entropy_test_out_mira_2: cmu_rng_entropy_test_out_mira_2 {
    mux = <127 2>;
  };
  gp_pdm_mira_1: gp_pdm_mira_1 {
    mux = <127 3>;
  };
  dbg_bus_out_locb_2: dbg_bus_out_locb_2 {
    mux = <127 4>;
  };
  i2s0_data1: i2s0_data1 {
    mux = <128 1>;
  };
  cmu_rng_entropy_test_out_mira_1: cmu_rng_entropy_test_out_mira_1 {
    mux = <128 2>;
  };
  gp_pdm_mira_2: gp_pdm_mira_2 {
    mux = <128 3>;
  };
  dbg_bus_out_locb_1: dbg_bus_out_locb_1 {
    mux = <128 4>;
  };
  i2s0_ws: i2s0_ws {
    mux = <129 1>;
  };
  cmu_rng_entropy_test_out_mira_0: cmu_rng_entropy_test_out_mira_0 {
    mux = <129 2>;
  };
  dbg_bus_out_locb_0: dbg_bus_out_locb_0 {
    mux = <129 3>;
  };
  uim0_data: uim0_data {
    mux = <130 1>;
  };
  atest_usb0_testdataout0_mirnat_1: atest_usb0_testdataout0_mirnat_1 {
    mux = <130 2>;
  };
  atest_char_status_loc_3: atest_char_status_loc_3 {
    mux = <130 3>;
  };
  uim0_clk: uim0_clk {
    mux = <131 1>;
  };
  atest_usb0_testdataout0_mirnat_0: atest_usb0_testdataout0_mirnat_0 {
    mux = <131 2>;
  };
  atest_char_status_loc_2: atest_char_status_loc_2 {
    mux = <131 3>;
  };
  uim0_reset: uim0_reset {
    mux = <132 1>;
  };
  atest_char_status_loc_1: atest_char_status_loc_1 {
    mux = <132 2>;
  };
  mdp_vsync_s_mirb: mdp_vsync_s_mirb {
    mux = <133 1>;
  };
  atest_char_status_loc_0: atest_char_status_loc_0 {
    mux = <133 2>;
  };
  uim1_data: uim1_data {
    mux = <134 1>;
  };
  do_not_expose_qup3_qspi_cs: do_not_expose_qup3_qspi_cs {
    mux = <134 2>;
  };
  qspi_data_0: qspi_data_0 {
    mux = <134 3>;
  };
  sdc4_data_0: sdc4_data_0 {
    mux = <134 4>;
  };
  gcc_gp1_clk_mira: gcc_gp1_clk_mira {
    mux = <134 5>;
  };
  uim1_clk: uim1_clk {
    mux = <135 1>;
  };
  do_not_expose_qup3_qspi_clk: do_not_expose_qup3_qspi_clk {
    mux = <135 2>;
  };
  qspi_clk: qspi_clk {
    mux = <135 3>;
  };
  sdc4_clk: sdc4_clk {
    mux = <135 4>;
  };
  gcc_gp2_clk_mira: gcc_gp2_clk_mira {
    mux = <135 5>;
  };
  uim1_reset: uim1_reset {
    mux = <136 1>;
  };
  do_not_expose_qup3_qspi_doorbell: do_not_expose_qup3_qspi_doorbell {
    mux = <136 2>;
  };
  qspi_data_1: qspi_data_1 {
    mux = <136 3>;
  };
  sdc4_data_1: sdc4_data_1 {
    mux = <136 4>;
  };
  gcc_gp3_clk_mira: gcc_gp3_clk_mira {
    mux = <136 5>;
  };
  mdp_vsync_p_mirb: mdp_vsync_p_mirb {
    mux = <137 1>;
  };
  atest_char_start: atest_char_start {
    mux = <137 2>;
  };
  rffe0_clk: rffe0_clk {
    mux = <138 1>;
  };
  grfc0: grfc0 {
    mux = <138 2>;
  };
  rffe0_data: rffe0_data {
    mux = <139 1>;
  };
  grfc1: grfc1 {
    mux = <139 2>;
  };
  rffe1_clk: rffe1_clk {
    mux = <140 1>;
  };
  grfc2: grfc2 {
    mux = <140 2>;
  };
  qdss_gpio_tracedata_loca_0: qdss_gpio_tracedata_loca_0 {
    mux = <140 3>;
  };
  rffe1_data: rffe1_data {
    mux = <141 1>;
  };
  grfc3: grfc3 {
    mux = <141 2>;
  };
  qdss_gpio_tracedata_loca_1: qdss_gpio_tracedata_loca_1 {
    mux = <141 3>;
  };
  rffe2_clk: rffe2_clk {
    mux = <142 1>;
  };
  grfc4: grfc4 {
    mux = <142 2>;
  };
  qdss_gpio_tracedata_loca_2: qdss_gpio_tracedata_loca_2 {
    mux = <142 3>;
  };
  rffe2_data: rffe2_data {
    mux = <143 1>;
  };
  grfc5: grfc5 {
    mux = <143 2>;
  };
  qdss_gpio_tracedata_loca_3: qdss_gpio_tracedata_loca_3 {
    mux = <143 3>;
  };
  grfc6: grfc6 {
    mux = <144 1>;
  };
  qdss_gpio_tracedata_loca_4: qdss_gpio_tracedata_loca_4 {
    mux = <144 2>;
  };
  grfc7: grfc7 {
    mux = <145 1>;
  };
  qdss_gpio_tracedata_loca_5: qdss_gpio_tracedata_loca_5 {
    mux = <145 2>;
  };
  grfc8: grfc8 {
    mux = <146 1>;
  };
  qdss_gpio_tracedata_loca_6: qdss_gpio_tracedata_loca_6 {
    mux = <146 2>;
  };
  grfc9: grfc9 {
    mux = <147 1>;
  };
  qdss_gpio_tracedata_loca_7: qdss_gpio_tracedata_loca_7 {
    mux = <147 2>;
  };
  coex_uart1_rx: coex_uart1_rx {
    mux = <148 1>;
  };
  qdss_gpio_tracectl_loca: qdss_gpio_tracectl_loca {
    mux = <148 2>;
  };
  coex_uart1_tx: coex_uart1_tx {
    mux = <149 1>;
  };
  qdss_gpio_traceclk_loca: qdss_gpio_traceclk_loca {
    mux = <149 2>;
  };
  grfc10: grfc10 {
    mux = <150 1>;
  };
  vfr_0: vfr_0 {
    mux = <150 2>;
  };
  coex_uart2_rx: coex_uart2_rx {
    mux = <150 3>;
  };
  qdss_gpio_tracedata_loca_8: qdss_gpio_tracedata_loca_8 {
    mux = <150 4>;
  };
  grfc11: grfc11 {
    mux = <151 1>;
  };
  coex_uart2_tx: coex_uart2_tx {
    mux = <151 2>;
  };
  qdss_gpio_tracedata_loca_9: qdss_gpio_tracedata_loca_9 {
    mux = <151 3>;
  };
  nav_gpio2: nav_gpio2 {
    mux = <152 1>;
  };
  grfc12: grfc12 {
    mux = <152 2>;
  };
  qdss_gpio_tracedata_loca_10: qdss_gpio_tracedata_loca_10 {
    mux = <152 3>;
  };
  cci_i2c_scl4: cci_i2c_scl4 {
    mux = <153 1>;
  };
  phase_flag_status_loc_29: phase_flag_status_loc_29 {
    mux = <153 2>;
  };
  dbg_bus_out_loca_29: dbg_bus_out_loca_29 {
    mux = <153 3>;
  };
  qdss_gpio_tracedata_locb_5: qdss_gpio_tracedata_locb_5 {
    mux = <153 4>;
  };
  nav_gpio0: nav_gpio0 {
    mux = <154 1>;
  };
  nav_gpio3: nav_gpio3 {
    mux = <154 2>;
  };
  qdss_gpio_tracedata_loca_11: qdss_gpio_tracedata_loca_11 {
    mux = <154 3>;
  };
  nav_gpio1: nav_gpio1 {
    mux = <155 1>;
  };
  vfr_1: vfr_1 {
    mux = <155 2>;
  };
  qdss_gpio_tracedata_loca_12: qdss_gpio_tracedata_loca_12 {
    mux = <155 3>;
  };
  qlink_little_request: qlink_little_request {
    mux = <156 1>;
  };
  qdss_gpio_tracedata_loca_13: qdss_gpio_tracedata_loca_13 {
    mux = <156 2>;
  };
  qlink_little_enable: qlink_little_enable {
    mux = <157 1>;
  };
  qdss_gpio_tracedata_loca_14: qdss_gpio_tracedata_loca_14 {
    mux = <157 2>;
  };
  qlink_wmss_reset_n: qlink_wmss_reset_n {
    mux = <158 1>;
  };
  qdss_gpio_tracedata_loca_15: qdss_gpio_tracedata_loca_15 {
    mux = <158 2>;
  };
  qlink_big_request: qlink_big_request {
    mux = <159 1>;
  };
  qdss_cti_trig1_in_mira: qdss_cti_trig1_in_mira {
    mux = <159 2>;
  };
  qlink_big_enable: qlink_big_enable {
    mux = <160 1>;
  };
  qdss_cti_trig0_in_mira: qdss_cti_trig0_in_mira {
    mux = <162 1>;
  };
  cci_async_in1: cci_async_in1 {
    mux = <163 1>;
  };
  phase_flag_status_loc_30: phase_flag_status_loc_30 {
    mux = <163 2>;
  };
  dbg_bus_out_loca_30: dbg_bus_out_loca_30 {
    mux = <163 3>;
  };
  cci_async_in2: cci_async_in2 {
    mux = <164 1>;
  };
  phase_flag_status_loc_31: phase_flag_status_loc_31 {
    mux = <164 2>;
  };
  dbg_bus_out_loca_31: dbg_bus_out_loca_31 {
    mux = <164 3>;
  };
  prng_rosc_test_out_3: prng_rosc_test_out_3 {
    mux = <181 1>;
  };
  prng_rosc_test_out_2: prng_rosc_test_out_2 {
    mux = <182 1>;
  };
  prng_rosc_test_out_1: prng_rosc_test_out_1 {
    mux = <183 1>;
  };
  prng_rosc_test_out_0: prng_rosc_test_out_0 {
    mux = <186 1>;
  };
  cri_trng_rosc_test_out: cri_trng_rosc_test_out {
    mux = <187 1>;
  };
  dbg_bus_out_locb_22: dbg_bus_out_locb_22 {
    mux = <188 1>;
  };
  dbg_bus_out_locb_21: dbg_bus_out_locb_21 {
    mux = <189 1>;
  };
  dbg_bus_out_locb_20: dbg_bus_out_locb_20 {
    mux = <190 1>;
  };
  dbg_bus_out_locb_19: dbg_bus_out_locb_19 {
    mux = <191 1>;
  };
  dbg_bus_out_locb_18: dbg_bus_out_locb_18 {
    mux = <192 1>;
  };
  dbg_bus_out_locb_17: dbg_bus_out_locb_17 {
    mux = <193 1>;
  };
  dbg_bus_out_locb_16: dbg_bus_out_locb_16 {
    mux = <194 1>;
  };
  dbg_bus_out_locb_15: dbg_bus_out_locb_15 {
    mux = <195 1>;
  };
  dbg_bus_out_locb_14: dbg_bus_out_locb_14 {
    mux = <196 1>;
  };
  dbg_bus_out_locb_13: dbg_bus_out_locb_13 {
    mux = <197 1>;
  };
  dbg_bus_out_locb_12: dbg_bus_out_locb_12 {
    mux = <198 1>;
  };
  dbg_bus_out_locb_11: dbg_bus_out_locb_11 {
    mux = <199 1>;
  };
  dbg_bus_out_locb_10: dbg_bus_out_locb_10 {
    mux = <200 1>;
  };
  dbg_bus_out_locb_9: dbg_bus_out_locb_9 {
    mux = <201 1>;
  };
  i2chub0_se8_l0: i2chub0_se8_l0 {
    mux = <206 1>;
  };
  i2chub0_se8_l1: i2chub0_se8_l1 {
    mux = <207 1>;
  };
  dbg_bus_out_locb_26: dbg_bus_out_locb_26 {
    mux = <208 1>;
  };
  dbg_bus_out_locb_25: dbg_bus_out_locb_25 {
    mux = <209 1>;
  };
#endif
};

&tlmm {
  qcom,sleep-config   =  <
(GPIO_INPUT | GPIO_PULL_UP   | GPIO_OUT_LOW  | GPIO_PRG_YES)
(GPIO_INPUT | GPIO_PULL_DOWN | GPIO_OUT_LOW  | GPIO_PRG_NO)
(GPIO_INPUT | GPIO_PULL_DOWN | GPIO_OUT_LOW  | GPIO_PRG_NO)
(GPIO_INPUT | GPIO_PULL_DOWN | GPIO_OUT_LOW  | GPIO_PRG_NO)
(GPIO_INPUT | GPIO_PULL_DOWN | GPIO_OUT_LOW  | GPIO_PRG_NO)
(GPIO_INPUT | GPIO_PULL_DOWN | GPIO_OUT_LOW  | GPIO_PRG_NO)
(GPIO_INPUT | GPIO_PULL_DOWN | GPIO_OUT_LOW  | GPIO_PRG_NO)
(GPIO_INPUT | GPIO_PULL_DOWN | GPIO_OUT_LOW  | GPIO_PRG_NO)
(GPIO_INPUT | GPIO_PULL_DOWN | GPIO_OUT_LOW  | GPIO_PRG_NO)
(GPIO_INPUT | GPIO_PULL_DOWN | GPIO_OUT_LOW  | GPIO_PRG_NO)

(GPIO_INPUT | GPIO_PULL_DOWN | GPIO_OUT_LOW  | GPIO_PRG_NO)
(GPIO_INPUT | GPIO_PULL_DOWN | GPIO_OUT_LOW  | GPIO_PRG_NO)
(GPIO_INPUT | GPIO_NO_PULL   | GPIO_OUT_LOW  | GPIO_PRG_YES)
(GPIO_INPUT | GPIO_NO_PULL   | GPIO_OUT_LOW  | GPIO_PRG_YES)
(GPIO_INPUT | GPIO_PULL_DOWN | GPIO_OUT_LOW  | GPIO_PRG_NO)
(GPIO_INPUT | GPIO_PULL_DOWN | GPIO_OUT_LOW  | GPIO_PRG_NO)
(GPIO_INPUT | GPIO_PULL_DOWN | GPIO_OUT_LOW  | GPIO_PRG_NO)
(GPIO_INPUT | GPIO_PULL_DOWN | GPIO_OUT_LOW  | GPIO_PRG_NO)
(GPIO_INPUT | GPIO_PULL_DOWN | GPIO_OUT_LOW  | GPIO_PRG_NO)
(GPIO_INPUT | GPIO_PULL_DOWN | GPIO_OUT_LOW  | GPIO_PRG_NO)

(GPIO_INPUT | GPIO_PULL_DOWN | GPIO_OUT_LOW  | GPIO_PRG_NO)
(GPIO_INPUT | GPIO_PULL_DOWN | GPIO_OUT_LOW  | GPIO_PRG_NO)
(GPIO_INPUT | GPIO_PULL_DOWN | GPIO_OUT_LOW  | GPIO_PRG_NO)
(GPIO_INPUT | GPIO_PULL_DOWN | GPIO_OUT_LOW  | GPIO_PRG_NO)
(GPIO_INPUT | GPIO_PULL_DOWN | GPIO_OUT_LOW  | GPIO_PRG_NO)
(GPIO_INPUT | GPIO_PULL_DOWN | GPIO_OUT_LOW  | GPIO_PRG_NO)
(GPIO_INPUT | GPIO_PULL_DOWN | GPIO_OUT_LOW  | GPIO_PRG_NO)
(GPIO_INPUT | GPIO_PULL_DOWN | GPIO_OUT_LOW  | GPIO_PRG_NO)
(GPIO_INPUT | GPIO_PULL_DOWN | GPIO_OUT_LOW  | GPIO_PRG_NO)
(GPIO_INPUT | GPIO_PULL_DOWN | GPIO_OUT_LOW  | GPIO_PRG_NO)

(GPIO_INPUT | GPIO_PULL_DOWN | GPIO_OUT_LOW  | GPIO_PRG_NO)
(GPIO_INPUT | GPIO_PULL_DOWN | GPIO_OUT_LOW  | GPIO_PRG_NO)
(GPIO_INPUT | GPIO_PULL_DOWN | GPIO_OUT_LOW  | GPIO_PRG_NO)
(GPIO_INPUT | GPIO_PULL_DOWN | GPIO_OUT_LOW  | GPIO_PRG_NO)
(GPIO_INPUT | GPIO_PULL_DOWN | GPIO_OUT_LOW  | GPIO_PRG_NO)
(GPIO_INPUT | GPIO_PULL_DOWN | GPIO_OUT_LOW  | GPIO_PRG_NO)
(GPIO_INPUT | GPIO_PULL_DOWN | GPIO_OUT_LOW  | GPIO_PRG_NO)
(GPIO_INPUT | GPIO_PULL_DOWN | GPIO_OUT_LOW  | GPIO_PRG_NO)
(GPIO_INPUT | GPIO_PULL_DOWN | GPIO_OUT_LOW  | GPIO_PRG_NO)
(GPIO_INPUT | GPIO_PULL_DOWN | GPIO_OUT_LOW  | GPIO_PRG_NO)

(GPIO_INPUT | GPIO_PULL_DOWN | GPIO_OUT_LOW  | GPIO_PRG_NO)
(GPIO_INPUT | GPIO_PULL_DOWN | GPIO_OUT_LOW  | GPIO_PRG_NO)
(GPIO_INPUT | GPIO_PULL_DOWN | GPIO_OUT_LOW  | GPIO_PRG_NO)
(GPIO_INPUT | GPIO_PULL_DOWN | GPIO_OUT_LOW  | GPIO_PRG_NO)
(GPIO_INPUT | GPIO_PULL_DOWN | GPIO_OUT_LOW  | GPIO_PRG_NO)
(GPIO_INPUT | GPIO_PULL_DOWN | GPIO_OUT_LOW  | GPIO_PRG_NO)
(GPIO_INPUT | GPIO_PULL_DOWN | GPIO_OUT_LOW  | GPIO_PRG_NO)
(GPIO_INPUT | GPIO_PULL_UP   | GPIO_OUT_LOW  | GPIO_PRG_YES)
(GPIO_INPUT | GPIO_NO_PULL   | GPIO_OUT_LOW  | GPIO_PRG_YES)
(GPIO_INPUT | GPIO_NO_PULL   | GPIO_OUT_LOW  | GPIO_PRG_YES)

(GPIO_INPUT | GPIO_PULL_DOWN | GPIO_OUT_LOW  | GPIO_PRG_NO)
(GPIO_INPUT | GPIO_PULL_DOWN | GPIO_OUT_LOW  | GPIO_PRG_NO)
(GPIO_INPUT | GPIO_PULL_DOWN | GPIO_OUT_LOW  | GPIO_PRG_NO)
(GPIO_INPUT | GPIO_PULL_DOWN | GPIO_OUT_LOW  | GPIO_PRG_NO)
(GPIO_INPUT | GPIO_PULL_DOWN | GPIO_OUT_LOW  | GPIO_PRG_NO)
(GPIO_INPUT | GPIO_PULL_DOWN | GPIO_OUT_LOW  | GPIO_PRG_NO)
(GPIO_INPUT | GPIO_NO_PULL   | GPIO_OUT_LOW  | GPIO_PRG_YES)
(GPIO_INPUT | GPIO_NO_PULL   | GPIO_OUT_LOW  | GPIO_PRG_YES)
(GPIO_INPUT | GPIO_PULL_DOWN | GPIO_OUT_LOW  | GPIO_PRG_NO)
(GPIO_INPUT | GPIO_PULL_DOWN | GPIO_OUT_LOW  | GPIO_PRG_NO)

(GPIO_INPUT | GPIO_PULL_UP | GPIO_OUT_LOW  | GPIO_PRG_YES)
(GPIO_OUTPUT | GPIO_NO_PULL | GPIO_OUT_HIGH  | GPIO_PRG_YES)
(GPIO_OUTPUT | GPIO_NO_PULL | GPIO_OUT_HIGH  | GPIO_PRG_YES)
(GPIO_OUTPUT | GPIO_NO_PULL | GPIO_OUT_HIGH  | GPIO_PRG_YES)
(GPIO_INPUT | GPIO_NO_PULL   | GPIO_OUT_LOW  | GPIO_PRG_YES)
(GPIO_INPUT | GPIO_PULL_DOWN | GPIO_OUT_LOW  | GPIO_PRG_NO)
(GPIO_INPUT | GPIO_NO_PULL   | GPIO_OUT_LOW  | GPIO_PRG_YES)
(GPIO_INPUT | GPIO_NO_PULL   | GPIO_OUT_LOW  | GPIO_PRG_YES)
(GPIO_INPUT | GPIO_NO_PULL   | GPIO_OUT_LOW  | GPIO_PRG_YES)
(GPIO_INPUT | GPIO_PULL_DOWN | GPIO_OUT_LOW  | GPIO_PRG_NO)

(GPIO_INPUT | GPIO_NO_PULL   | GPIO_OUT_LOW  | GPIO_PRG_YES)
(GPIO_INPUT | GPIO_NO_PULL   | GPIO_OUT_LOW  | GPIO_PRG_YES)
(GPIO_INPUT | GPIO_NO_PULL   | GPIO_OUT_LOW  | GPIO_PRG_YES)
(GPIO_INPUT | GPIO_NO_PULL   | GPIO_OUT_LOW  | GPIO_PRG_YES)
(GPIO_INPUT | GPIO_PULL_DOWN | GPIO_OUT_LOW  | GPIO_PRG_NO)
(GPIO_INPUT | GPIO_PULL_DOWN | GPIO_OUT_LOW  | GPIO_PRG_NO)
(GPIO_INPUT | GPIO_PULL_UP   | GPIO_OUT_LOW  | GPIO_PRG_YES)
(GPIO_INPUT | GPIO_PULL_DOWN | GPIO_OUT_LOW  | GPIO_PRG_NO)
(GPIO_OUTPUT| GPIO_NO_PULL   |  GPIO_OUT_LOW | GPIO_PRG_YES)
(GPIO_INPUT | GPIO_PULL_DOWN | GPIO_OUT_LOW  | GPIO_PRG_NO)

(GPIO_INPUT | GPIO_PULL_DOWN | GPIO_OUT_LOW  | GPIO_PRG_YES)
(GPIO_OUTPUT| GPIO_NO_PULL   |  GPIO_OUT_LOW | GPIO_PRG_YES)
(GPIO_OUTPUT| GPIO_NO_PULL   |  GPIO_OUT_LOW | GPIO_PRG_YES)
(GPIO_INPUT | GPIO_PULL_DOWN | GPIO_OUT_LOW  | GPIO_PRG_NO)
(GPIO_INPUT | GPIO_PULL_DOWN | GPIO_OUT_LOW  | GPIO_PRG_NO)
(GPIO_INPUT | GPIO_PULL_DOWN | GPIO_OUT_LOW  | GPIO_PRG_NO)
(GPIO_INPUT | GPIO_PULL_DOWN | GPIO_OUT_LOW  | GPIO_PRG_NO)
(GPIO_INPUT | GPIO_PULL_DOWN | GPIO_OUT_LOW  | GPIO_PRG_NO)
(GPIO_INPUT | GPIO_PULL_DOWN | GPIO_OUT_LOW  | GPIO_PRG_NO)
(GPIO_INPUT | GPIO_PULL_DOWN | GPIO_OUT_LOW  | GPIO_PRG_NO)

(GPIO_INPUT | GPIO_PULL_DOWN | GPIO_OUT_LOW  | GPIO_PRG_NO)
(GPIO_INPUT | GPIO_PULL_DOWN | GPIO_OUT_LOW  | GPIO_PRG_NO)
(GPIO_INPUT | GPIO_PULL_DOWN | GPIO_OUT_LOW  | GPIO_PRG_NO)
(GPIO_INPUT | GPIO_PULL_DOWN | GPIO_OUT_LOW  | GPIO_PRG_NO)
(GPIO_INPUT | GPIO_PULL_DOWN | GPIO_OUT_LOW  | GPIO_PRG_NO)
(GPIO_INPUT | GPIO_PULL_DOWN | GPIO_OUT_LOW  | GPIO_PRG_NO)
(GPIO_INPUT | GPIO_PULL_DOWN | GPIO_OUT_LOW  | GPIO_PRG_NO)
(GPIO_INPUT | GPIO_PULL_DOWN | GPIO_OUT_LOW  | GPIO_PRG_NO)
(GPIO_INPUT | GPIO_PULL_DOWN | GPIO_OUT_LOW  | GPIO_PRG_NO)
(GPIO_INPUT | GPIO_PULL_DOWN | GPIO_OUT_LOW  | GPIO_PRG_NO)

(GPIO_INPUT | GPIO_PULL_DOWN | GPIO_OUT_LOW  | GPIO_PRG_NO)
(GPIO_INPUT | GPIO_PULL_DOWN | GPIO_OUT_LOW  | GPIO_PRG_NO)
(GPIO_INPUT | GPIO_PULL_DOWN | GPIO_OUT_LOW  | GPIO_PRG_NO)
(GPIO_INPUT | GPIO_PULL_DOWN | GPIO_OUT_LOW  | GPIO_PRG_NO)
(GPIO_INPUT | GPIO_PULL_DOWN | GPIO_OUT_LOW  | GPIO_PRG_NO)
(GPIO_INPUT | GPIO_PULL_DOWN | GPIO_OUT_LOW  | GPIO_PRG_NO)
(GPIO_INPUT | GPIO_PULL_DOWN | GPIO_OUT_LOW  | GPIO_PRG_NO)
(GPIO_INPUT | GPIO_PULL_DOWN | GPIO_OUT_LOW  | GPIO_PRG_NO)
(GPIO_INPUT | GPIO_PULL_DOWN | GPIO_OUT_LOW  | GPIO_PRG_NO)
(GPIO_INPUT | GPIO_PULL_DOWN | GPIO_OUT_LOW  | GPIO_PRG_NO)

(GPIO_INPUT | GPIO_PULL_DOWN | GPIO_OUT_LOW  | GPIO_PRG_NO)
(GPIO_INPUT | GPIO_PULL_DOWN | GPIO_OUT_LOW  | GPIO_PRG_NO)
(GPIO_INPUT | GPIO_PULL_DOWN | GPIO_OUT_LOW  | GPIO_PRG_NO)
(GPIO_INPUT | GPIO_NO_PULL   | GPIO_OUT_LOW  | GPIO_PRG_YES)
(GPIO_INPUT | GPIO_NO_PULL   | GPIO_OUT_LOW  | GPIO_PRG_YES)
(GPIO_INPUT | GPIO_NO_PULL   | GPIO_OUT_LOW  | GPIO_PRG_YES)
(GPIO_INPUT | GPIO_NO_PULL   | GPIO_OUT_LOW  | GPIO_PRG_YES)
(GPIO_INPUT | GPIO_NO_PULL   | GPIO_OUT_LOW  | GPIO_PRG_YES)
(GPIO_INPUT | GPIO_NO_PULL   | GPIO_OUT_LOW  | GPIO_PRG_YES)
(GPIO_INPUT | GPIO_PULL_DOWN | GPIO_OUT_LOW  | GPIO_PRG_NO)

(GPIO_INPUT | GPIO_PULL_DOWN | GPIO_OUT_LOW  | GPIO_PRG_NO)
(GPIO_INPUT | GPIO_PULL_DOWN | GPIO_OUT_LOW  | GPIO_PRG_NO)
(GPIO_INPUT | GPIO_PULL_DOWN | GPIO_OUT_LOW  | GPIO_PRG_NO)
(GPIO_INPUT | GPIO_PULL_DOWN | GPIO_OUT_LOW  | GPIO_PRG_NO)
(GPIO_INPUT | GPIO_PULL_DOWN | GPIO_OUT_LOW  | GPIO_PRG_NO)
(GPIO_INPUT | GPIO_PULL_DOWN | GPIO_OUT_LOW  | GPIO_PRG_NO)
(GPIO_INPUT | GPIO_PULL_DOWN | GPIO_OUT_LOW  | GPIO_PRG_NO)
(GPIO_INPUT | GPIO_PULL_DOWN | GPIO_OUT_LOW  | GPIO_PRG_NO)
(GPIO_OUTPUT| GPIO_NO_PULL   |  GPIO_OUT_LOW | GPIO_PRG_YES)
(GPIO_INPUT | GPIO_PULL_DOWN | GPIO_OUT_LOW  | GPIO_PRG_NO)

(GPIO_INPUT | GPIO_PULL_DOWN | GPIO_OUT_LOW  | GPIO_PRG_NO)
(GPIO_INPUT | GPIO_PULL_DOWN | GPIO_OUT_LOW  | GPIO_PRG_NO)
(GPIO_INPUT | GPIO_PULL_DOWN | GPIO_OUT_LOW  | GPIO_PRG_NO)
(GPIO_OUTPUT| GPIO_NO_PULL   |  GPIO_OUT_LOW | GPIO_PRG_YES)
(GPIO_INPUT | GPIO_PULL_DOWN | GPIO_OUT_LOW  | GPIO_PRG_NO)
(GPIO_INPUT | GPIO_PULL_DOWN | GPIO_OUT_LOW  | GPIO_PRG_NO)
(GPIO_INPUT | GPIO_PULL_DOWN | GPIO_OUT_LOW  | GPIO_PRG_NO)
(GPIO_OUTPUT| GPIO_NO_PULL   |  GPIO_OUT_HIGH| GPIO_PRG_YES)
(GPIO_INPUT | GPIO_PULL_DOWN | GPIO_OUT_LOW  | GPIO_PRG_NO)
(GPIO_INPUT | GPIO_PULL_DOWN | GPIO_OUT_LOW  | GPIO_PRG_NO)

(GPIO_INPUT | GPIO_PULL_DOWN | GPIO_OUT_LOW  | GPIO_PRG_NO)
(GPIO_INPUT | GPIO_PULL_DOWN | GPIO_OUT_LOW  | GPIO_PRG_NO)
(GPIO_INPUT | GPIO_PULL_DOWN | GPIO_OUT_LOW  | GPIO_PRG_NO)
(GPIO_INPUT | GPIO_PULL_DOWN | GPIO_OUT_LOW  | GPIO_PRG_NO)
(GPIO_INPUT | GPIO_PULL_DOWN | GPIO_OUT_LOW  | GPIO_PRG_NO)
(GPIO_INPUT | GPIO_PULL_DOWN | GPIO_OUT_LOW  | GPIO_PRG_NO)
(GPIO_INPUT | GPIO_PULL_DOWN | GPIO_OUT_LOW  | GPIO_PRG_NO)
(GPIO_INPUT | GPIO_PULL_DOWN | GPIO_OUT_LOW  | GPIO_PRG_NO)
(GPIO_INPUT | GPIO_PULL_DOWN | GPIO_OUT_LOW  | GPIO_PRG_NO)
(GPIO_INPUT | GPIO_PULL_DOWN | GPIO_OUT_LOW  | GPIO_PRG_NO)

(GPIO_INPUT | GPIO_PULL_DOWN | GPIO_OUT_LOW  | GPIO_PRG_NO)
(GPIO_INPUT | GPIO_PULL_DOWN | GPIO_OUT_LOW  | GPIO_PRG_NO)
(GPIO_INPUT | GPIO_PULL_DOWN | GPIO_OUT_LOW  | GPIO_PRG_NO)
(GPIO_INPUT | GPIO_PULL_DOWN | GPIO_OUT_LOW  | GPIO_PRG_NO)
(GPIO_INPUT | GPIO_PULL_DOWN | GPIO_OUT_LOW  | GPIO_PRG_NO)
(GPIO_INPUT | GPIO_PULL_DOWN | GPIO_OUT_LOW  | GPIO_PRG_NO)
(GPIO_INPUT | GPIO_PULL_DOWN | GPIO_OUT_LOW  | GPIO_PRG_NO)
(GPIO_INPUT | GPIO_PULL_DOWN | GPIO_OUT_LOW  | GPIO_PRG_NO)
(GPIO_INPUT | GPIO_PULL_DOWN | GPIO_OUT_LOW  | GPIO_PRG_NO)
(GPIO_INPUT | GPIO_PULL_DOWN | GPIO_OUT_LOW  | GPIO_PRG_NO)

(GPIO_INPUT | GPIO_PULL_DOWN | GPIO_OUT_LOW  | GPIO_PRG_NO)
(GPIO_OUTPUT| GPIO_NO_PULL   |  GPIO_OUT_LOW | GPIO_PRG_YES)
(GPIO_INPUT | GPIO_NO_PULL   | GPIO_OUT_LOW  | GPIO_PRG_YES)
(GPIO_INPUT | GPIO_PULL_DOWN | GPIO_OUT_LOW  | GPIO_PRG_NO)
(GPIO_INPUT | GPIO_PULL_DOWN | GPIO_OUT_LOW  | GPIO_PRG_NO)
(GPIO_INPUT | GPIO_PULL_DOWN | GPIO_OUT_LOW  | GPIO_PRG_NO)
(GPIO_INPUT | GPIO_PULL_DOWN | GPIO_OUT_LOW  | GPIO_PRG_NO)
(GPIO_INPUT | GPIO_PULL_DOWN | GPIO_OUT_LOW  | GPIO_PRG_NO)
(GPIO_INPUT | GPIO_PULL_DOWN | GPIO_OUT_LOW  | GPIO_PRG_NO)
(GPIO_INPUT | GPIO_PULL_DOWN | GPIO_OUT_LOW  | GPIO_PRG_NO)

(GPIO_INPUT | GPIO_PULL_DOWN | GPIO_OUT_LOW  | GPIO_PRG_NO)
(GPIO_INPUT | GPIO_PULL_DOWN | GPIO_OUT_LOW  | GPIO_PRG_NO)
(GPIO_INPUT | GPIO_PULL_DOWN | GPIO_OUT_LOW  | GPIO_PRG_NO)
(GPIO_INPUT | GPIO_PULL_DOWN | GPIO_OUT_LOW  | GPIO_PRG_NO)
(GPIO_INPUT | GPIO_PULL_DOWN | GPIO_OUT_LOW  | GPIO_PRG_NO)
(GPIO_INPUT | GPIO_PULL_DOWN | GPIO_OUT_LOW  | GPIO_PRG_NO)
(GPIO_INPUT | GPIO_PULL_DOWN | GPIO_OUT_LOW  | GPIO_PRG_NO)
(GPIO_INPUT | GPIO_PULL_DOWN | GPIO_OUT_LOW  | GPIO_PRG_NO)
(GPIO_INPUT | GPIO_PULL_DOWN | GPIO_OUT_LOW  | GPIO_PRG_NO)
(GPIO_INPUT | GPIO_PULL_DOWN | GPIO_OUT_LOW  | GPIO_PRG_NO)

(GPIO_INPUT | GPIO_PULL_DOWN | GPIO_OUT_LOW  | GPIO_PRG_NO)
(GPIO_INPUT | GPIO_PULL_DOWN | GPIO_OUT_LOW  | GPIO_PRG_NO)
(GPIO_INPUT | GPIO_NO_PULL   | GPIO_OUT_LOW  | GPIO_PRG_YES)
(GPIO_INPUT | GPIO_PULL_DOWN | GPIO_OUT_LOW  | GPIO_PRG_NO)
(GPIO_INPUT | GPIO_PULL_DOWN | GPIO_OUT_LOW  | GPIO_PRG_NO)
(GPIO_INPUT | GPIO_PULL_DOWN | GPIO_OUT_LOW  | GPIO_PRG_NO)
(GPIO_INPUT | GPIO_PULL_DOWN | GPIO_OUT_LOW  | GPIO_PRG_NO)
(GPIO_INPUT | GPIO_PULL_DOWN | GPIO_OUT_LOW  | GPIO_PRG_NO)
(GPIO_INPUT | GPIO_NO_PULL   | GPIO_OUT_LOW  | GPIO_PRG_YES)
(GPIO_INPUT | GPIO_NO_PULL   | GPIO_OUT_LOW  | GPIO_PRG_YES)

(GPIO_INPUT | GPIO_PULL_DOWN | GPIO_OUT_LOW  | GPIO_PRG_NO)
(GPIO_INPUT | GPIO_PULL_DOWN | GPIO_OUT_LOW  | GPIO_PRG_NO)
(GPIO_INPUT | GPIO_PULL_DOWN | GPIO_OUT_LOW  | GPIO_PRG_NO)
(GPIO_INPUT | GPIO_PULL_DOWN | GPIO_OUT_LOW  | GPIO_PRG_NO)
(GPIO_INPUT | GPIO_PULL_DOWN | GPIO_OUT_LOW  | GPIO_PRG_NO)
(GPIO_INPUT | GPIO_PULL_DOWN | GPIO_OUT_LOW  | GPIO_PRG_NO)
(GPIO_INPUT | GPIO_PULL_DOWN | GPIO_OUT_LOW  | GPIO_PRG_NO)
(GPIO_INPUT | GPIO_PULL_DOWN | GPIO_OUT_LOW  | GPIO_PRG_NO)
(GPIO_INPUT | GPIO_PULL_DOWN | GPIO_OUT_LOW  | GPIO_PRG_NO)
(GPIO_INPUT | GPIO_PULL_DOWN | GPIO_OUT_LOW  | GPIO_PRG_NO)

(GPIO_INPUT | GPIO_PULL_DOWN | GPIO_OUT_LOW  | GPIO_PRG_NO)
(GPIO_INPUT | GPIO_PULL_DOWN | GPIO_OUT_LOW  | GPIO_PRG_NO)
(GPIO_INPUT | GPIO_PULL_DOWN | GPIO_OUT_LOW  | GPIO_PRG_NO)
(GPIO_INPUT | GPIO_PULL_DOWN | GPIO_OUT_LOW  | GPIO_PRG_NO)
(GPIO_INPUT | GPIO_PULL_DOWN | GPIO_OUT_LOW  | GPIO_PRG_NO)
(GPIO_INPUT | GPIO_PULL_DOWN | GPIO_OUT_LOW  | GPIO_PRG_NO)
(GPIO_INPUT | GPIO_PULL_DOWN | GPIO_OUT_LOW  | GPIO_PRG_NO)
(GPIO_INPUT | GPIO_PULL_DOWN | GPIO_OUT_LOW  | GPIO_PRG_NO)
(GPIO_INPUT | GPIO_PULL_DOWN | GPIO_OUT_LOW  | GPIO_PRG_NO)
(GPIO_INPUT | GPIO_PULL_DOWN | GPIO_OUT_LOW  | GPIO_PRG_NO)
  >;
};