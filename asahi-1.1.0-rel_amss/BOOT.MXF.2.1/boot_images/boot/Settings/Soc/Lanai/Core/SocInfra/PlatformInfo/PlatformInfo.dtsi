&soc {
 PlatformInfo {
  compatible = "qcom,platforminfo";
  PlatformInfo = [
    /*
     * PlatformInfo Version
     */
    05

    /*
     * Platform type
     * Eg: 8 - MTP
     *     1 - CDP
     */
    //08
    0B

    /*
     * Major HW Version
     */
    01

    /*
     * Minor HW Version
     */
    00

    /*
     * Subtype
     */
    00

    /*
     * OEM Variant
     * 0x00 => Qualcomm reference platform
     * 0x01-0xff => OEM variant
     */
    00

    /*
     * Number of key-value pairs
     */
    00

    /*
     * Key-value pairs
     * Eg: FUSION, SLT, etc
     */
    // 00 00
    // 00 00
  ];
 };
};
