#include <limits.h>

&soc { 
  OEMInfo { 
    compatible = "qcom,oeminfo";
    /*This order is strictly relevant to the internal functionality of the driver 
    *and is not pertinent information to the user. This is because the driver, 
    *in its current state, cannot support more than one input type simultaneously.
    *There are considerations for future versions of the driver to support such 
    *functionality, if requested. But as delivered, a declaration of more than one 
    *"OEMDevice" in the DT file will cause a failure of the driver's initialization
    */
    OEMDevices { 
      ADC { 
        // Purposely none of the ADC measurements match .63V
        ADCMsmt = < 100000 200000 300000 400000 >;
        OEMVariant = < 1 2 3 4 >; 
      };
    };
  };
};
