/dts-v1/;

/ {
	compatible = "qcom,lanai-post-ddr", "qcom,lanai";
	model = "qcom,lanai";
};

#include "soc_pre-ddr.dtsi"             /* Common SoC Node Definitions */
#include "soc.dtsi"                     /* Post-DDR SoC Node Definitions */
#include "../../Platform/Lanai_Default/platform-1.0.dtsi"