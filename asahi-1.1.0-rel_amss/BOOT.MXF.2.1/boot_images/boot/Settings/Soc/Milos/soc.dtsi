//#include "Core/Buses/I2C/i2c.dtsi"
#include "Core/Buses/SPI/spi.dtsi"
#include "Core/PIL/pil.dtsi"
//#include "Core/DAL/dal.dtsi"
#include "Core/HWEngines/BAM/bam.dtsi"
//#include "Core/HWEngines/PCIe/pcie.dtsi"
//#include "Core/HWEngines/TSENS/tsens.dtsi"
//#include "Core/MPROC/SMEM/smem.dtsi"
#include "Core/SMMU/iort.dtsi"
#include "Core/PMIC/pmic.dtsi"
//#include "Core/PMIC/buttons.dtsi"
//#include "Core/Services/services.dtsi"
//#include "Core/SocInfra/Busywait/busywait.dtsi"
//#include "Core/SocInfra/Clock/clock.dtsi"
//#include "Core/SocInfra/HWIO/hwio.dtsi"
//#include "Core/SocInfra/ICB/icb.dtsi"
#include "Core/SocInfra/TLMM/pinctrl.dtsi"
#include "Core/Storage/SDCC/sdcc.dtsi"
#include "Core/WiredConnectivity/USB/usb.dtsi"
#include "Core/SSR/ssr.dtsi"
#include "Core/Uefi/uefi.dtsi"
#include "Core/Quantum/quantum.dtsi"

#include "Multimedia/Display/display.dtsi"

//#include "Core/SW/Buses/I2C/i2c.dtsi"
//#include "Core/SW/Buses/SPI/spi.dtsi"
//#include "Core/SW/DAL/dal.dtsi"
//#include "Core/SW/HWEngines/BAM/bam.dtsi"
//#include "Core/SW/HWEngines/PCIe/pcie.dtsi"
//#include "Core/SW/HWEngines/TSENS/tsens.dtsi"
//#include "Core/SW/MPROC/SMEM/smem.dtsi"
//#include "Core/SW/PMIC/pmic.dtsi"
//#include "Core/SW/Services/services.dtsi"
//#include "Core/SW/SocInfra/Busywait/busywait.dtsi"
//#include "Core/SocInfra/Clock/clock.dtsi"
//#include "Core/SW/SocInfra/HWIO/hwio.dtsi"
//#include "Core/SW/SocInfra/ICB/icb.dtsi"
//#include "Core/SW/SocInfra/TLMM/tlmm.dtsi"
//#include "Core/SW/Storage/UFS/ufs.dtsi"
//#include "Core/SW/WiredConnectivity/USB/usb.dtsi"
#include "Core/MPROC/SMP2P/smp2p.dtsi"
#include "Core/MPROC/GLINK/glink.dtsi"
