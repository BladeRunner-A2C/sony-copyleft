&soc {
  disp_rdump_memory: disp_rdump_region@E3940000 {
    compatible = "qcom,display";
    reg   = <0xE3940000 0x02B00000>;
    label = "disp_rdump_region";
  };

  // Table for text resolution modes,
  // Maximum number of entries is 7, the mode resolution must be in descending order.
  text_mode_table {
    table = <
    135  126
    96   71
    96   67
    96   53
    90   67
    75   42
    80   25>;
   };
};
