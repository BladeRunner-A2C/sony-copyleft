/dts-v1/;

/ {
	compatible = "qcom,milos-post-ddr", "qcom,milos";
	model = "qcom,milos";
};

#include "soc_pre-ddr.dtsi"             /* Common SoC Node Definitions */
#include "soc.dtsi"                     /* Post-DDR SoC Node Definitions */
#include "../../Platform/Milos_Default/platform-1.0.dtsi"