/ {
	compatible = "qcom,palawan";
	model = "qcom,palawan";

	#address-cells = <2>;
	#size-cells = <2>;

	soc: soc {
		#address-cells = <1>;
		#size-cells = <1>;
	};

	sw: sw { };
};

// Core Pre-DDR SoC settings here

#include "Core/Boot/ddr.dtsi"
#include "Core/Boot/sw_boot.dtsi"	/* Boot SW configuration settings */
#include "Core/PMIC/pmic_pre_ddr.dtsi"
#include "Core/PMIC/buttons.dtsi"
#include "Core/SocInfra/PlatformInfo/PlatformInfo.dtsi"
#include "Core/SocInfra/TLMM/tlmm.dtsi"
#include "Core/Storage/UFS/ufs.dtsi"
#include "Core/MPROC/SMEM/smem.dtsi"
#include "Core/Power/BootTempCheck/BootTempCheckDT.dtsi"
#include "Core/TSENS/TsensBsp.dtsi"
#include "Core/Buses/I2C/i2c.dtsi"
