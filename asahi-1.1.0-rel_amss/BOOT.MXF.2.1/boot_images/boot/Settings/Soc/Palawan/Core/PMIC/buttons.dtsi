/**
This is the configuration file for Button Configurations;
Gpio configurations
Platform Keymaps

Copyright (c) 2022 Qualcomm Technologies, Inc. All Rights Reserved.
Confidential and Proprietary - Qualcomm Technologies, Inc.

Update values of gpio configs, platform keymaps when new configs are added
**/

#include "pm_defines.h"
#include "button_defines.h"


&soc {
  buttons: buttons { };
};

&buttons {

  buttons-config {
    compatible = "qcom,pm-button";

    gpio-configs = <
    /* BTNType     GpioType   PmicIndex GPioNumber IsSourcePulls             VoltageSource     OutBufStrength               Source*/
      VOL_UP_BTN   PMIC_GPIO   PMIC_B   PM_GPIO_6  BUTTON_GPIO_PULL_UP_30uA  BUTTON_GPIO_VIN1  BUTTON_GPIO_OUT_DRV_STR_LOW  BUTTON_GPIO_SRC_GND
    /*HOME_BTN     TLMM_GPIO   PMIC_B   PM_GPIO_1  BUTTON_GPIO_PULL_UP_30uA  BUTTON_GPIO_VIN1  BUTTON_GPIO_OUT_DRV_STR_LOW  BUTTON_GPIO_SRC_GND
      CAMERA_BTN   TLMM_GPIO   PMIC_B   PM_GPIO_1  BUTTON_GPIO_PULL_UP_30uA  BUTTON_GPIO_VIN1  BUTTON_GPIO_OUT_DRV_STR_LOW  BUTTON_GPIO_SRC_GND*/
    >;
  };

  platform-key-maps {
    compatible = "qcom,pm-keymap";

    key-maps = <
     /* power  vol_up      vol_down     reserved1     reserved2 */
        PWR    VOL_UP      VOL_DOWN     RESERVED      RESERVED
    >;
  };
};
