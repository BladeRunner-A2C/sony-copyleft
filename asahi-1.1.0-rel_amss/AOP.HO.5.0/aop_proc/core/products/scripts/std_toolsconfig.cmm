//============================================================================
//  Name:                                                                     
//    std_toolsconfig.cmm 
//
//  Description:                                                              
//    None 
//                                                                            
// Copyright (c) 2024 by QUALCOMM Technologies, Incorporated.  All Rights Reserved.        
//============================================================================
//                                                                            
// *** AUTO GENERATED FILE - DO NOT EDIT                                      
//                                                                            
// GENERATED: Mon Apr  1 10:13:23 2024 
//============================================================================


GLOBAL &AOP_ABS_BUILD_ROOT
GLOBAL &AOP_BUILD_ROOT
GLOBAL &AOP_CBSP_ROOT
GLOBAL &AOP_SCRIPTSDIR
GLOBAL &AOP_BUILDMSDIR



&AOP_ABS_BUILD_ROOT="/local/mnt/workspace/CRMBuilds/e68a4a61-a213-45bf-0ec1-08dc4a24af2c/b/HY11_1/aop_proc"
&AOP_BUILD_ROOT=os.ppd()+"/../../.."
&AOP_CBSP_ROOT=os.ppd()+"/../.."
&AOP_SCRIPTSDIR=os.ppd()+"/../../products"
&AOP_BUILDMSDIR=os.ppd()+"/../../../aop/build/ms"


ENDDO